## drivers/pci/cadence/Kconfig
```kconfig
menuconfig PCI_CADENCE
	bool "Cadence PCI controllers support"
	depends on PCI && HAS_IOMEM
	help
	  Say Y here if you want to support some Cadence PCI controller.

	  When in doubt, say N.

if PCI_CADENCE

config PCIE_CADENCE
	bool

config PCIE_CADENCE_HOST
	bool "Cadence PCIe host controller"
	depends on OF
	depends on PCI_MSI_IRQ_DOMAIN
	select PCIE_CADENCE
	help
	  Say Y here if you want to support the Cadence PCIe controller in host
	  mode. This PCIe controller may be embedded into many different vendors
	  SoCs.

config PCIE_CADENCE_EP
	bool "Cadence PCIe endpoint controller"
	depends on PCI_ENDPOINT
	select PCIE_CADENCE
	help
	  Say Y here if you want to support the Cadence PCIe  controller in
	  endpoint mode. This PCIe controller may be embedded into many
	  different vendors SoCs.

endif # PCI_CADENCE
```

## drivers/pci/pcie/dpc/Kconfig
```kconfig
#
# PCI Express Device DPC Configuration
#

config PCIEDPC
	tristate "PCI-e Downstream Port Containment support"
	depends on PCIEPORTBUS
	default n
	help
	  This enables PCI-Express Downstream Port Containment (DPC)
	  driver support. DPC events from Root and Downstream ports
	  will be handled by the DPC driver. If your system doesn't
	  have this capability or you do not want to use this feature,
	  it is safe to answer N.

	  To compile this driver as a module, choose M here: the module
	  will be called dpcdrv.
```

## drivers/peci/Kconfig
```kconfig
#
# Platform Environment Control Interface (PECI) subsystem configuration
#

config PECI
	bool "PECI support"
	select RT_MUTEXES
	select CRC8
	help
	  The Platform Environment Control Interface (PECI) is a one-wire bus
	  interface that provides a communication channel from Intel processors
	  and chipset components to external monitoring or control devices.
```

## drivers/perf/Kconfig
```kconfig
#
# Performance Monitor Drivers
#

menu "Performance monitor support"

config ARM_PMU
	depends on PERF_EVENTS && (ARM || ARM64)
	bool "ARM PMU framework"
	default y
	help
	  Say y if you want to use CPU performance monitors on ARM-based
	  systems.

config QCOM_L3_PMU
	 bool "Qualcomm Technologies L3-cache PMU"
	 depends on ARCH_QCOM && ARM64 && PERF_EVENTS && ACPI
	   help
	   Provides support for the L3 cache performance monitor unit (PMU)
	   in Qualcomm Technologies processors.
	   Adds the L3 cache PMU into the perf events subsystem for
	   monitoring L3 cache events.

config XGENE_PMU
        depends on PERF_EVENTS && ARCH_XGENE
        bool "APM X-Gene SoC PMU"
        default n
        help
          Say y if you want to use APM X-Gene SoC performance monitors.

endmenu
```

## drivers/phy/Kconfig
```kconfig
#
# PHY
#

menu "PHY Subsystem"

config GENERIC_PHY
	bool "PHY Core"
	help
	  Generic PHY support.

	  This framework is designed to provide a generic interface for PHY
	  devices present in the kernel. This layer will have the generic
	  API by which phy drivers can create PHY using the phy framework and
	  phy users can obtain reference to the PHY. All the users of this
	  framework should select this config.

config PHY_LPC18XX_USB_OTG
	tristate "NXP LPC18xx/43xx SoC USB OTG PHY driver"
	depends on OF && (ARCH_LPC18XX || COMPILE_TEST)
	depends on MFD_SYSCON
	select GENERIC_PHY
	help
	  Enable this to support NXP LPC18xx/43xx internal USB OTG PHY.

	  This driver is need for USB0 support on LPC18xx/43xx and takes
	  care of enabling and clock setup.

config PHY_MT65XX_USB3
	tristate "Mediatek USB3.0 PHY Driver"
	depends on ARCH_MEDIATEK && OF
	select GENERIC_PHY
	help
	  Say 'Y' here to add support for Mediatek USB3.0 PHY driver
	  for mt65xx SoCs. it supports two usb2.0 ports and
	  one usb3.0 port.

config PHY_PISTACHIO_USB
	tristate "IMG Pistachio USB2.0 PHY driver"
	depends on MACH_PISTACHIO
	select GENERIC_PHY
	help
	  Enable this to support the USB2.0 PHY on the IMG Pistachio SoC.

config PHY_XGENE
	tristate "APM X-Gene 15Gbps PHY support"
	depends on HAS_IOMEM && OF && (ARM64 || COMPILE_TEST)
	select GENERIC_PHY
	help
	  This option enables support for APM X-Gene SoC multi-purpose PHY.

menuconfig PHY_PLAT
	bool "Platform Phy drivers"

if PHY_PLAT
source "drivers/phy/bcom/Kconfig"
source "drivers/phy/hisi/Kconfig"
source "drivers/phy/marvell/Kconfig"
source "drivers/phy/qcom/Kconfig"
source "drivers/phy/rcar/Kconfig"
source "drivers/phy/rockchip/Kconfig"
source "drivers/phy/samsung/Kconfig"
source "drivers/phy/st/Kconfig"
source "drivers/phy/sunxi/Kconfig"
source "drivers/phy/ti/Kconfig"
endif

endmenu
```

## drivers/phy/amlogic/Kconfig
```kconfig
#
# Phy drivers for Amlogic platforms
#
config PHY_MESON8B_USB2
	tristate "Meson8, Meson8b and GXBB USB2 PHY driver"
	default ARCH_MESON
	depends on OF && (ARCH_MESON || COMPILE_TEST)
	depends on USB_SUPPORT
	select USB_COMMON
	select GENERIC_PHY
	help
	  Enable this to support the Meson USB2 PHYs found in Meson8,
	  Meson8b and GXBB SoCs.
	  If unsure, say N.

config PHY_MESON_GXL_USB2
	tristate "Meson GXL and GXM USB2 PHY drivers"
	default ARCH_MESON
	depends on OF && (ARCH_MESON || COMPILE_TEST)
	depends on USB_SUPPORT
	select GENERIC_PHY
	select REGMAP_MMIO
	help
	  Enable this to support the Meson USB2 PHYs found in Meson
	  GXL and GXM SoCs.
	  If unsure, say N.

config PHY_MESON_GXL_USB3
	tristate "Meson GXL and GXM USB3 PHY drivers"
	default ARCH_MESON
	depends on OF && (ARCH_MESON || COMPILE_TEST)
	depends on USB_SUPPORT
	select GENERIC_PHY
	select REGMAP_MMIO
	help
	  Enable this to support the Meson USB3 PHY and OTG detection
	  IP block found in Meson GXL and GXM SoCs.
	  If unsure, say N.

config PHY_MESON_AXG_PCIE
	bool "Meson AXG PCIe PHY driver"
	depends on OF && (ARCH_MESON || COMPILE_TEST)
	select GENERIC_PHY
	help
	  Enable PCIe PHY support for Meson AXG SoC series.
	  This driver provides PHY interface for Meson PCIe controller.
```

## drivers/phy/bcom/Kconfig
```kconfig
#
# PHY drivers for Broadcom platforms
#
config PHY_CYGNUS_PCIE
	tristate "Broadcom Cygnus PCIe PHY driver"
	depends on OF && (ARCH_BCM_CYGNUS || COMPILE_TEST)
	select GENERIC_PHY
	default ARCH_BCM_CYGNUS
	help
	  Enable this to support the Broadcom Cygnus PCIe PHY.
	  If unsure, say N.

config BCM_KONA_USB2_PHY
	tristate "Broadcom Kona USB2 PHY Driver"
	depends on HAS_IOMEM
	select GENERIC_PHY
	help
	  Enable this to support the Broadcom Kona USB 2.0 PHY.

config PHY_BRCMSTB_SATA
	tristate "Broadcom STB SATA PHY driver"
	depends on ARCH_BRCMSTB || BMIPS_GENERIC
	depends on OF
	select GENERIC_PHY
	help
	  Enable this to support the SATA3 PHY on 28nm or 40nm Broadcom STB SoCs.
	  Likely useful only with CONFIG_SATA_BRCMSTB enabled.
```

## drivers/phy/cadence/Kconfig
```kconfig
#
# Phy drivers for Cadence PHYs
#
config CDNS_SIERRA_PHY
	tristate "Cadence Sierra PHY Driver"
	depends on OF && HAS_IOMEM && RESET_CONTROLLER
	select GENERIC_PHY
	help
	  Enable this to support the Cadence Sierra PHY driver
```

## drivers/phy/qcom/Kconfig
```kconfig
#
# PHY drivers for Qualcomm platforms
#
config PHY_QCOM_APQ8064_SATA
	tristate "Qualcomm APQ8064 SATA SerDes/PHY driver"
	depends on ARCH_QCOM
	depends on HAS_IOMEM
	depends on OF
	select GENERIC_PHY

config PHY_QCOM_IPQ806X_SATA
	tristate "Qualcomm IPQ806x SATA SerDes/PHY driver"
	depends on ARCH_QCOM
	depends on HAS_IOMEM
	depends on OF
	select GENERIC_PHY

config PHY_QCOM_UFS
	tristate "Qualcomm UFS PHY driver"
	depends on OF && ARCH_QCOM
	select GENERIC_PHY
	help
	  Support for UFS PHY on QCOM chipsets.
```

## drivers/phy/rcar/Kconfig
```kconfig
#
# PHY drivers for Renesas's r-car platforms
#
config PHY_RCAR_GEN2
	tristate "Renesas R-Car generation 2 USB PHY driver"
	depends on ARCH_SHMOBILE
	depends on GENERIC_PHY
	help
	  Support for USB PHY found on Renesas R-Car generation 2 SoCs.

config PHY_RCAR_GEN3_USB2
	tristate "Renesas R-Car generation 3 USB 2.0 PHY driver"
	depends on OF && ARCH_SHMOBILE
	select GENERIC_PHY
	help
	  Support for USB 2.0 PHY found on Renesas R-Car generation 3 SoCs.
```

## drivers/phy/rockchip/Kconfig
```kconfig
#
# PHY drivers for Rockchip platforms
#
config PHY_ROCKCHIP_USB
	tristate "Rockchip USB2 PHY Driver"
	depends on ARCH_ROCKCHIP && OF
	select GENERIC_PHY
	help
	  Enable this to support the Rockchip USB 2.0 PHY.

config PHY_ROCKCHIP_EMMC
	tristate "Rockchip EMMC PHY Driver"
	depends on ARCH_ROCKCHIP && OF
	select GENERIC_PHY
	help
	  Enable this to support the Rockchip EMMC PHY.

config PHY_ROCKCHIP_DP
	tristate "Rockchip Display Port PHY Driver"
	depends on ARCH_ROCKCHIP && OF
	select GENERIC_PHY
	help
	  Enable this to support the Rockchip Display Port PHY.
```

## drivers/phy/st/Kconfig
```kconfig
#
# PHY drivers for ST Micro platforms
#
config PHY_MIPHY28LP
	tristate "STMicroelectronics MIPHY28LP PHY driver for STiH407"
	depends on ARCH_STI
	select GENERIC_PHY
	help
	  Enable this to support the miphy transceiver (for SATA/PCIE/USB3)
	  that is part of STMicroelectronics STiH407 SoC.

config PHY_MIPHY365X
	tristate "STMicroelectronics MIPHY365X PHY driver for STiH41x series"
	depends on ARCH_STI
	depends on HAS_IOMEM
	depends on OF
	select GENERIC_PHY
	help
	  Enable this to support the miphy transceiver (for SATA/PCIE)
	  that is part of STMicroelectronics STiH41x SoC series.

config PHY_ST_SPEAR1310_MIPHY
	tristate "ST SPEAR1310-MIPHY driver"
	select GENERIC_PHY
	depends on MACH_SPEAR1310 || COMPILE_TEST
	help
	  Support for ST SPEAr1310 MIPHY which can be used for PCIe and SATA.

config PHY_ST_SPEAR1340_MIPHY
	tristate "ST SPEAR1340-MIPHY driver"
	select GENERIC_PHY
	depends on MACH_SPEAR1340 || COMPILE_TEST
	help
	  Support for ST SPEAr1340 MIPHY which can be used for PCIe and SATA.

config PHY_STIH407_USB
	tristate "STMicroelectronics USB2 picoPHY driver for STiH407 family"
	depends on RESET_CONTROLLER
	depends on ARCH_STI || COMPILE_TEST
	select GENERIC_PHY
	help
	  Enable this support to enable the picoPHY device used by USB2
	  and USB3 controllers on STMicroelectronics STiH407 SoC families.

config PHY_STIH41X_USB
	tristate "STMicroelectronics USB2 PHY driver for STiH41x series"
	depends on ARCH_STI
	select GENERIC_PHY
	help
	  Enable this to support the USB transceiver that is part of
	  STMicroelectronics STiH41x SoC series.
```

## drivers/phy/tegra/Kconfig
```kconfig
config PHY_TEGRA_XUSB
	tristate "NVIDIA Tegra XUSB pad controller driver"
	depends on PINCTRL_TEGRA && PINCTRL_TEGRA_XUSB
	help
	  Choose this option if you have an NVIDIA Tegra SoC.

	  To compile this driver as a module, choose M here: the module will
	  be called phy-tegra-xusb.
```

## drivers/pinctrl/tegra/Kconfig
```kconfig
config PINCTRL_TEGRA
	bool
	select PINMUX
	select PINCONF

config PINCTRL_TEGRA20
	bool
	select PINCTRL_TEGRA

config PINCTRL_TEGRA30
	bool
	select PINCTRL_TEGRA

config PINCTRL_TEGRA114
	bool
	select PINCTRL_TEGRA

config PINCTRL_TEGRA124
	bool
	select PINCTRL_TEGRA

config PINCTRL_TEGRA210
	bool
	select PINCTRL_TEGRA

config PINCTRL_TEGRA_IO_PAD
	bool "Tegra IO pad Control Driver"
	depends on ARCH_TEGRA && REGULATOR
	select PINCONF
	select PINMUX
	help
	  NVIDIA Tegra124/210 SoC has IO pads which supports multi-voltage
	  level of interfacing and deep power down mode of IO pads. The
	  voltage of IO pads are SW configurable based on IO rail of that
	  pads on T210. This driver provides the interface to change IO pad
	  voltage and power state via pincontrol interface.

config PINCTRL_TEGRA_XUSB
	def_bool y if ARCH_TEGRA
	select GENERIC_PHY
	select PINCONF
	select PINMUX
```

## drivers/platform/arm/Kconfig
```kconfig
config PVPANIC_MMIO
        tristate "pvpanic mmio device support"
        help
          This driver provides support for the pvpanic mmio device. pvpanic mmio
          is a paravirtualized device provided by QEMU; it lets a virtual machine
          (guest) communicate panic events to the host.
```

## drivers/platform/goldfish/Kconfig
```kconfig
menuconfig GOLDFISH
	bool "Platform support for Goldfish virtual devices"
	depends on X86_32 || X86_64 || ARM || ARM64 || MIPS
	depends on HAS_IOMEM
	help
	  Say Y here to get to see options for the Goldfish virtual platform.
	  This option alone does not add any kernel code.

	  Unless you are building for the Android Goldfish emulator say N here.

if GOLDFISH

config GOLDFISH_PIPE
	tristate "Goldfish virtual device for QEMU pipes"
	help
	  This is a virtual device to drive the QEMU pipe interface used by
	  the Goldfish Android Virtual Device.

config GOLDFISH_ADDRESS_SPACE
	tristate "A Goldfish driver that talks to the memory sharing device in QEMU"
	depends on PCI
	depends on GOLDFISH
	help
	  A Goldfish driver that allocates address space ranges in the guest to
	  populate them later in the host. This allows sharing host's memory
	  with the guest.

endif # GOLDFISH
```

## drivers/reset/Kconfig
```kconfig
config RESET_CONTROLLER
	bool
	help
	  Generic Reset Controller support.

	  This framework is designed to abstract reset handling of devices
	  via GPIOs or SoC-internal reset controller modules.

	  If unsure, say no.


menu "Reset Controllers"
	depends on RESET_CONTROLLER

source "drivers/reset/sti/Kconfig"

endmenu
```

## drivers/rpmsg/Kconfig
```kconfig
menuconfig RPMSG
	tristate "Rpmsg drivers"

config RPMSG_CHAR
	tristate "RPMSG device interface"
	depends on RPMSG
	depends on NET
	help
	  Say Y here to export rpmsg endpoints as device files, usually found
	  in /dev. They make it possible for user-space programs to send and
	  receive rpmsg packets.

config RPMSG_QCOM_GLINK_RPM
	tristate "Qualcomm RPM Glink driver"
	depends on RPMSG
	depends on HAS_IOMEM
	depends on MAILBOX
	help
	  Say y here to enable support for the GLINK RPM communication driver,
	  which serves as a channel for communication with the RPM in GLINK
	  enabled systems.

config RPMSG_QCOM_SMD
	tristate "Qualcomm Shared Memory Driver (SMD)"
	depends on QCOM_SMEM
	depends on RPMSG
	help
	  Say y here to enable support for the Qualcomm Shared Memory Driver
	  providing communication channels to remote processors in Qualcomm
	  platforms.

config RPMSG_VIRTIO
	tristate "Virtio remote processor messaging driver (RPMSG)"
	depends on RPMSG
	select VIRTIO
	select VIRTUALIZATION
	help
	  Say y here to enable support for the Virtio remote processor
	  messaging protocol (RPMSG).
```

## drivers/scsi/aic7xxx/Kconfig
```kconfig
config SCSI_AICLIB
	tristate
	default n

source "drivers/scsi/aic7xxx/Kconfig.aic7xxx"
source "drivers/scsi/aic7xxx/Kconfig.aic79xx"
```

## drivers/scsi/emcctd/Kconfig
```kconfig
config SCSI_EMCCTD
	tristate "EMC Cut-Through client driver"
	depends on SCSI && PCI && X86
	help
		This driver supports EMC virtual PCI Cut-Through-Device.
		To compile this driver as a module, choose M here: the
		module will be called emcctd.
```

## drivers/scsi/hisi_sas/Kconfig
```kconfig
config SCSI_HISI_SAS
	tristate "HiSilicon SAS"
	select SCSI_SAS_LIBSAS
	select BLK_DEV_INTEGRITY
	depends on HAS_IOMEM && HAS_DMA
	help
		This driver supports HiSilicon's SAS HBA
```

## drivers/siox/Kconfig
```kconfig
menuconfig SIOX
	tristate "Eckelmann SIOX Support"

if SIOX

config SIOX_BUS_GPIO
	tristate "SIOX GPIO bus driver"

endif
```

## drivers/smaf/Kconfig
```kconfig
config SMAF
	tristate "Secure Memory Allocation Framework"
	depends on DMA_SHARED_BUFFER
	help
	  Choose this option to enable Secure Memory Allocation Framework

config SMAF_CMA
	tristate "SMAF CMA allocator"
	depends on SMAF && HAVE_DMA_ATTRS
	help
	  Choose this option to enable CMA allocation within SMAF

config SMAF_FAKE_SECURE
	tristate "SMAF fake secure module"
	depends on SMAF
	help
	  Choose this option to enable fake secure module for test purpose
```

## drivers/soc/cavium/Kconfig
```kconfig
#
# Cavium ThunderX Soc drivers
#
config CAVIUM_LMC
        depends on ARCH_THUNDER
	def_tristate m

config CAVIUM_OCX
	depends on ARCH_THUNDER
	def_tristate m

config CAVIUM_OCX
        depends on ARCH_THUNDER
	def_tristate m
```
