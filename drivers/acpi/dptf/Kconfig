## drivers/acpi/dptf/Kconfig
```kconfig
config DPTF_POWER
	tristate "DPTF Platform Power Participant"
	depends on X86
	select ACPI_BATTERY_COMMON
	select POWER_SUPPLY
	default y
	help
	  This driver adds support for Dynamic Platform and Thermal Framework
	  (DPTF) Platform Power Participant device support.
	  This participant is responsible for exposing platform telemetry such
	  as platform Power, battery Information such as state of Charge,
	  estimated maximum sustainable power (PMax), SMART battery spec
	  information.

	  To compile this driver as a module, choose M here:
	  the module will be called dptf_power.
```

## drivers/acpi/hmem/Kconfig
```kconfig
config ACPI_HMEM
	bool "ACPI Heterogeneous Memory Support"
	depends on ACPI_NUMA
	depends on SYSFS
	help
	  Exports a sysfs representation of the ACPI Heterogeneous Memory
	  Attributes Table (HMAT).
```

## drivers/amba/Kconfig
```kconfig
menuconfig TEGRA_AHB
	bool "NVIDIA Tegra AHB"
	depends on ARCH_TEGRA
	default y if ARCH_TEGRA
	help
	  Adds AHB configuration functionality for NVIDIA Tegra SoCs,
	  which controls AHB bus master arbitration and some performance
	  parameters (priority, prefetch size).
```

## drivers/base/Kconfig.debug
```kconfig
menuconfig DRIVER_MATCH_OVERRIDE
	bool "Allow manual driver binding to override id match (DANGEROUS)"
	default n
	help
	  When binding a driver manually bypass the check of driver id table
	  against device id in driver core. This can be useful for development
	  or on buses that don't provide reliable device identification.

config DRIVER_MATCH_OVERRIDE_BUSES
	string "Specify buses for which id matching will be overridden"
	default "spi"
	depends on DRIVER_MATCH_OVERRIDE
	help
	  space separated bus names
```

## drivers/clk/actions/Kconfig
```kconfig
config CLK_ACTIONS
	bool "Clock driver for Actions Semi SoCs"
	depends on ARCH_ACTIONS || COMPILE_TEST
	default ARCH_ACTIONS

if CLK_ACTIONS

# SoC Drivers

config CLK_OWL_S700
	bool "Support for the Actions Semi OWL S700 clocks"
	depends on (ARM64 && ARCH_ACTIONS) || COMPILE_TEST
	default ARM64 && ARCH_ACTIONS

config CLK_OWL_S900
	bool "Support for the Actions Semi OWL S900 clocks"
	depends on (ARM64 && ARCH_ACTIONS) || COMPILE_TEST
	default ARM64 && ARCH_ACTIONS

if CLK_OWL_S700
config MMC_OWL_CLK_NANDPLL
	bool "Set MMC clock rate as same as NAND"
	depends on CLK_OWL_S700
	default n
endif

endif
```

## drivers/clk/intel/Kconfig
```kconfig
# SPDX-License-Identifier: GPL-2.0
config COMMON_CLK_INTEL
	depends on COMMON_CLK
	depends on INTEL_MIPS || COMPILE_TEST
	select MFD_SYSCON
	bool "Intel clock controller support"
	help
	  This driver support Intel GRX500 crystal oscillator clock
	  using common clock framework.

choice
	prompt "SoC platform selection"
	depends on COMMON_CLK_INTEL
	default INTEL_GRX500_CLK

config INTEL_GRX500_CLK
	bool "GRX500 CLK"
	help
	  Clock driver of GRX500 platform.

endchoice
```

## drivers/clk/nxp/Kconfig
```kconfig
config CLK_74AUP1G157GW
	tristate "NXP 74AUP1G157GW Low-power 2-input multiplexer support as clock"
	help
	  This enables NXP 74AUP1G157GW 2-input multiplexer as clock driver
```

## drivers/clk/samsung/Kconfig
```kconfig
config COMMON_CLK_SAMSUNG
	bool
	select COMMON_CLK

# ARMv7 SoCs:
config S3C2410_COMMON_CLK
	bool
	select COMMON_CLK_SAMSUNG
	help
	  Build the s3c2410 clock driver based on the common clock framework.

config S3C2410_COMMON_DCLK
	bool
	select COMMON_CLK_SAMSUNG
	select REGMAP_MMIO
	help
	  Temporary symbol to build the dclk driver based on the common clock
	  framework.

config S3C2412_COMMON_CLK
	bool
	select COMMON_CLK_SAMSUNG

config S3C2443_COMMON_CLK
	bool
	select COMMON_CLK_SAMSUNG

# ARMv8 SoCs:
config EXYNOS5433_COMMON_CLK
	bool
	depends on ARM64 || COMPILE_TEST
	default ARCH_EXYNOS
	select COMMON_CLK_SAMSUNG

config EXYNOS7_COMMON_CLK
	bool
	depends on ARM64 || COMPILE_TEST
	default ARCH_EXYNOS
	select COMMON_CLK_SAMSUNG
```

## drivers/clk/sh/Kconfig
```kconfig
config COMMON_CLK_SH7750
	bool "Clcok driver for SH7750/SH7751"
	depends on CPU_SUBTYPE_SH7750 || CPU_SUBTYPE_SH7750S || \
	           CPU_SUBTYPE_SH7750R || \
	           CPU_SUBTYPE_SH7751 || CPU_SUBTYPE_SH7751R
```

## drivers/counter/Kconfig
```kconfig
#
# Counter devices
#
# When adding new entries keep the list in alphabetical order

menuconfig COUNTER
	tristate "Counter support"
	help
	  Provides Generic Counter interface support for counter devices.

	  Counter devices are prevalent within a diverse spectrum of industries.
	  The ubiquitous presence of these devices necessitates a common
	  interface and standard of interaction and exposure. This driver API
	  attempts to resolve the issue of duplicate code found among existing
	  counter device drivers by providing a generic counter interface for
	  consumption. The Generic Counter interface enables drivers to support
	  and expose a common set of components and functionality present in
	  counter devices.
```

## drivers/crypto/cavium/cpt/Kconfig
```kconfig
#
# Cavium crypto device configuration
#

config CRYPTO_DEV_CPT
	tristate
	select HW_RANDOM_OCTEON
	select CRYPTO_AES
	select CRYPTO_DES
	select CRYPTO_BLKCIPHER
	select FW_LOADER

config OCTEONTX_CPT_PF
	tristate "Octeon-tx CPT Physical function driver"
	depends on ARCH_THUNDER
	select CRYPTO_DEV_CPT
	help
	  Support for Cavium CPT block found in octeon-tx series of
	  processors.

	  To compile this as a module, choose M here: the module will be
	  called cptpf.
config OCTEONTX_CPT_VF
	tristate "Octeon-tx CPT Virtual function driver"
	depends on ARCH_THUNDER
	select CRYPTO_DEV_CPT
	help
	  Support for Cavium CPT Virtual function found in octeon-tx
	  series of processors.

	  To compile this as a module, choose M here: the module will be
	  called cptvf.
```

## drivers/crypto/ccp/Kconfig
```kconfig
config CRYPTO_DEV_CCP_CRYPTO
	tristate "Support for AMD Cryptographic Coprocessor"
	default n
	select AMD_CCP
	select CRYPTO_HASH
	select CRYPTO_BLKCIPHER
	select CRYPTO_AUTHENC
	help
	  Support for using the cryptographic API with the AMD Cryptographic
	  Coprocessor. This module supports offload of SHA and AES algorithms.
	  If you choose 'M' here, this module will be called ccp_crypto.
```

## drivers/crypto/chelsio/Kconfig
```kconfig
config CRYPTO_DEV_CHELSIO
	tristate "Chelsio Crypto Co-processor Driver"
	depends on PCI && NETDEVICES && ETHERNET
	select CRYPTO_SHA1
	select CRYPTO_SHA256
	select CRYPTO_SHA512
	select NET_VENDOR_CHELSIO
	select CHELSIO_T4
	---help---
	  The Chelsio Crypto Co-processor driver for T6 adapters.

	  For general information about Chelsio and our products, visit
	  our website at <http://www.chelsio.com>.

	  For customer support, please visit our customer support page at
	  <http://www.chelsio.com/support.html>.

	  Please send feedback to <linux-bugs@chelsio.com>.

	  To compile this driver as a module, choose M here: the module
	  will be called chcr.
```

## drivers/crypto/stm32/Kconfig
```kconfig
config CRYPTO_DEV_STM32
	tristate "Support for STM32 crypto accelerators"
	depends on ARCH_STM32
	select CRYPTO_HASH
	help
          This enables support for the CRC32 hw accelerator which can be found
	  on STMicroelectronis STM32 SOC.

config CRYP_DEV_STM32
	tristate "Support for STM32 cryp accelerators"
	depends on ARCH_STM32
	select CRYPTO_HASH
	select CRYPTO_ENGINE
	help
          This enables support for the CRYP (AES/DES/TDES) hw accelerator which
	  can be found on STMicroelectronics STM32 SOC.
```

## drivers/devfreq/rockchip/Kconfig
```kconfig
config ARM_ROCKCHIP_DMC_DEVFREQ
	tristate "ARM ROCKCHIP DMC DEVFREQ Driver"
	depends on ARCH_ROCKCHIP
	help
	  This adds the DEVFREQ driver framework for the rockchip dmc.

config ARM_RK3399_DMC_DEVFREQ
	tristate "ARM RK3399 DMC DEVFREQ Driver"
	depends on ARM_ROCKCHIP_DMC_DEVFREQ
	select PM_OPP
	select DEVFREQ_GOV_SIMPLE_ONDEMAND
	help
	  This adds the DEVFREQ driver for the RK3399 dmc. It sets the frequency
	  for the memory controller and reads the usage counts from hardware.
```

## drivers/dma-buf/Kconfig
```kconfig
menu "DMABUF options"

config SYNC
	bool "Synchronization framework"
	default n
	select ANON_INODES
	select DMA_SHARED_BUFFER
	---help---
	  This option enables the framework for synchronization between multiple
	  drivers.  Sync implementations can take advantage of hardware
	  synchronization built into devices like GPUs.

config SW_SYNC
	bool "Software synchronization objects"
	default n
	depends on SYNC
	---help---
	  A sync object driver that uses a 32bit counter to coordinate
	  synchronization.  Useful when there is no hardware primitive backing
	  the synchronization.

endmenu
```

## drivers/dma/mediatek/Kconfig
```kconfig
config DMA_MTK_UART
	tristate "MediaTek SoCs APDMA support for UART"
	depends on OF
	select DMA_ENGINE
	select DMA_VIRTUAL_CHANNELS
	help
	  Support for the UART DMA engine found on MediaTek MTK SoCs.
	  when 8250 mtk uart is enabled, and if you want to using DMA,
	  you can enable the config. the DMA engine just only be used
	  with MediaTek Socs.

config MTK_HSDMA
	tristate "MediaTek High-Speed DMA controller support"
	depends on ARCH_MEDIATEK || COMPILE_TEST
	select DMA_ENGINE
	select DMA_VIRTUAL_CHANNELS
	---help---
	  Enable support for High-Speed DMA controller on MediaTek
	  SoCs.

	  This controller provides the channels which is dedicated to
	  memory-to-memory transfer to offload from CPU through ring-
	  based descriptor management.
```

## drivers/firmware/xilinx/zynqmp/Kconfig
```kconfig
# SPDX-License-Identifier: GPL-2.0+
# Kconfig for Xilinx zynqmp firmware

menu "Zynq MPSoC Firmware Drivers"
	depends on ARCH_ZYNQMP

config ZYNQMP_FIRMWARE
	bool "Enable Xilinx Zynq MPSoC firmware interface"
	help
	  Firmware interface driver is used by different to
	  communicate with the firmware for various platform
	  management services.
	  Say yes to enable zynqmp firmware interface driver.
	  In doubt, say N

config ZYNQMP_FIRMWARE_DEBUG
	bool "Enable Xilinx Zynq MPSoC firmware debug APIs"
	default ARCH_ZYNQMP && ZYNQMP_FIRMWARE && DEBUG_FS
	help
	  Say yes to enable zynqmp firmware interface debug APIs.
	  In doubt, say N

endmenu
```

## drivers/fpga/intel/Kconfig
```kconfig
menuconfig INTEL_FPGA
	tristate "Intel(R) FPGA support"
	depends on FPGA_DEVICE
	help
	  Select this option to enable driver support for Intel(R)
	  Field-Programmable Gate Array (FPGA) solutions. This driver
	  provides interfaces for userspace applications to configure,
	  enumerate, open, and access FPGA accelerators on platforms
	  equipped with Intel(R) FPGA solutions and enables system
	  level management functions such as FPGA reconfiguration,
	  power management, and virtualization.

	  Say Y if your platform has this technology. Say N if unsure.

if INTEL_FPGA

config INTEL_FPGA_PCI
	tristate "Intel FPGA PCIe Driver"
	depends on PCI
	help
	  This is the driver for the PCIe device which locates between
	  CPU and Accelerated Function Units (AFUs) and allows them to
	  communicate with each other.

	  To compile this as a module, choose M here.

config INTEL_FPGA_FME
	tristate "Intel FPGA FME Driver"
	depends on INTEL_FPGA_PCI
	help
	  This is the driver for FPGA Management Engine which implements
	  all FPGA platform level management features. There shall be 1
	  FME per Intel FPGA.

config INTEL_FPGA_AFU
	tristate "Intel FPGA AFU Driver"
	depends on INTEL_FPGA_PCI
	help
	  This is the driver for FPGA Accelerated Function Unit (AFU) which
	  implements AFU and Port management features. A User AFU connects
	  to the FPGA infrastructure via a Port. There may be more than 1
	  Port/AFU per Intel FPGA.

endif
```

## drivers/fsi/Kconfig
```kconfig
#
# FSI subsystem
#

menu "FSI support"

config FSI
	tristate "FSI support"
	---help---
	  FSI - the FRU Support Interface - is a simple bus for low-level
	  access to POWER-based hardware.

if FSI

config FSI_MASTER_GPIO
	tristate "GPIO-based FSI master"
	depends on FSI && GPIOLIB
	---help---
	This option enables a FSI master driver using GPIO lines.

endif

endmenu
```

## drivers/fsi/clients/Kconfig
```kconfig
config FSI_SBEFIFO
	tristate "Self Boot Engine FIFO"
	---help---
	The Self Boot Engine FIFO manages communication between a service
	processor and the Self Boot Engine on POWER processors.
```

## drivers/gpu/drm/amd/powerplay/Kconfig
```kconfig
config DRM_AMD_POWERPLAY
	def_bool DRM_AMDGPU
	help
	  select this option will enable AMD powerplay component.
```

## drivers/gpu/drm/atmel/Kconfig
```kconfig
config DRM_ATMEL
	bool
	help
	  Enable Atmel DRM support

config DRM_ATMEL_HLCDC
	tristate "DRM Support for ATMEL HLCDC Display Controller"
	depends on DRM && OF && COMMON_CLK && MFD_ATMEL_HLCDC && ARM
	select DRM_ATMEL
	select DRM_GEM_CMA_HELPER
	select DRM_KMS_HELPER
	select DRM_KMS_CMA_HELPER
	select DRM_PANEL
	help
	  Choose this option if you have an ATMEL SoC with an HLCDC display
	  controller (i.e. at91sam9n12, at91sam9x5 family or sama5d3 family).

config DRM_ATMEL_LCDC
	tristate "DRM Support for ATMEL LCDC Display Controller"
	depends on DRM && OF && COMMON_CLK && MFD_ATMEL_LCDC && ARM
	select DRM_ATMEL
	select DRM_GEM_CMA_HELPER
	select DRM_KMS_HELPER
	select DRM_KMS_CMA_HELPER
	select DRM_PANEL
	help
	  Choose this option if you have an ATMEL SoC with an LCDC display
	  controller (only at91sam9263 or at91sam9rl).
```

## drivers/gpu/drm/i2c/Kconfig
```kconfig
menu "I2C encoder or helper chips"
     depends on DRM && DRM_KMS_HELPER && I2C

config DRM_I2C_ADV7511
	tristate "AV7511 encoder"
	select REGMAP_I2C
	help
	  Support for the Analog Device ADV7511(W) and ADV7513 HDMI encoders.

config DRM_I2C_ADV7511_AUDIO
	bool "ADV7511 audio"
	depends on DRM_I2C_ADV7511 && SND_SOC
	default y
	help
	  This adds support for audio on the ADV7511(W) and ADV7513 HDMI
	  encoders.

	  By selecting this option the ADV7511 will register a codec interface
	  into ALSA.

config DRM_I2C_CH7006
	tristate "Chrontel ch7006 TV encoder"
	default m if DRM_NOUVEAU
	help
	  Support for Chrontel ch7006 and similar TV encoders, found
	  on some nVidia video cards.

	  This driver is currently only useful if you're also using
	  the nouveau driver.

config DRM_I2C_SIL164
	tristate "Silicon Image sil164 TMDS transmitter"
	default m if DRM_NOUVEAU
	help
	  Support for sil164 and similar single-link (or dual-link
	  when used in pairs) TMDS transmitters, used in some nVidia
	  video cards.

config DRM_I2C_NXP_TDA998X
	tristate "NXP Semiconductors TDA998X HDMI encoder"
	default m if DRM_TILCDC
	help
	  Support for NXP Semiconductors TDA998X HDMI encoders.

endmenu
```
