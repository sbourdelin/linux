## drivers/soc/hisilicon/Kconfig
```kconfig
#
# Hisilicon SoC drivers
#
config HISI_DJTAG
	bool "Hisilicon Djtag Support"
	depends on ARCH_HISI || COMPILE_TEST
	help
	  Say y here to enable the Hisilicon Djtag support. It is an
	  independent module which connects with some modules in the
	  SoC by Debug Bus. This module can be configured to access
	  the registers of connecting modules during real time
	  debugging.
```

## drivers/soc/marvell/Kconfig
```kconfig
#
# MARVELL SoC drivers
#

menu "Marvell SoC drivers"

config OCTEONTX2_MBOX
	tristate

config OCTEONTX2_AF
	tristate "OcteonTX2 RVU Admin Function driver"
	select OCTEONTX2_MBOX
	depends on ARM64 && PCI
	---help---
	  This driver supports Marvell's OcteonTX2 Resource Virtualization
	  Unit's admin function manager which manages all RVU HW resources.

endmenu
```

## drivers/soc/mediatek/Kconfig
```kconfig
#
# MediaTek SoC drivers
#
config MTK_INFRACFG
	bool "MediaTek INFRACFG Support"
	depends on ARCH_MEDIATEK || COMPILE_TEST
	select REGMAP
	help
	  Say yes here to add support for the MediaTek INFRACFG controller. The
	  INFRACFG controller contains various infrastructure registers not
	  directly associated to any device.

config MTK_PMIC_WRAP
	tristate "MediaTek PMIC Wrapper Support"
	depends on ARCH_MEDIATEK
	depends on RESET_CONTROLLER
	select REGMAP
	help
	  Say yes here to add support for MediaTek PMIC Wrapper found
	  on different MediaTek SoCs. The PMIC wrapper is a proprietary
	  hardware to connect the PMIC.

config MTK_SCPSYS
	bool
	select REGMAP
	select MTK_INFRACFG
	select PM_GENERIC_DOMAINS if PM
	help
	  MediaTek SCPSYS power domain support.

config MTK_SCPSYS_MT8173
	bool "MediaTek MT8173 SCPSYS Support"
	depends on ARCH_MEDIATEK || COMPILE_TEST
	select MTK_SCPSYS
	default ARCH_MEDIATEK
	help
	  Say yes here to add support for the MT8173 SCPSYS power domain
	  driver.
	  The System Control Processor System (SCPSYS) has several power
	  management related tasks in the system.

config MTK_SCPSYS_MT2701
	bool "SCPSYS Support MediaTek MT2701"
	depends on ARCH_MEDIATEK || COMPILE_TEST
	select MTK_SCPSYS
	default ARCH_MEDIATEK
	help
	  Say yes here to add support for the MT2701 SCPSYS power domain
	  driver.
	  The System Control Processor System (SCPSYS) has several power
	  management related tasks in the system.
```

## drivers/soc/rockchip/Kconfig
```kconfig
if ARCH_ROCKCHIP || COMPILE_TEST

#
# Rockchip Soc drivers
#
config ROCKCHIP_PM_DOMAINS
        bool "Rockchip generic power domain"
        depends on PM
        select PM_GENERIC_DOMAINS
        help
          Say y here to enable power domain support.
          In order to meet high performance and low power requirements, a power
          management unit is designed or saving power when RK3288 in low power
          mode. The RK3288 PMU is dedicated for managing the power of the whole chip.

          If unsure, say N.

config ROCKCHIP_REBOOT
	bool "Rockchip reboot mode driver"
	select REBOOT_MODE
	help
	  Say y here will enable reboot mode driver. This will
	  get reboot mode arguments from userspace and store it
	  in special register, then the bootloader will read it
	  to take different action according to the mode.

endif
```

## drivers/soc/xilinx/Kconfig
```kconfig
# SPDX-License-Identifier:	GPL-2.0+
# Kconfig for Xilinx SoCs

source "drivers/soc/xilinx/zynqmp/Kconfig"
```

## drivers/soc/xilinx/zynqmp/Kconfig
```kconfig
# SPDX-License-Identifier:	GPL-2.0+
# Kconfig for Xilinx zynqmp SoC
#
menu "Zynq MPSoC SoC Drivers"
	depends on ARCH_ZYNQMP


config ZYNQMP_PM
	bool "Enable Xilinx Zynq MPSoC Power Management"
	depends on PM
	help
	  Say yes to enable power management support for
	  ZyqnMP SoC. In doubt, say N.

endmenu
```

## drivers/soc/zte/Kconfig
```kconfig
#
# zx SoC drivers
#
menuconfig SOC_ZX
        bool "zx SoC driver support"

if SOC_ZX

config ZX_PM_DOMAINS
        bool "zx PM domains"
        depends on PM_GENERIC_DOMAINS

endif
```

## drivers/soundwire/Kconfig
```kconfig
#
# Soundwire subsystem configuration
#

menuconfig SOUNDWIRE
	bool "Soundwire support"
	---help---
	  Soundwire is a 2-Pin interface with data and clock line ratified
	  by the MIPI Alliance. SoundWire is used for transporting data typically
	  related to audio functions. SoundWire interface is optimized to integrate
	  audio devices in mobile or mobile inspired systems.

if SOUNDWIRE

comment "SoundWire Devices"

config SOUNDWIRE_BUS
	tristate
	default SOUNDWIRE

config SOUNDWIRE_CADENCE
	tristate "Intel Soundwire driver for CADENCE Controller"
	depends on SOUNDWIRE_BUS
	---help---
	  If you have an Intel device with Soundwire controller then
	  enable this config option to get the soundwire support for your
	  device

endif
```

## drivers/staging/dmec/Kconfig
```kconfig
config MFD_DMEC
	tristate "Data Modul Embedded Controller MFD"
	select MFD_CORE
	help
	    Say Y here to enable support for a Data Module embedded controller
	    found on Data Module CPU Modules

	    To compile this driver as a module, say M here: the module will be
            called dmec

config I2C_DMEC
	tristate "Data Modul I2C"
	depends on MFD_DMEC && I2C
	help
	  Say Y here to enable support for a i2c bus on the Data Modul
	  embedded controller.

	  To compile this driver as a module, say M here: the module will be
          called i2c-dmec

config GPIO_DMEC
	tristate "Data Modul GPIO"
	depends on MFD_DMEC && GPIOLIB
	help
	  Say Y here to enable support for a GPIOs on a Data Module embedded
	  controller.

	  To compile this driver as a module, say M here: the module will be
          called gpio-dmec
```

## drivers/staging/hv_uio/Kconfig
```kconfig
config HV_UIO
	tristate "Microsoft Hyper-V UIO driver"
	depends on HYPERV_NET && UIO
	help
	  Userspace interface for Hyper-V VMBus.
	  Can be used with DPDK to provide access to network device.
```

## drivers/staging/jnx/Kconfig
```kconfig
#
# Juniper devices
#
config JNX_DEVICES
	bool
	default n

if JNX_DEVICES

menu "Juniper Devices and Infrastructure"

config JNX_SYSTEM
	bool "Juniper System Infrastructure"
	default y
	help
	  This driver adds support for Juniper System Infrastructure. It creates
	  platform devices for the platform, chassis and cards and provides sysfs
	  attributes for these devices.

	  This driver can not be compiled as a module.

endmenu

endif # JNX_DEVICES
```

## drivers/staging/media/allegro-dvt/Kconfig
```kconfig
config VIDEO_ALLEGRO_DVT
	tristate "Allegro DVT Video IP Cores"
	select REGMAP_MMIO
	select V4L2_MEM2MEM_DEV
	help
	  Support for encoder and decoder video IP cores by Allegro DVT.
```

## drivers/staging/media/atomisp/pci/Kconfig
```kconfig
#
# Kconfig for ISP driver
#

config VIDEO_ATOMISP
       tristate "Intel Atom Image Signal Processor Driver"
       depends on VIDEO_V4L2 && VIDEO_V4L2_SUBDEV_API
       select VIDEOBUF_VMALLOC
        ---help---
          Say Y here if your platform supports Intel Atom SoC
          camera imaging subsystem.
          To compile this driver as a module, choose M here: the
          module will be called atomisp

choice
        prompt "Intel Atom Image Signal Processor Driver Type"
        depends on VIDEO_ATOMISP
        default VIDEO_ATOMISP_ISP2400
        help
          Intel Atom Image Signal Processor Driver actually doesn't support
          dynamically all SoC.
          So need to choose at compilation time which SoC it can support.
          Please refer to staging TODO for more details.

config VIDEO_ATOMISP_ISP2400
        bool "ISP2400"
        help
          Atom ISP for Merrifield, Baytrail SoC.

config VIDEO_ATOMISP_ISP2401
        bool "ISP2401"
        help
          Atom ISP for Anniedale (Merrifield+ / Moorefield), Cherrytrail SoC.

endchoice
```

## drivers/staging/media/imx/Kconfig
```kconfig
config VIDEO_IMX_MEDIA
	tristate "i.MX5/6 V4L2 media core driver"
	depends on MEDIA_CONTROLLER && VIDEO_V4L2 && ARCH_MXC && IMX_IPUV3_CORE
	default y
	---help---
	  Say yes here to enable support for video4linux media controller
	  driver for the i.MX5/6 SOC.

if VIDEO_IMX_MEDIA
menu "i.MX5/6 Media Sub devices"

config VIDEO_IMX_CAMERA
	tristate "i.MX5/6 Camera driver"
	depends on VIDEO_IMX_MEDIA && VIDEO_DEV && I2C
	select VIDEOBUF2_DMA_CONTIG
	default y
	---help---
	  A video4linux camera capture driver for i.MX5/6.

config IMX_OV5640_MIPI
       tristate "OmniVision OV5640 MIPI CSI-2 camera support"
       depends on GPIOLIB && VIDEO_IMX_CAMERA
       select IMX_MIPI_CSI2
       default y
       ---help---
         MIPI CSI-2 OV5640 Camera support.

endmenu
endif
```

## drivers/staging/media/imx/capture/Kconfig
```kconfig
menu "i.MX5/6 Camera Sub devices"

config IMX_MIPI_CSI2
       tristate "MIPI CSI2 Receiver Driver"
       depends on VIDEO_IMX_CAMERA
       default y
       ---help---
         MIPI CSI-2 Receiver driver support. This driver is required
	 for sensor drivers with a MIPI CSI2 interface.

config IMX_VIDEO_SWITCH
	tristate "i.MX5/6 Video Bus Multiplexer"
	depends on VIDEO_IMX_CAMERA
	default y
	---help---
	  This driver provides support for the i.MX5/6 internal video bus
	  multiplexer controlled by register bitfields as well as
	  external multiplexers controller by a GPIO.

config IMX_CAMERA_OV5640_MIPI
       tristate "OmniVision OV5640 MIPI CSI-2 camera support"
       depends on VIDEO_IMX_CAMERA
       select IMX_MIPI_CSI2
       default y
       ---help---
         MIPI CSI-2 OV5640 Camera support.

endmenu
```

## drivers/staging/media/st-cec/Kconfig
```kconfig
config VIDEO_STIH_CEC
       tristate "STIH4xx CEC driver"
       depends on VIDEO_DEV && MEDIA_CEC && (ARCH_STI || COMPILE_TEST)
       ---help---
         This is a driver for STIH4xx HDMI CEC interface. It uses the
         generic CEC framework interface.
         CEC bus is present in the HDMI connector and enables communication
         between compatible devices.
```

## drivers/staging/nrf24/Kconfig
```kconfig
config NRF24
        tristate "nRF24L01+ 2.4GHz radio module support"
        depends on SPI
        help
          This enables support for Nordic Semiconductor nRF24L01+ radio module,
          with the following features:
            - multiple radio module instances via nrfX
            - dedicated /dev/nrfX.Y device per pipe per instance
            - dynamic and static payload lengths
            - configuration via sysfs (/sys/class/nrfX)
            - poll mechanism
            - 64kB RX FIFO per pipe
            - 64kB TX FIFO

          To compile this driver as a module, choose M here: the module will be
          called nrf24.
```

## drivers/staging/riffa/Kconfig
```kconfig
config RIFFA_PCIE
    tristate "a simple framework for communicating data from a host CPU to a FPGA via a PCI Express bus"
    default n
    help
        Transfers data with full duplex capability using PCIe protocol
```

## drivers/staging/typec/Kconfig
```kconfig
menu "USB Power Delivery and Type-C drivers"

config TYPEC_TCPM
	tristate "USB Type-C Port Controller Manager"
	depends on USB
	select TYPEC
	help
	  The Type-C Port Controller Manager provides a USB PD and USB Type-C
	  state machine for use with Type-C Port Controllers.

if TYPEC_TCPM

config TYPEC_TCPCI
	tristate "Type-C Port Controller Interface driver"
	depends on I2C
	select REGMAP_I2C
	help
	  Type-C Port Controller driver for TCPCI-compliant controller.

config TYPEC_WCOVE
	tristate "Intel WhiskeyCove PMIC USB Type-C PHY driver"
	depends on ACPI
	depends on INTEL_SOC_PMIC
	depends on INTEL_PMC_IPC
	depends on BXT_WC_PMIC_OPREGION
	help
	  Intel WhiskeyCove PMIC USB PHY Type-C driver that works with Type-C
	  Port Controller Manager to provide USB Power Delivery and USB Type-C
	  functionalities.

source "drivers/staging/typec/fusb302/Kconfig"

endif

endmenu
```

## drivers/staging/vc04_services/bcm2835-audio/Kconfig
```kconfig
config SND_BCM2835
        tristate "BCM2835 Audio"
        depends on ARCH_BCM2835 && SND
        select SND_PCM
        select BCM2835_VCHIQ
        help
          Say Y or M if you want to support BCM2835 built in audio

if SND_BCM2835

config SND_BCM2835_TRADITIONAL_ALSA
	bool "Traditional bcm2835 ALSA"
	default y
	help
	   BCM2835 Audio supports a virtual card for each available
	   output. This may not be compatible with some
	   distributions, so this option adds a virtual card that
	   works like the traditional version.

config SND_BCM2835_HDMI_AUDIO
	bool "HDMI Audio"
	help
	   BCM2835 Audio supports a virtual card for each available
	   output.  This option adds a virtual card specifically
	   for the HDMI output.

config SND_BCM2835_HEADPHONE_AUDIO
	bool "Headphone Audio"
	help
	   BCM2835 Audio supports a virtual card for each available
	   output.  This option adds a virtual card specifically
	   for the Headphone jack.

endif
```

## drivers/staging/vc04_services/bcm2835-firmware-gpio/Kconfig
```kconfig
config FIRMWARE_GPIO_BCM2835
	tristate "BCM2835 Firmware GPIO"
	depends on OF_GPIO && (ARCH_BCM2835 || COMPILE_TEST)
	help
	  Turn on GPIO support for Broadcom chips using the firmware mailbox
	  to communicate with VideoCore on BCM283x chips.
```

## drivers/staging/xm2mvscale/Documentation/devicetree/bindings/xm2mvscaler.txt
```
Xilinx M2M Video Scaler
-----------------------
This document describes the DT bindings required by the
Xilinx M2M Video Scaler driver.

Required Properties:
- compatible		: Must be "xlnx,v-m2m-scaler"
- reg			: Memory map for module access
- reset-gpios		: Should contain GPIO reset phandle
- interrupt-parent	: Interrupt controller the interrupt is routed through
- interrupts		: Should contain DMA channel interrupt
- xlnx,scaler-num-taps	: The number of filter taps for scaling filter
- xlnx,scaler-max-chan	: The maximum number of supported scaling channels

Examples
---------
	v_multi_scaler: v_multi_scaler@a0000000 {
		compatible = "xlnx,v-m2m-scaler";
		reg = <0x0 0xa0000000 0x0 0x10000>;
		reset-gpios = <&gpio 78 1>;
		interrupt-parent = <&gic>;
		interrupts = <0 89 4>;
		xlnx,scaler-num-taps = <6>;
		xlnx,scaler-max-chan = <4>;
	};
```

## drivers/staging/xm2mvscale/Kconfig
```kconfig
config XILINX_M2M_VSC
	tristate "Xilinx M2M Video Scaler"
	depends on ARCH_ZYNQMP && OF
	---help---
	  This driver is developed for Xilinx M2M Video Scaler IP,
	  designed to allow passage of frame buffers from the source
	  kernel sub-system, apply video scaling and forward to the
	  sink kernel sub-system.

	  To compile this driver as a module, choose M here.
	  If unsure, choose N.
```

## drivers/thermal/broadcom/Kconfig
```kconfig
config BCM_NS_THERMAL
	tristate "Northstar thermal driver"
	depends on ARCH_BCM_IPROC || COMPILE_TEST
	help
	  Northstar's DMU (Device Management Unit) block contains a thermal
	  sensor that allows checking CPU temperature. This driver provides
	  support for it.
```

## drivers/thermal/st/Kconfig
```kconfig
config ST_THERMAL
       tristate "Thermal sensors on STMicroelectronics STi series of SoCs"
       help
         Support for thermal sensors on STMicroelectronics STi series of SoCs.

config ST_THERMAL_MEMMAP
	select ST_THERMAL
	tristate "STi series memory mapped access based thermal sensors"
```
