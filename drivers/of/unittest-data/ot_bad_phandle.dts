/dts-v1/;
/plugin/;

/ {

	fragment@0 {
		target = <&electric_1>;

		__overlay__ {

			// This label should cause an error when the overlay
			// is applied.  There is already a phandle value
			// in the base tree for motor_1.
			spin_ctrl_1_conflict: motor_1 {
				accelerate = < 3 >;
				decelerate = < 5 >;
			};
		};
	};
};
