## drivers/thermal/tegra/Kconfig
```kconfig
config TEGRA_SOCTHERM
	bool

config TEGRA124_SOCTHERM
	bool "Tegra124 SOCTHERM thermal management"
	depends on ARCH_TEGRA_124_SOC
	select TEGRA_SOCTHERM
	help
	  Enable this option for integrated thermal management support on NVIDIA
	  Tegra124 systems-on-chip. The driver supports four thermal zones
	  (CPU, GPU, MEM, PLLX). Cooling devices can be bound to the thermal
	  zones to manage temperatures. This option is also required for the
	  emergency thermal reset (thermtrip) feature to function.
```

## drivers/thunderbolt/Kconfig
```kconfig
menuconfig THUNDERBOLT
	tristate "Thunderbolt support"
	depends on PCI
	depends on X86 || COMPILE_TEST
	select APPLE_PROPERTIES if EFI_STUB && X86
	select CRC32
	select CRYPTO
	select CRYPTO_HASH
	select NVMEM
	help
	  Thunderbolt Controller driver. This driver is required if you
	  want to hotplug Thunderbolt devices on Apple hardware or on PCs
	  with Intel Falcon Ridge or newer.

	  To compile this driver a module, choose M here. The module will be
	  called thunderbolt.

config THUNDERBOLT_NET
	tristate "Networking over Thunderbolt cable"
	depends on THUNDERBOLT && INET
	help
	  Select this if you want to create network between two
	  computers over a Thunderbolt cable. The driver supports Apple
	  ThunderboltIP protocol and allows communication with any host
	  supporting the same protocol including Windows and macOS.

	  To compile this driver a module, choose M here. The module will be
	  called thunderbolt-net.
```

## drivers/uart/Kconfig
```kconfig
#
# UART slave driver configuration
#
menuconfig UART_DEV
	tristate "UART device support"
	help
	  Support for devices connected via a UART

if UART_DEV

config UART_DEV_LOOPBACK
	tristate "Loopback Test Driver"
	help
	  This option enables a loopback test driver. Anything received from
	  the connected device will be echoed back.

endif
```

## drivers/usb/cdns3/Kconfig
```kconfig
config USB_CDNS3
	tristate "Cadence USB3 Dual-Role Controller"
	depends on ((USB_XHCI_HCD && USB_GADGET) || (USB_XHCI_HCD && !USB_GADGET) || (!USB_XHCI_HCD && USB_GADGET)) && HAS_DMA
	help
	  Say Y here if your system has a cadence USB3 dual-role controller.
	  It supports: dual-role switch Host-only, and Peripheral-only.

	  If you choose to build this driver is a dynamically linked
	  module, the module will be called cdns3.ko.

if USB_CDNS3

config USB_CDNS3_GADGET
	bool "Cadence USB3 device controller"
	depends on USB_GADGET
	help
	  Say Y here to enable device controller functionality of the
	  cadence USBSS-DEV driver.

	  This controller support FF, HS and SS mode. It doeasn't support
	  LS and SSP mode

config USB_CDNS3_HOST
	bool "Cadence USB3 host controller"
	depends on USB_XHCI_HCD
	help
	  Say Y here to enable host controller functionality of the
	  cadence driver.

	  Host controller is compliance with XHCI so it will use
	  standard XHCI driver.

config USB_CDNS3_PCI_WRAP
	tristate "PCIe-based Platforms"
	depends on USB_PCI && ACPI
	default USB_CDNS3
	help
	  If you're using the USBSS Core IP with a PCIe, please say
	  'Y' or 'M' here.

	  If you choose to build this driver as module it will
	  be dynamically linked and module will be called cdns3-pci.ko

endif
```

## drivers/usb/common/Kconfig
```kconfig
config USB_LED_TRIG
	bool "USB LED Triggers"
	depends on LEDS_CLASS && USB_COMMON && LEDS_TRIGGERS
	help
	  This option adds LED triggers for USB host and/or gadget activity.

	  Say Y here if you are working on a system with led-class supported
	  LEDs and you want to use them as activity indicators for USB host or
	  gadget.
```

## drivers/usb/mux/Kconfig
```kconfig
#
# USB port mux driver configuration
#
menu "USB Port MUX drivers"
config INTEL_USB_MUX
	select EXTCON
	def_bool n
	help
	  Common code for all Intel dual role port mux drivers. All Intel
	  usb port mux drivers should select it.

config INTEL_MUX_GPIO
	tristate "Intel dual role port mux controlled by GPIOs"
	depends on GPIOLIB
	depends on X86 && ACPI
	select INTEL_USB_MUX
	help
	  Say Y here to enable support for Intel dual role port mux
	  controlled by GPIOs.

endmenu
```

## drivers/usb/type-c/Kconfig
```kconfig
menu "USB PD and Type-C drivers"

config TYPEC
	tristate

config TYPEC_UCSI
	tristate "USB Type-C Connector System Software Interface"
	select TYPEC
	help
	  USB Type-C Connector System Software Interface (UCSI) describes the
	  registers and data structures used to interface with the USB Type-C
	  connectors on a system.

if TYPEC_UCSI

config TYPEC_UCSI_ACPI
	tristate "UCSI ACPI Driver"
	depends on ACPI
	help
	  Driver for ACPI enumerated UCSI devices.

endif

endmenu
```

## drivers/usb/typec/altmodes/Kconfig
```kconfig
menu "USB Type-C Alternate Mode drivers"

config TYPEC_DUMMY_ALTMODE
	tristate "Dummy Alternate Mode driver"
	help
	  Driver for Dummy Alternate Mode.

endmenu
```

## drivers/usb/usbip/Kconfig
```kconfig
config USBIP_CORE
	tristate "USB/IP support"
	depends on USB && NET
	---help---
	  This enables pushing USB packets over IP to allow remote
	  machines direct access to USB devices. It provides the
	  USB/IP core that is required by both drivers.

	  For more details, and to get the userspace utility
	  programs, please see <http://usbip.sourceforge.net/>.

	  To compile this as a module, choose M here: the module will
	  be called usbip-core.

	  If unsure, say N.

config USBIP_UX
	tristate "USB/IP userspace URB transmission"
	depends on USBIP_CORE
	---help---
	  This moves USB/IP URB transmission to userspace
	  to apply SSL, WebSocket and etc.

	  To compile this driver as a module, choose M here: the
	  module will be called usbip-ux.

config USBIP_VHCI_HCD
	tristate "VHCI hcd"
	depends on USBIP_CORE
	---help---
	  This enables the USB/IP virtual host controller driver,
	  which is run on the remote machine.

	  To compile this driver as a module, choose M here: the
	  module will be called vhci-hcd.

config USBIP_HOST
	tristate "Host driver"
	depends on USBIP_CORE
	---help---
	  This enables the USB/IP host driver, which is run on the
	  machine that is sharing the USB devices.

	  To compile this driver as a module, choose M here: the
	  module will be called usbip-host.

config USBIP_DEBUG
	bool "Debug messages for USB/IP"
	depends on USBIP_CORE
	---help---
	  This enables the debug messages from the USB/IP drivers.
```

## drivers/usb/usbssp/Kconfig
```kconfig
config USB_USBSSP
	tristate "Cadence USBSSP DRD Controller"
	depends on (USB || USB_GADGET) && HAS_DMA
	select USB_USBSSP_GADGET
	help
	  Say Y here if your system has a cadence USBSSP dual-role controller.
	  It supports: dual-role switch Host-only, and Peripheral-only.

	  If you choose to build this driver is a dynamically linked
	  module, the module will be called usbssp.ko.

if USB_USBSSP

config USB_USBSSP_GADGET
	bool "Gadget only mode"
	depends on USB_GADGET=y || USB_GADGET=USB_USBSSP
	help
	  Select this when you want to use USBSSP in gadget mode only,

config USB_USBSSP_PCI
	tristate "PCIe-based Platforms"
	depends on USB_PCI && ACPI
	default USB_USBSSP
	help
	  If you're using the USBSSP Core IP with a PCIe, please say
	  'Y' or 'M' here.

endif
```

## drivers/vfio/ccw/Kconfig
```kconfig
config VFIO_CCW
	tristate "VFIO support for CCW devices"
	depends on VFIO_NOIOMMU && CCW
	help
	  VFIO support for CCW bus driver. Note that this is just
	  the base driver; you'll also need a userspace program
	  to provide a device configuration and channel programs.
```

## drivers/vfio/mdev/Kconfig
```kconfig
config VFIO_MDEV
    tristate "Mediated device driver framework"
    depends on VFIO
    default n
    help
        Provides a framework to virtualize device.
	See Documentation/vfio-mediated-device.txt for more details.

        If you don't know what do here, say N.
```

## drivers/vgpu/Kconfig
```kconfig
menuconfig VGPU
    tristate "VGPU driver framework"
    depends on VFIO
    select VGPU_VFIO
    help
        VGPU provides a framework to virtualize GPU without SR-IOV cap
        See Documentation/vgpu.txt for more details.

        If you don't know what do here, say N.

config VGPU
    tristate
    depends on VFIO
    default n

config VGPU_VFIO
    tristate
    depends on VGPU
    default n
```

## lib/Kconfig.kasan
```kconfig
config HAVE_ARCH_KASAN
	bool

config HAVE_ARCH_KASAN_HW
	bool

if HAVE_ARCH_KASAN

config KASAN
	bool "KASAN: runtime memory debugger"
	help
	  Enables KASAN (KernelAddressSANitizer) - runtime memory debugger,
	  designed to find out-of-bounds accesses and use-after-free bugs.

choice
	prompt "KASAN mode"
	depends on KASAN
	default KASAN_GENERIC
	help
	  KASAN has two modes: KASAN (a classic version, similar to userspace
	  ASan, enabled with CONFIG_KASAN_GENERIC) and KHWASAN (a version
	  based on pointer tagging, only for arm64, similar to userspace
	  HWASan, enabled with CONFIG_KASAN_HW).

config KASAN_GENERIC
	bool "KASAN: the generic mode"
	depends on (SLUB && SYSFS) || (SLAB && !DEBUG_SLAB)
	select SLUB_DEBUG if SLUB
	select CONSTRUCTORS
	select STACKDEPOT
	help
	  Enables the generic mode of KASAN.
	  This is strictly a debugging feature and it requires a GCC version
	  of 4.9.2 or later. Detection of out-of-bounds accesses to stack or
	  global variables requires GCC 5.0 or later.
	  This mode consumes about 1/8 of available memory at kernel start
	  and introduces an overhead of ~x1.5 for the rest of the allocations.
	  The performance slowdown is ~x3.
	  For better error detection enable CONFIG_STACKTRACE.
	  Currently CONFIG_KASAN_GENERIC doesn't work with CONFIG_DEBUG_SLAB
	  (the resulting kernel does not boot).

if HAVE_ARCH_KASAN_HW

config KASAN_HW
	bool "KHWASAN: the hardware assisted mode"
	depends on (SLUB && SYSFS) || (SLAB && !DEBUG_SLAB)
	select SLUB_DEBUG if SLUB
	select CONSTRUCTORS
	select STACKDEPOT
	help
	  Enabled KHWASAN (KASAN mode based on pointer tagging).
	  This mode requires Top Byte Ignore support by the CPU and therefore
	  only supported for arm64.
	  This feature requires clang revision 330044 or later.
	  This mode consumes about 1/16 of available memory at kernel start
	  and introduces an overhead of ~20% for the rest of the allocations.
	  For better error detection enable CONFIG_STACKTRACE.
	  Currently CONFIG_KASAN_HW doesn't work with CONFIG_DEBUG_SLAB
	  (the resulting kernel does not boot).

endif

endchoice

config KASAN_EXTRA
	bool "KASAN: extra checks"
	depends on KASAN_GENERIC && DEBUG_KERNEL && !COMPILE_TEST
	help
	  This enables further checks in KASAN, for now it only includes the
	  address-use-after-scope check that can lead to excessive kernel
	  stack usage, frame size warnings and longer compile time.
	  https://gcc.gnu.org/bugzilla/show_bug.cgi?id=81715 has more


choice
	prompt "Instrumentation type"
	depends on KASAN
	default KASAN_OUTLINE

config KASAN_OUTLINE
	bool "Outline instrumentation"
	help
	  Before every memory access compiler insert function call
	  __asan_load*/__asan_store*. These functions performs check
	  of shadow memory. This is slower than inline instrumentation,
	  however it doesn't bloat size of kernel's .text section so
	  much as inline does.

config KASAN_INLINE
	bool "Inline instrumentation"
	help
	  Compiler directly inserts code checking shadow memory before
	  memory accesses. This is faster than outline (in some workloads
	  it gives about x2 boost over outline instrumentation), but
	  make kernel's .text size much bigger.
	  For CONFIG_KASAN_GENERIC this requires GCC 5.0 or later.

endchoice

config TEST_KASAN
	tristate "Module for testing KASAN for bug detection"
	depends on m && KASAN
	help
	  This is a test module doing various nasty things like
	  out of bounds accesses, use after free. It is useful for testing
	  kernel debugging features like KASAN.

endif
```

## lib/zinc/Kconfig
```kconfig
config ZINC_CHACHA20
	tristate
	select CRYPTO_ALGAPI

config ZINC_POLY1305
	tristate

config ZINC_DEBUG
	bool "Zinc cryptography library debugging and self-tests"
	help
	  This builds a series of self-tests for the Zinc crypto library, which
	  help diagnose any cryptographic algorithm implementation issues that
	  might be at the root cause of potential bugs. It also adds various
	  debugging traps.

	  Unless you're developing and testing cryptographic routines, or are
	  especially paranoid about correctness on your hardware, you may say
	  N here.

config ZINC_ARCH_ARM
	def_bool y
	depends on ARM && !64BIT

config ZINC_ARCH_ARM64
	def_bool y
	depends on ARM64 && 64BIT

config ZINC_ARCH_X86_64
	def_bool y
	depends on X86_64 && 64BIT
	depends on !UML

config ZINC_ARCH_MIPS
	def_bool y
	depends on MIPS && CPU_MIPS32_R2 && !64BIT

config ZINC_ARCH_MIPS64
	def_bool y
	depends on MIPS && 64BIT
```

## net/bpfilter/Kconfig
```kconfig
menuconfig BPFILTER
	bool "BPF Filter Configuration"
	depends on NET && BPF

if BPFILTER

endif
```
