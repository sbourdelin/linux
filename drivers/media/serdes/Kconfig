## drivers/net/wireless/ath/ath10k/Kconfig
```kconfig
config ATH10K
        tristate "Atheros 802.11ac wireless cards support"
        depends on MAC80211 && HAS_DMA
	select ATH_COMMON
	select CRC32
	select WANT_DEV_COREDUMP
        ---help---
          This module adds support for wireless adapters based on
          Atheros IEEE 802.11ac family of chipsets.

          If you choose to build a module, it'll be called ath10k.

config ATH10K_PCI
	tristate "Atheros ath10k PCI support"
	depends on ATH10K && PCI
	---help---
	  This module adds support for PCIE bus

config ATH10K_AHB
	bool "Atheros ath10k AHB support"
	depends on ATH10K_PCI && OF && RESET_CONTROLLER
	---help---
	  This module adds support for AHB bus

config ATH10K_DEBUG
	bool "Atheros ath10k debugging"
	depends on ATH10K
	---help---
	  Enables debug support

	  If unsure, say Y to make it easier to debug problems.

config ATH10K_DEBUGFS
	bool "Atheros ath10k debugfs support"
	depends on ATH10K && DEBUG_FS
	select RELAY
	---help---
	  Enabled debugfs support

	  If unsure, say Y to make it easier to debug problems.

config ATH10K_TRACING
	bool "Atheros ath10k tracing support"
	depends on ATH10K
	depends on EVENT_TRACING
	---help---
	  Select this to ath10k use tracing infrastructure.

config ATH10K_DFS_CERTIFIED
	bool "Atheros DFS support for certified platforms"
	depends on ATH10K && CFG80211_CERTIFICATION_ONUS
	default n
	---help---
	This option enables DFS support for initiating radiation on
	ath10k.

config ATH10K_LICENSED_CHAN
	bool "Support channels in licensed bands"
	depends on ATH10K && CFG80211_CERTIFICATION_ONUS
	default n
	---help---
	  This option enables support for licensed channels on such as
          4.9 GHz (public safety).

	  These are PUBLIC SAFETY CHANNELS and MUST NOT BE USED in most
	  regulatory domains UNLESS YOU HAVE A FULL LICENSE for their use from
	  your local radio regulator, e.g. the FCC or equivalent. Using these
	  channels without proper authorisation may result in serious legal
	  consequences.

	  You will also have to build a regulatory database with these channels
	  enabled to actually use them.

	  If you are a distro kernel builder or have any doubt whatsoever about
	  your legal ability to use these channels, say N.
```

## drivers/net/wireless/quantenna/qtnfmac/Kconfig
```kconfig
config QTNFMAC
	tristate "Quantenna WiFi FullMAC WLAN driver"
	default n
	depends on CFG80211
	---help---
	  This option adds core support for wireless adapters based on
	  Quantenna 802.11n/ac chipsets. You still need separate
	  bus drivers for PCIe to be able to use real devices.

	  If you choose to build it as a module, it will be
	  called qtnfmac.ko.

config QTNFMAC_PEARL_PCIE
	tristate "PCIE bus interface support for Quantenna QSR10g FullMAC driver"
	default n
	depends on HAS_DMA && PCI
	depends on QTNFMAC
	select FW_LOADER
	select CRC32
	---help---
	  This option adds support for wireless adapters based on Quantenna
	  QSR10g FullMAC chipset running over PCIe. If you choose to build
	  it as a module, it will be called qtnfmac_pearl_pcie.ko.
```

## drivers/ntb/hw/idt/Kconfig
```kconfig
config NTB_IDT
	tristate "IDT PCIe-switch Non-Transparent Bridge support"
	depends on PCI
	help
	 This driver supports NTB of cappable IDT PCIe-switches.

	 If unsure, say N.

# BAR's early enable quirks
config NTB_IDT_QUIRKS
	bool "Enable PCI fixups built-in kernel for IDT PCIe-switch"
	depends on NTB_IDT
	default y if NTB_IDT=y
	select PCI_QUIRKS # NTB_IDT depends on PCI so it's ok to force quirks
	help
	 There are some configurations of IDT PCIe-switch which must be made
	 before the kernel PCI subsystem starts bus-devices scan and
	 initialization. For instance, the corresponding NT-function BARs must
	 be enabled. This option builds the fixups into the kernel to bypass
	 the basic IDT quirks.
```

## drivers/ntb/test/Kconfig
```kconfig
config NTB_PINGPONG
	tristate "NTB Ping Pong Test Client"
	help
	 This is a simple ping pong driver that exercises the scratchpads and
	 doorbells of the ntb hardware.  This driver may be used to test that
	 your ntb hardware and drivers are functioning at a basic level.

	 If unsure, say N.

config NTB_TOOL
	tristate "NTB Debugging Tool Test Client"
	help
	 This is a simple debugging driver that enables the doorbell and
	 scratchpad registers to be read and written from the debugfs.  This
	 enables more complicated debugging to be scripted from user space.
	 This driver may be used to test that your ntb hardware and drivers are
	 functioning at a basic level.

	 If unsure, say N.

config NTB_PERF
	tristate "NTB RAW Perf Measuring Tool"
	help
	 This is a tool to measure raw NTB performance by transferring data
	 to and from the window without additional software interaction.

	 If unsure, say N.

config NTB_DB_TEST
	tristate "NTB Doorbell Test Client"
	help
	 This is a driver to test doorbell subsystem of NTB bus devices.
	 The design is similar to the ping pong although it exchanges the
	 doorbell bits one-by-one, waiting for the peer response before getting
	 to a next doorbell.

	 If unsure, say N.

config NTB_MSG_TEST
	tristate "NTB Messaging Test Client"
	help
	 This is a driver to test messaging subsystem of NTB. It just creates
	 one file in the DebugFS for each NTB device of asynchronous
	 architecture. In order to send a message one can just write a text to
	 the file. It will be immediately sent to the peer so user can get it
	 by reading from the corresponding file.

	 If unsure, say N.

config NTB_MW_TEST
	tristate "NTB Memory Windows Test Client"
	help
	 This is a driver to test memory sharing amongst devices. It creates a
	 set of files in the DebugFS, one of which are used to write a text to
	 outbound memory windows and anothers can be used to read data written
	 by the peer to our inbound memory window.

	 If unsure, say N.
```

## drivers/of/overlay-manager/Kconfig
```kconfig
config OF_OVERLAY_MGR
	bool "Device Tree Overlay Manager"
	depends on OF_OVERLAY
	help
	  Enable the overlay manager to handle automatic overlay loading when
	  devices are detected.

if OF_OVERLAY_MGR

menu "Dips header formats"

config OF_OVERLAY_MGR_FORMAT_CHIP
	bool "Nextthing's C.H.I.P. dip header format"
	help
	  Enable Nextthing's C.H.I.P. dip header format support.

endmenu

menu "Overlay Manager detectors"

config OF_OVERLAY_MGR_DETECTOR_DS2431
	bool "Dip header on a DS2431 EEPROM"
	depends on W1_SLAVE_DS2431
	help
	  Enable dip header DS2431 EEPROM support.

endmenu

endif
```
