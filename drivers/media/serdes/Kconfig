## drivers/media/serdes/Kconfig
```kconfig
menu "Video serializers and deserializers"

config SERDES_DS90UB954
	tristate "TI DS90UB954-Q1 deserializer"
	help
	  Device driver for the Texas Instruments "DS90UB954-Q1 Dual
	  4.16 Gbps FPD-Link III Deserializer Hub With MIPI CSI-2
	  Outputs for 2MP/60fps Cameras and RADAR".

	  To compile this driver as a module, choose M here: the
	  module will be called ds90ub954.

endmenu
```

## drivers/media/spi/Kconfig
```kconfig
config VIDEO_GSXXXX
	tristate "Gennum Serializers video"
	depends on SPI
	---help---
	  Enable the GSXXXX driver which serializes video streams.
```

## drivers/media/usb/hdcapm/Kconfig
```kconfig
config VIDEO_HDCAPM
	tristate "Startech HDCAPM support"
	depends on VIDEO_DEV && VIDEO_V4L2
	select VIDEO_MST3367 if MEDIA_SUBDRV_AUTOSELECT
	select I2C_ALGOBIT
	help
	  This is a video4linux driver for Startech's HDCAPM USB device.

	  To compile this driver as a module, choose M here: the
	  module will be called hdpvr
```

## drivers/misc/amd-sp/Kconfig
```kconfig
config AMD_SP
	tristate "Support for AMD Secure Processor"
	default n
	depends on ((X86 && PCI) || (ARM64 && (OF_ADDRESS || ACPI))) && HAS_IOMEM
	help
	  Provides the interface to access the AMD Secure Processor. The
	  AMD Secure Processor supports the AMD Cryptographic Coprocessor.
	  If you choose 'M' here, this module will be call ccp.

config AMD_CCP
	bool "Support for AMD Cryptographic Coprocessor"
	depends on AMD_SP
	default y
	select HW_RANDOM
	select DMA_ENGINE
	select DMADEVICES
	select CRYPTO_SHA1
	select CRYPTO_SHA256
	help
	  Provides the interface to use the AMD Cryptographic Coprocessor
	  which can be used to offload encryption operations such as SHA,
	  AES and more.
```

## drivers/misc/sprd-wcn/Kconfig
```kconfig
config SPRD_WCN
	tristate "Support for Spreadtrum's WCN SoCs"
	depends on ARCH_SPRD
	default n
	help
	  This enables Spreadtrum's WCN (wireless connectivity network)
	  SoCs. In general, Spreadtrum's WCN SoCs consisted of some
	  modules, such as FM, bluetooth, wifi, GPS, etc.

if SPRD_WCN

source "drivers/misc/sprd-wcn/radio/Kconfig"

endif
```

## drivers/misc/sprd-wcn/radio/Kconfig
```kconfig
## Spreadtrum SC2332 FM drivers

config SPRD_RADIO_SC2332
	tristate "Support for the Spreadtrum Radio SC2332"
	default n
	---help---
	  Say Y to enable built-in FM radio controller for the
	  Spreadtrum SC2332 SoC.
```

## drivers/misc/vas/Kconfig
```kconfig
#
# IBM Virtual Accelarator Switchboard (VAS) compatible devices
#depends on PPC_POWERNV && PCI_MSI && EEH
#

config VAS
	tristate "Support for IBM Virtual Accelerator Switchboard (VAS)"
	default n
	help
	  Select this option to enable driver support for IBM Virtual
	  Accelerator Switchboard (VAS).
	  VAS allows accelerators in co processors like NX-842 to be
	  directly available to a user process.  This driver enables
	  userspace programs to access these accelerators via
	  /dev/vas/vas-nxM.N devices.

	  VAS adapters are found in POWER9 based systems.

	  If unsure, say N.
```

## drivers/mtd/parsers/Kconfig
```kconfig
config MTD_PARSER_TRX
	tristate "Parser for TRX format partitions"
	depends on MTD && (BCM47XX || ARCH_BCM_5301X)
	help
	  TRX is a firmware format used by Broadcom on their devices. It
	  may contain up to 3/4 partitions (depending on the version).
	  This driver will parse partitions marked as TRX ones and on
	  success it will at least two partitions: kernel and rootfs.
```

## drivers/net/dsa/microchip/Kconfig
```kconfig
menuconfig MICROCHIP_KSZ9477
	tristate "Microchip KSZ9477 series switch support"
	depends on NET_DSA
	select NET_DSA_TAG_KSZ
	help
	  This driver adds support for Microchip KSZ9477 switch chips.

config MICROCHIP_KSZ9477_SPI_DRIVER
	tristate "KSZ9477 series SPI connected switch driver"
	depends on MICROCHIP_KSZ9477 && SPI
	help
	  Select to enable support for registering switches configured through SPI.
```

## drivers/net/ethernet/aquantia/atlantic/Kconfig
```kconfig
#
# Aquantia device configuration
#

config AQTION
	tristate "Aquantia AQtion Support"
	depends on PCI
	---help---
	  This enables the support for the Aquantia AQtion Ethernet card.
```

## drivers/net/ethernet/cavium/Kconfig
```kconfig
#
# Cavium ethernet device configuration
#

config NET_VENDOR_CAVIUM
	bool "Cavium ethernet drivers"
	depends on PCI || CAVIUM_OCTEON_SOC
	default y
	---help---
	  Select this option if you want enable Cavium network support.

	  If you have a Cavium SoC or network adapter, say Y.

if NET_VENDOR_CAVIUM

#
# The Thunder* and LiquidIO drivers require PCI.
#

if PCI

config THUNDER_NIC_PF
	tristate "Thunder Physical function driver"
	depends on 64BIT
	select THUNDER_NIC_BGX
	---help---
	  This driver supports Thunder's NIC physical function.
	  The NIC provides the controller and DMA engines to
	  move network traffic to/from the memory. The NIC
	  works closely with TNS, BGX and SerDes to implement the
	  functions replacing and virtualizing those of a typical
	  standalone PCIe NIC chip.

config THUNDER_NIC_VF
	tristate "Thunder Virtual function driver"
	depends on 64BIT
	---help---
	  This driver supports Thunder's NIC virtual function

config	THUNDER_NIC_BGX
	tristate "Thunder MAC interface driver (BGX)"
	depends on 64BIT
	select PHYLIB
	select MDIO_THUNDER
	select THUNDER_NIC_RGX
	---help---
	  This driver supports programming and controlling of MAC
	  interface from NIC physical function driver.

config	THUNDER_NIC_RGX
	tristate "Thunder MAC interface driver (RGX)"
	depends on 64BIT
	select PHYLIB
	select MDIO_THUNDER
	---help---
	  This driver supports configuring XCV block of RGX interface
	  present on CN81XX chip.

config LIQUIDIO
	tristate "Cavium LiquidIO support"
	depends on 64BIT
	imply PTP_1588_CLOCK
	select FW_LOADER
	select LIBCRC32C
	---help---
	  This driver supports Cavium LiquidIO Intelligent Server Adapters
	  based on CN66XX, CN68XX and CN23XX chips.

	  To compile this driver as a module, choose M here: the module
	  will be called liquidio.  This is recommended.

config LIQUIDIO_VF
	tristate "Cavium LiquidIO VF support"
	depends on 64BIT && PCI_MSI
	imply PTP_1588_CLOCK
	---help---
	  This driver supports Cavium LiquidIO Intelligent Server Adapter
	  based on CN23XX chips.

	  To compile this driver as a module, choose M here: The module
	  will be called liquidio_vf. MSI-X interrupt support is required
	  for this driver to work correctly

endif # PCI

config OCTEON_MGMT_ETHERNET
	tristate "Octeon Management port ethernet driver (CN5XXX, CN6XXX)"
	depends on CAVIUM_OCTEON_SOC
	select PHYLIB
	select MDIO_OCTEON
	default y
	help
	  Enable the ethernet driver for the management
	  port on Cavium Networks' Octeon CN57XX, CN56XX, CN55XX,
	  CN54XX, CN52XX, and CN6XXX chips.

config OCTEON3_BGX_NEXUS
	tristate
	depends on CAVIUM_OCTEON_SOC

config OCTEON3_BGX_PORT
	tristate "Cavium OCTEON-III BGX port support"
	depends on CAVIUM_OCTEON_SOC
	select OCTEON3_BGX_NEXUS
	---help---
	  Enable the driver for Cavium Octeon III BGX ports. BGX ports
	  support sgmii, rgmii, xaui, rxaui, xlaui, xfi, 10KR and 40KR modes.

	  Say Y for support of any Octeon III SoC Ethernet port.

config OCTEON3_ETHERNET
	tristate "Cavium OCTEON-III PKI/PKO Ethernet support"
	depends on CAVIUM_OCTEON_SOC
	select OCTEON_BGX_PORT
	select OCTEON_FPA3
	select FW_LOADER
	---help---
	  Enable the driver for Cavium Octeon III Ethernet via PKI/PKO
	  units.  No support for cn70xx chips (use OCTEON_ETHERNET for
	  cn70xx).

	  Say Y for support of any Octeon III SoC Ethernet port.

endif # NET_VENDOR_CAVIUM
```

## drivers/net/ethernet/freescale/dpaa/Kconfig
```kconfig
menuconfig FSL_DPAA_ETH
	tristate "DPAA Ethernet"
	depends on FSL_DPAA && FSL_FMAN
	select PHYLIB
	select FSL_FMAN_MAC
	---help---
	  Data Path Acceleration Architecture Ethernet driver,
	  supporting the Freescale QorIQ chips.
	  Depends on Freescale Buffer Manager and Queue Manager
	  driver and Frame Manager Driver.

if FSL_DPAA_ETH
config FSL_DPAA_ETH_TS
	bool "DPAA hardware timestamping support"
	select PTP_1588_CLOCK_QORIQ
	default n
	help
	  Enable DPAA hardware timestamping support.
	  This option is useful for applications to get
	  hardware time stamps on the Ethernet packets
	  using the SO_TIMESTAMPING API.
endif
```

## drivers/net/ethernet/freescale/dpaa2/Kconfig
```kconfig
config FSL_DPAA2_ETH
	tristate "Freescale DPAA2 Ethernet"
	depends on FSL_MC_BUS && FSL_MC_DPIO
	depends on NETDEVICES && ETHERNET
	help
	  Ethernet driver for Freescale DPAA2 SoCs, using the
	  Freescale MC bus driver

config FSL_DPAA2_PTP_CLOCK
	tristate "Freescale DPAA2 PTP Clock"
	depends on FSL_DPAA2_ETH && POSIX_TIMERS
	select PTP_1588_CLOCK
	help
	  This driver adds support for using the DPAA2 1588 timer module
	  as a PTP clock.
```

## drivers/net/ethernet/mediatek/Kconfig
```kconfig
config NET_VENDOR_MEDIATEK
	bool "MediaTek ethernet driver"
	depends on ARCH_MEDIATEK
	---help---
	  If you have a Mediatek SoC with ethernet, say Y.

if NET_VENDOR_MEDIATEK

config NET_MEDIATEK_SOC
	tristate "MediaTek SoC Gigabit Ethernet support"
	depends on NET_VENDOR_MEDIATEK
	select PHYLIB
	---help---
	  This driver supports the gigabit ethernet MACs in the
	  MediaTek SoC family.

config MTK_GMAC
	tristate "MediaTek Gigabit AVB Ethernet support"
	select PHYLIB
	select PTP_1588_CLOCK
	select VLAN_8021Q
	---help---
	  This driver supports the gigabit avb ethernet MACs in the
	  MediaTek MT27xx SoC family.

if MTK_GMAC
config MT2712_GMAC
	tristate "MT2712 Gigabit Ethernet support"
	---help---
	  This driver supports the gigabit avb ethernet MACs in the
	  MediaTek MT2712 SoC.
endif #MTK_GMAC
endif #NET_VENDOR_MEDIATEK
```

## drivers/net/ethernet/microchip/Kconfig
```kconfig
#
# Microchip network device configuration
#

config NET_VENDOR_MICROCHIP
	bool "Microchip devices"
	default y
	---help---
	  If you have a network (Ethernet) card belonging to this class, say Y.

	  Note that the answer to this question doesn't directly affect the
	  kernel: saying N will just cause the configurator to skip all
	  the questions about Microchip cards. If you say Y, you will be asked
	  for your specific card in the following questions.

if NET_VENDOR_MICROCHIP

config ENC28J60
	tristate "ENC28J60 support"
	depends on SPI
	select CRC32
	---help---
	  Support for the Microchip EN28J60 ethernet chip.

	  To compile this driver as a module, choose M here. The module will be
	  called enc28j60.

config ENC28J60_WRITEVERIFY
	bool "Enable write verify"
	depends on SPI
	depends on ENC28J60
	---help---
	  Enable the verify after the buffer write useful for debugging purpose.
	  If unsure, say N.

config ENCX24J600
    tristate "ENCX24J600 support"
    depends on SPI
    ---help---
      Support for the Microchip ENC424J600/624J600 ethernet chip.

      To compile this driver as a module, choose M here. The module will be
      called encx24j600.

config MCHP9352
	tristate "LAN9352 embedded ethernet support"
	depends on HAS_IOMEM
	select CRC32
	select MII
	select PHYLIB
	---help---
	  The LAN9352 is a 2-Port 10/100 Managed Ethernet Switch with
	  16-Bit Non-PCI CPU Interface. The CPU interface includes a basic
	  ethernet controller interface whose virtual phy is connected
	  internally to a 3rd port on the embedded switch.

	  This driver only operates as a simple ethernet controller
	  on the CPU interface. Since this interface is connected directly
	  to the embedded switch, the result is that traffic can be sent and
	  received on both physical ports.

	  No managed switch features are yet supported by this driver.
	  1588 features are not yet supported by this driver.

	  May support LAN9250, LAN9311, and LAN9312, but these products
	  were not tested.

	  Say Y here if you want support for MICROCHIP LAN9352 as a simple
	  ethernet controller.

	  To compile this driver as a module, choose M here. The module
	  will be called mchp9352.


endif # NET_VENDOR_MICROCHIP
```

## drivers/net/ethernet/qualcomm/rmnet/Kconfig
```kconfig
#
# RMNET MAP driver
#

menuconfig RMNET
	depends on NETDEVICES
	bool "RmNet MAP driver"
	default n
	---help---
	  If you say Y here, then the rmnet module will be statically
	  compiled into the kernel. The rmnet module provides MAP
	  functionality for embedded and bridged traffic.
```

## drivers/net/ethernet/ralink/Kconfig
```kconfig
config NET_RALINK
	tristate "Ralink ethernet driver"
	depends on RALINK
	help
	  This driver supports the ethernet mac inside the ralink wisocs

if NET_RALINK
choice
	prompt "MAC type"

config NET_RALINK_RT2880
	bool "RT2882"
	depends on SOC_RT288X

config NET_RALINK_RT3050
	bool "RT3050/MT7628"
	depends on (SOC_RT305X || SOC_MT7620)

config NET_RALINK_RT3883
	bool "RT3883"
	depends on SOC_RT3883

config NET_RALINK_MT7620
	bool "MT7620"
	depends on (SOC_MT7620 || SOC_MT7621)

endchoice

config NET_RALINK_MDIO
	def_bool NET_RALINK
	depends on (NET_RALINK_RT2880 || NET_RALINK_RT3883 || NET_RALINK_MT7620 || NET_RALINK_MT7621)
	select PHYLIB

config NET_RALINK_MDIO_RT2880
	def_bool NET_RALINK
	depends on (NET_RALINK_RT2880 || NET_RALINK_RT3883)
	select NET_RALINK_MDIO

config NET_RALINK_ESW_RT3050
	def_bool NET_RALINK
	depends on NET_RALINK_RT3050
	select PHYLIB

config NET_RALINK_GSW_MT7620
	def_bool NET_RALINK
	depends on NET_RALINK_MT7620 || NET_RALINK_MT7621
	select NET_RALINK_MDIO
	select PHYLIB
endif
```

## drivers/net/ethernet/socionext/Kconfig
```kconfig
#
# Socionext Network device configuration
#

config NET_VENDOR_SNI
	bool "Socionext devices"
	default y
	---help---
	  If you have a network (Ethernet) card belonging to this class, say Y.

	  Note that the answer to this question doesn't directly affect the
	  the questions about Socionext cards. If you say Y, you will be asked for
	  your specific card in the following questions.

if NET_VENDOR_SNI

config SNI_NETSEC
	tristate "NETSEC Driver Support"
	depends on OF
	select PHYLIB
	select MII
help
	  Enable for NETSEC support of Socionext FGAMC4 IP
	  Provides Gigabit ethernet support

	  To compile this driver as a module, choose M here: the module will be
	  called netsec.  If unsure, say N.

endif # NET_VENDOR_SNI
```

## drivers/net/ethernet/synopsys/dwc/Kconfig
```kconfig
#
# Synopsys DWC ethernet drivers configuration
#

config DWC_ETH
	bool
	depends on HAS_IOMEM && HAS_DMA
	select BITREVERSE
        select CRC32
        select PTP_1588_CLOCK
        select PHYLIB

config DWC_XLGMAC_PCI
	tristate "Synopsys DWC Enterprise Ethernet (XLGMAC) driver PCI support"
        depends on HAS_IOMEM && HAS_DMA
	depends on PCI
        select BITREVERSE
        select CRC32
        select PTP_1588_CLOCK
        select PHYLIB
	select DWC_ETH
	---help---
	  This driver supports the Synopsys DWC Enterprise Ethernet (XLGMAC)
	  for PCI platform

	  To compile this driver as a module, choose M here: the module
	  will be called snps-dwc-xlgmac.

config DWC_ETH_DCB
	bool "Data Center Bridging (DCB) support"
	default n
	depends on DWC_ETH && DCB
	---help---
	  Say Y here to enable Data Center Bridging (DCB) support in the
	  driver.

	  If unsure, say N.
```
