## drivers/gpu/drm/i2c/adv7511/Kconfig
```kconfig
config DRM_I2C_ADV7511
	tristate "AV7511 encoder"
	select REGMAP_I2C
	help
	  Support for the Analog Device ADV7511(W) and ADV7513 HDMI encoders.

config DRM_I2C_ADV7511_AUDIO
	bool "ADV7511 audio"
	depends on DRM_I2C_ADV7511
	depends on SND_SOC=y || (SND_SOC && DRM_I2C_ADV7511=m)
	default y
	help
	  This adds support for audio on the ADV7511(W) and ADV7513 HDMI
	  encoders.

	  By selecting this option the ADV7511 will register a codec interface
	  into ALSA.
```

## drivers/gpu/drm/nouveau/Kconfig
```kconfig
config DRM_NOUVEAU
	tristate "Nouveau (NVIDIA) cards"
	depends on DRM && PCI && MMU
	depends on ACPI_VIDEO || !(ACPI && X86)
        select FW_LOADER
	select DRM_KMS_HELPER
	select DRM_TTM
	select FB_BACKLIGHT if DRM_NOUVEAU_BACKLIGHT && FB
	select X86_PLATFORM_DEVICES if ACPI && X86
	select ACPI_WMI if ACPI && X86
	select MXM_WMI if ACPI && X86
	select POWER_SUPPLY
	select DRM_VM
	help
	  Choose this option for open-source NVIDIA support.

config NOUVEAU_PLATFORM_DRIVER
	bool "Nouveau (NVIDIA) SoC GPUs"
	depends on DRM_NOUVEAU && ARCH_TEGRA
	default y
	help
	  Support for Nouveau platform driver, used for SoC GPUs as found
	  on NVIDIA Tegra K1.

config NOUVEAU_DEBUG
	int "Maximum debug level"
	depends on DRM_NOUVEAU
	range 0 7
	default 5
	help
	  Selects the maximum debug level to compile support for.

	  0 - fatal
	  1 - error
	  2 - warning
	  3 - info
	  4 - debug
	  5 - trace (recommended)
	  6 - paranoia
	  7 - spam

	  The paranoia and spam levels will add a lot of extra checks which
	  may potentially slow down driver operation.

config NOUVEAU_DEBUG_DEFAULT
	int "Default debug level"
	depends on DRM_NOUVEAU
	range 0 7
	default 3
	help
	  Selects the default debug level

config DRM_NOUVEAU_BACKLIGHT
	bool "Support for backlight control"
	depends on DRM_NOUVEAU
	default y
	help
	  Say Y here if you want to control the backlight of your display
	  (e.g. a laptop panel).
```

## drivers/gpu/drm/sun4i/Kconfig
```kconfig
config DRM_SUN4I
	tristate "DRM Support for Allwinner A10 Display Engine"
	depends on DRM && ARM && COMMON_CLK
	depends on ARCH_SUNXI || COMPILE_TEST
	select DRM_GEM_CMA_HELPER
	select DRM_KMS_HELPER
	select DRM_KMS_CMA_HELPER
	select DRM_PANEL
	select REGMAP_MMIO
	select VIDEOMODE_HELPERS
	help
	  Choose this option if you have an Allwinner SoC with a
	  Display Engine. If M is selected the module will be called
	  sun4i-drm.

config DRM_SUN4I_DE2
	bool "Support Display Engine 2.0"
	depends on DRM_SUN4I
	default MACH_SUN8I
	select SUN8I_DE2_CCU
	help
	  Choose this option if you have an Allwinner SoC with a
	  "Display Engine 2.0".
```

## drivers/gpu/drm/xlnx/Kconfig
```kconfig
config DRM_XLNX
	tristate "Xilinx DRM KMS Driver"
	depends on DRM && OF
	select DRM_KMS_HELPER
	select DRM_KMS_CMA_HELPER
	select DRM_GEM_CMA_HELPER
	help
	  Xilinx DRM KMS driver. Choose this option if you have
	  a Xilinx SoCs with hardened display pipeline or soft
	  display pipeline using Xilinx IPs in FPGA. This module
	  provides the kernel mode setting functionalities
	  for Xilinx display drivers.

config DRM_ZYNQMP_DPSUB
	tristate "ZynqMP DP Subsystem Driver"
	depends on ARCH_ZYNQMP && OF && DRM_XLNX && COMMON_CLK
	select DMA_ENGINE
	select GENERIC_PHY
	help
	  DRM KMS driver for ZynqMP DP Subsystem controller. Choose
	  this option if you have a Xilinx ZynqMP SoC with DisplayPort
	  subsystem. The driver provides the kernel mode setting
	  functionlaities for ZynqMP DP subsystem.

config DRM_ZYNQMP_DISP_DEBUG_FS
	bool "ZynqMP Display debugfs"
	depends on DEBUG_FS && DRM_ZYNQMP_DPSUB
	select DRM_ZYNQMP_DP_DEBUG_FS
	help
	  Enable the debugfs code for DP Sub driver. The debugfs code
	  enables debugging or testing related features. It exposes some
	  low level controls to the user space to help testing automation,
	  as well as can enable additional diagnostic or statistical
	  information.

config DRM_ZYNQMP_DP_DEBUG_FS
	bool "ZynqMP DP debugfs"
	depends on DEBUG_FS && DRM_ZYNQMP_DPSUB
	help
	  Enable the debugfs code for DP driver. The debugfs code
	  enables debugging or testing related features. It exposes some
	  low level controls to the user space to help testing automation,
	  as well as can enable additional diagnostic or statistical
	  information.
```

## drivers/hid/intel-ish-hid/Kconfig
```kconfig
menu "Intel ISH HID support"
	depends on X86 && PCI

config INTEL_ISH_HID_TRANSPORT
	bool
	default n

config INTEL_ISH_HID_IPC
	bool
	default n

config INTEL_ISH_HID
	bool "Intel Integrated Sensor Hub"
	default n
	select INTEL_ISH_HID_TRANSPORT
	select INTEL_ISH_HID_IPC
	help
	  The Integrated Sensor Hub (ISH) enables the ability to offload
	  sensor polling and algorithm processing to a dedicated low power
	  processor in the chipset. This allows the core processor to go into
	  low power modes more often, resulting in the increased battery life.
	  The current processors that support ISH are: Cherrytrail, Skylake,
	  Broxton and Kaby Lake.

	  Say Y here if you want to support Intel ISH. If unsure, say N.

endmenu
```

## drivers/hwmon/occ/Kconfig
```kconfig
#
# On Chip Controller configuration
#

menuconfig SENSORS_IBM_OCC
	bool "IBM On-Chip Controller"
	help
	  If you say yes here you get support to monitor IBM Power CPU
	  sensors via the On-Chip Controller (OCC), from a service
	  processor.

	  Generally this is used by management controllers such as a BMC
	  on an OpenPower system.

if SENSORS_IBM_OCC

config SENSORS_IBM_OCC_P8_I2C
	tristate "POWER8 OCC hwmon support"
	depends on I2C
	help
	  Provide a hwmon sysfs interface for the POWER8 On-Chip Controller,
	  exposing temperature, frequency and power measurements. This
	  interface runs on the service processor, not the POWER CPU.

	  This driver can also be built as a module. If so, the module will be
	  called hwmon_occ_p8.

endif
```

## drivers/i3c/Kconfig
```kconfig
menu "I3C support"

config I3C
	tristate "I3C support"
	---help---
	  I3C (pronounce: I-cube-C) is a serial protocol standardized by the
	  MIPI alliance.

	  It's supposed to be backward compatible with I2C while providing
	  support for high speed transfers and native interrupt support
	  without the need for extra pins.

	  The I3C protocol also standardizes the slave device types and is
	  mainly design to communicate with sensors.

	  If you want I3C support, you should say Y here and also to the
	  specific driver for your bus adapter(s) below.

	  This I3C support can also be built as a module.  If so, the module
	  will be called i3c.

source "drivers/i3c/master/Kconfig"

endmenu
```

## drivers/i3c/master/Kconfig
```kconfig
config CDNS_I3C_MASTER
	tristate "Cadence I3C master driver"
	depends on I3C
	depends on ARM || ARM64 || XTENSA
	help
	  Enable this driver if you want to support Cadence I3C master block.
```

## drivers/iio/chemical/bme680/Kconfig
```kconfig
#
# Bosch BME680 Driver
#

config BME680
	tristate "Bosch Sensortec BME680 sensor driver"
	depends on (I2C || SPI)
	select REGMAP
	select BME680_I2C if (I2C)
	select BME680_SPI if (SPI)
	help
	  Say yes here to build support for Bosch Sensortec BME680 sensor with
	  temperature, pressure, humidity and gas sensing capability.

	  This driver can also be built as a module. If so, the module for I2C
	  would be called bme680_i2c and bme680_spi for SPI support.

config BME680_I2C
	tristate
	depends on BME680
	depends on I2C
	select REGMAP_I2C

config BME680_SPI
	tristate
	depends on BME680
	depends on SPI
	select REGMAP_SPI
```

## drivers/iio/counter/Kconfig
```kconfig
#
# Counter devices
#
# When adding new entries keep the list in alphabetical order

menu "Counters"

config 104_QUAD_8
	tristate "ACCES 104-QUAD-8 driver"
	depends on X86 && ISA_BUS_API
	help
	  Say yes here to build support for the ACCES 104-QUAD-8 quadrature
	  encoder counter/interface device family (104-QUAD-8, 104-QUAD-4).

	  Performing a write to a counter's IIO_CHAN_INFO_RAW sets the counter and
	  also clears the counter's respective clearable flags (BORROW, CARRY,
	  COMPARE, SIGN, and ERROR). Interrupts are not supported by this driver.

	  The base port addresses for the devices may be configured via the base
	  array module parameter.

endmenu
```

## drivers/iio/misc/Kconfig
```kconfig
#
# Miscellaneous iio drivers
#
# When adding new entries keep the list in alphabetical order

menu "Miscellaneous iio drivers"

config GPIO_POWER_SWITCH
	tristate "GPIO power switch driver"
	depends on GPIOLIB
	help
	  Say yes here to build support for gpio power switches.

	  To compile this driver as a module, choose M here: the module will
	  be called gpio-power-switch.

endmenu
```

## drivers/iio/multiplexer/Kconfig
```kconfig
#
# Multiplexer drivers
#
# When adding new entries keep the list in alphabetical order

menu "Multiplexers"

config IIO_MUX
	tristate "IIO multiplexer driver"
	depends on OF && MUX_GPIO
	help
	  Say yes here to build support for the IIO multiplexer.

	  To compile this driver as a module, choose M here: the
	  module will be called iio-mux.

endmenu
```

## drivers/iio/timer/Kconfig
```kconfig
#
# Timers drivers

menu "Timers"

config IIO_STM32_TIMER_TRIGGER
	tristate "STM32 Timer Trigger"
	depends on (ARCH_STM32 && OF && MFD_STM32_TIMERS) || COMPILE_TEST
	select IIO_TRIGGERED_EVENT
	help
	  Select this option to enable STM32 Timer Trigger

endmenu
```

## drivers/infiniband/sw/rdmavt/Kconfig
```kconfig
config INFINIBAND_RDMAVT
	tristate "RDMA verbs transport library"
	depends on 64BIT
	default n
	---help---
	This is a common software verbs provider for RDMA networks.
```

## drivers/input/touchscreen/goodix-ts-sunrise/Kconfig
```kconfig
#
# Goodix touchscreen driver configuration
#
menuconfig TOUCHSCREEN_GOODIX_GTX5
	tristate "Goodix GTx5 touchscreen"
	depends on I2C && OF
	depends on GPIOLIB
	help
	  Say Y here if you have a Goodix GTx5xx touchscreen connected
	  to your system.

	  If unsure, say N.

if TOUCHSCREEN_GOODIX_GTX5

config TOUCHSCREEN_GOODIX_GTX5_UPDATE
	tristate "Goodix GTx5xx firmware update module"
	help
	  Say Y here to enable support for doing firmware update.

	  If unsure, say N.

	  If you want support firmware update function say yes,
	  this module will create some sysfs node for firmware
	  update.

config TOUCHSCREEN_GOODIX_GTX5_TOOLS
	tristate "Goodix touch tools support"
	help
	  Say Y here to enable debug tools.

	  If unsure, say N.

	  Say yes here if you want to support controller debug
	  and any other extended functionality. In most condition
	  you may not need this feature.

endif
```

## drivers/jtag/Kconfig
```kconfig
menuconfig JTAG
	tristate "JTAG support"
	---help---
	  This provides basic core functionality support for jtag class devices
	  Hardware equipped with JTAG microcontroller which can be built
	  on top of this drivers. Driver exposes the set of IOCTL to the
	  user space for:
	  SIR (Scan Instruction Register, IEEE 1149.1 Data Register scan);
	  SDR (Scan Data Register, IEEE 1149.1 Instruction Register scan);
	  RUNTEST (Forces IEEE 1149.1 bus to a run state for specified
	  number of clocks).

	  If you want this support, you should say Y here.

	  To compile this driver as a module, choose M here: the module will
	  be called jtag.
```

## drivers/media/i2c/max2175/Kconfig
```kconfig
config SDR_MAX2175
	tristate "Maxim 2175 RF to Bits tuner"
	depends on VIDEO_V4L2 && MEDIA_SDR_SUPPORT && I2C
	---help---
	  Support for Maxim 2175 tuner

	  To compile this driver as a module, choose M here; the
	  module will be called max2175.
```

## drivers/media/pci/go2001/Kconfig
```kconfig
config VIDEO_GO2001
	tristate "GO2001 codec driver"
	depends on VIDEO_V4L2 && PCI
	select VIDEOBUF2_DMA_SG
	---help---
	  This driver supports the GO2001 PCI hardware codec. This codec
	  is present on ChromeOS based devices like the Acer ChromeBox
	  and ChromeBase 24 and LG ChromeBase as well.

	  To compile this driver as a module, choose M here: the
	  module will be called go2001.
```

## drivers/media/platform/cadence/Kconfig
```kconfig
config VIDEO_CADENCE
	bool "Cadence Video Devices"

if VIDEO_CADENCE

config VIDEO_CADENCE_CSI2RX
	tristate "Cadence MIPI-CSI2 RX Controller v1.3"
	depends on MEDIA_CONTROLLER
	depends on VIDEO_V4L2_SUBDEV_API
	select V4L2_FWNODE

endif
```

## drivers/media/platform/dwc/Kconfig
```kconfig
#
#  Synopsys DWC Platform drivers
#	Most drivers here are currently for MIPI CSI-2 and MIPI DPHY support

config DWC_MIPI_CSI2_HOST
	bool "Synopsys Designware CSI-2 Host Controller and DPHY-RX support"
	select VIDEO_DEV
	select VIDEO_V4L2
	select VIDEO_V4L2_SUBDEV_API
	select V4L2_FWNODE
	help
	 This selects the CSI-2 host controller support.

	 If you have a controller with this interface, say Y.

	  If unsure, say N.

if DWC_MIPI_CSI2_HOST

config DWC_MIPI_CSI2_HOST_PLATFORM
	tristate "Platform bus based CSI-2 Host Controller support"
	depends on HAS_DMA
	help
	 This selects the CSI-2 host controller support. Select this if
	 you have an CSI-2 Host controller on Platform bus.

	 If you have a controller with this interface, say Y or M here.

	  If unsure, say N.

endif # DWC_MIPI_CSI2_HOST

config DWC_MIPI_DPHY_GEN3
	tristate "DesignWare platform support using a Gen3 D-PHY"
	depends on DWC_MIPI_CSI2_HOST
	select GENERIC_PHY
	help
	 Synopsys MIPI D-PHY Generation 3 reference driver.

	  If unsure, say N.

if DWC_MIPI_DPHY_GEN3

config DWC_MIPI_TC_DPHY_GEN3
	bool "Platform support using a Synopsys Test Chip"
	help
	 Synopsys Test Chip is for prototyping purposes.

	  If unsure, say N.

endif # DWC_MIPI_DPHY_GEN3
```

## drivers/media/platform/imx/Kconfig
```kconfig
config MEDIA_IMX
	tristate "Multimedia Support for Freescale i.MX"
	depends on MEDIA_CONTROLLER
	default y if IMX_IPUV3_CORE
	---help---
	  This driver provides a SoC wide media controller device that all
	  multimedia components in i.MX5 and i.MX6 SoCs can register with.

config MEDIA_IMX_MIPI_CSI2
	tristate "i.MX MIPI CSI-2 Host Controller"
	depends on VIDEO_V4L2_SUBDEV_API
	help
	  This driver provides support for the MIPI CSI-2 Host Controller that
	  is connected to the IPU CSI input multiplexers on i.MX6 SoCs.

config VIDEO_IMX_IPU_COMMON
	tristate

config VIDEO_IMX_IPU_CAPTURE
	tristate "i.MX5/6 Video Capture driver"
	depends on IMX_IPUV3_CORE && VIDEO_V4L2_SUBDEV_API && MEDIA_IMX
	select VIDEOBUF2_DMA_CONTIG
	select VIDEO_IMX_IPU_COMMON
	select VIDEO_IMX_IPUV3
	help
	  This is a v4l2 video capture driver for the IPUv3 on i.MX5/6.

config VIDEO_IMX_IPU_CSI
	tristate "i.MX5/6 CMOS Sensor Interface driver"
	depends on VIDEO_DEV && IMX_IPUV3_CORE && MEDIA_IMX
	select VIDEO_IMX_IPUV3
	---help---
	  This is a v4l2 subdevice driver for two CSI modules in each IPUv3.
```

## drivers/media/platform/rcar-vin/Kconfig
```kconfig
config VIDEO_RCAR_VIN
	tristate "R-Car Video Input (VIN) support"
	depends on VIDEO_V4L2 && VIDEO_V4L2_SUBDEV_API && OF && HAS_DMA
	depends on ARCH_RENESAS || COMPILE_TEST
	select VIDEOBUF2_DMA_CONTIG
	---help---
	  This is a v4l2 driver for the R-Car VIN Interface
```

## drivers/media/platform/sunxi-csi/Kconfig
```kconfig
config VIDEO_SUNXI_CSI
	tristate "Allwinner Camera Sensor Interface driver"
	depends on VIDEO_V4L2 && COMMON_CLK && VIDEO_V4L2_SUBDEV_API && HAS_DMA
	depends on ARCH_SUNXI
	select VIDEOBUF2_DMA_CONTIG
	select REGMAP_MMIO
	---help---
	   Support for the Allwinner Camera Sensor Interface Controller.
```
