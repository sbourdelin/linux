## drivers/media/platform/vivid/Kconfig
```kconfig
config VIDEO_VIVID
	tristate "Virtual Video Test Driver"
	depends on VIDEO_DEV && VIDEO_V4L2 && !SPARC32 && !SPARC64 && FB
	select FONT_SUPPORT
	select FONT_8x16
	select FB_CFB_FILLRECT
	select FB_CFB_COPYAREA
	select FB_CFB_IMAGEBLIT
	select VIDEO_VIVID_MEM_VMALLOC if !VIDEO_VIVID_MEM_DMA_CONTIG
	default n
	---help---
	  Enables a virtual video driver. This driver emulates a webcam,
	  TV, S-Video and HDMI capture hardware, including VBI support for
	  the SDTV inputs. Also video output, VBI output, radio receivers,
	  transmitters and software defined radio capture is emulated.

	  It is highly configurable and is ideal for testing applications.
	  Error injection is supported to test rare errors that are hard
	  to reproduce in real hardware.

	  Say Y here if you want to test video apps or debug V4L devices.
	  When in doubt, say N.

config VIDEO_VIVID_MAX_DEVS
	int "Maximum number of devices"
	depends on VIDEO_VIVID
	default "64"
	---help---
	  This allows you to specify the maximum number of devices supported
	  by the vivid driver.

config VIDEO_VIVID_MEM_DMA_CONTIG
	bool "Enable DMA-CONTIG Memory Type"
	depends on VIDEO_VIVID
	select VIDEOBUF2_DMA_CONTIG
	default n
	---help---
	  Enable support for the DMA-CONTIG videobuf2 memory allocator. Say Y
	  here if you want to test buffer sharing with devices that require
	  contiguous memory buffers. When in doubt, say N.

config VIDEO_VIVID_MEM_VMALLOC
	bool "Enable VMALLOC Memory Type"
	depends on VIDEO_VIVID
	select VIDEOBUF2_VMALLOC
	default y
	---help---
	  Enable support for the VMALLOC videobuf2 memory allocator. This is the
	  default memory allocator for the vivid driver. When in doubt, say Y.
```
