/*
 * Copyright (C) 2016 Savoir-Faire Linux
 * Author: Sebastien Bourdelin <sebastien.bourdelin@savoirfairelinux.com>
 *
 * The code contained herein is licensed under the GNU General Public
 * License. You may obtain a copy of the GNU General Public License
 * Version 2 or later at the following locations:
 *
 * http://www.opensource.org/licenses/gpl-license.html
 * http://www.gnu.org/copyleft/gpl.html
 */

#include "imx28-ts4600-common.dtsi"

/ {
	model = "Technologic Systems i.MX28 TS-4600 Rev A";

	memory {
		reg = <0x40000000 0x08000000>;   /* 128MB */
	};

};
