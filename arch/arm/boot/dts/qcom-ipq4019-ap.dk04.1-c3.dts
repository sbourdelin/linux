// SPDX-License-Identifier: GPL-2.0
// Copyright (c) 2017, The Linux Foundation. All rights reserved.

#include "qcom-ipq4019-ap.dk04.1.dtsi"

/ {
	model = "Qualcomm Technologies, Inc. IPQ4019/AP-DK04.1-C3";

	soc {
		nand: qpic-nand@79b0000 {
			status = "disabled";
		};
	};
};
