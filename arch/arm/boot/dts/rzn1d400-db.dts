/*
 * Device Tree Source for the RZN1D-DB Board
 *
 * Copyright (C) 2018 Renesas Electronics Europe Limited
 *
 * SPDX-License-Identifier: GPL-2.0
 */

/dts-v1/;

#include "rzn1.dtsi"

/ {
	model = "RZN1D-DB Board";
	compatible = "renesas,rzn1d-db", "renesas,r9a06g032";

	chosen {
		bootargs = "console=ttyS0,115200";
		stdout-path = &uart0;
		linux,stdout-path = &uart0;
	};
};
&uart0 {
	status = "okay";
};
