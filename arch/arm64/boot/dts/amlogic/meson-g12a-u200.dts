// SPDX-License-Identifier: (GPL-2.0+ OR MIT)
/*
 * Copyright (c) 2018 Amlogic, Inc. All rights reserved.
 */

/dts-v1/;

#include "meson-g12a.dtsi"

/ {
	compatible = "amlogic,u200", "amlogic,g12a";
	model = "Amlogic Meson G12A U200 Development Board";

	aliases {
		serial0 = &uart_AO;
	};
};

&uart_AO {
	status = "okay";
};

