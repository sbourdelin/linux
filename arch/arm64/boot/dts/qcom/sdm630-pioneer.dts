// SPDX-License-Identifier: GPL-2.0
/* Copyright (c) 2018, Craig Tatlor. */

/dts-v1/;

#include "sdm630-pioneer.dtsi"

/ {
	model = "Sony Xperia XA2";
	compatible = "sony,pioneer", "qcom,sdm630";

	/* required for bootloader to select correct board */
	qcom,board-id = <8 0>;
	qcom,pmic-id = <0x0001001b 0x0101011a 0x0 0x0>,
			<0x0001001b 0x0201011a 0x0 0x0>;
};
