/*
 * dts file for Cavium ThunderX2 CN99XX based Evaluation Boards
 *
 * Copyright (c) 2017 Cavium Inc.
 * Copyright (c) 2013-2016 Broadcom
 *
 * This program is free software; you can redistribute it and/or
 * modify it under the terms of the GNU General Public License as
 * published by the Free Software Foundation; either version 2 of
 * the License, or (at your option) any later version.
 */

/dts-v1/;

#include "thunder-99xx.dtsi"

/ {
	model = "Cavium ThunderX2 CN99XX";
	compatible = "cavium,thunder-99xx";

	memory {
		device_type = "memory";
		reg = <0x00000000 0x80000000 0x0 0x80000000>,  /* 2G @ 2G  */
		      <0x00000008 0x80000000 0x0 0x80000000>;  /* 2G @ 34G */
	};

	aliases {
		serial0 = &uart0;
	};

	chosen {
		stdout-path = "serial0:115200n8";
	};
};
