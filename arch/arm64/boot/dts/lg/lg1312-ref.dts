/*
 * dts file for lg1312 Reference Board.
 *
 * Copyright (C) 2016, LG Electronics
 */

/dts-v1/;

#include "lg1312.dtsi"

/ {
	#address-cells = <2>;
	#size-cells = <1>;

	model = "LG Electronics, DTV SoC LG1312 Reference Board";
	compatible = "lge,lg1312-ref", "lge,lg1312";

	memory {
		device_type = "memory";
		reg = <0x0 0x00000000 0x20000000>;
	};

	chosen {
		bootargs = "root=/dev/nfs ip=dhcp";
	};
};
