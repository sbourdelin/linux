## security/caitsith/Kconfig
```kconfig
config SECURITY_CAITSITH
	bool "CaitSith Support"
	depends on SECURITY
	select SECURITYFS
	select SRCU
	default n
	help
	  This selects CaitSith, check list based access control.
	  Required userspace tools and further information may be
	  found at <https://caitsith.osdn.jp/>.
	  If you are unsure how to answer this question, answer N.

config SECURITY_CAITSITH_OMIT_USERSPACE_LOADER
	bool "Activate without calling userspace policy loader."
	default n
	depends on SECURITY_CAITSITH
	---help---
	  Say Y here if you want to activate access control as soon as built-in
	  policy was loaded. This option will be useful for systems where
	  operations which can lead to the hijacking of the boot sequence are
	  needed before loading the policy. For example, you can activate
	  immediately after loading the fixed part of policy which will allow
	  only operations needed for mounting a partition which contains the
	  variant part of policy and verifying (e.g. running GPG check) and
	  loading the variant part of policy. Since you can start using
	  enforcing mode from the beginning, you can reduce the possibility of
	  hijacking the boot sequence.

config SECURITY_CAITSITH_POLICY_LOADER
	string "Location of userspace policy loader"
	default "/sbin/caitsith-init"
	depends on SECURITY_CAITSITH
	depends on !SECURITY_CAITSITH_OMIT_USERSPACE_LOADER
	---help---
	  This is the default pathname of policy loader which is called before
	  activation. You can override this setting via CS_loader= kernel
	  command line option.

config SECURITY_CAITSITH_ACTIVATION_TRIGGER
	string "Trigger for calling userspace policy loader"
	default "/sbin/init"
	depends on SECURITY_CAITSITH
	depends on !SECURITY_CAITSITH_OMIT_USERSPACE_LOADER
	---help---
	  This is the default pathname of activation trigger. You can override
	  this setting via CS_trigger= kernel command line option.
	  For example, if you pass init=/usr/lib/systemd/systemd option, you
	  may want to also pass CS_trigger=/usr/lib/systemd/systemd option.
```

## security/checmate/Kconfig
```kconfig
config SECURITY_CHECMATE
	bool "Checmate support"
	depends on SECURITY
	default n
	help
	  This turns on checmate
```

## security/modautorestrict/Kconfig
```kconfig
config SECURITY_MODAUTORESTRICT
	bool "Automatic Module Loading Restriction"
	depends on SECURITY
	default n
	help
	  This selects ModAutoRestrict Linux Security Module which applies
          restrictions on automatic module loading operations. If this
          option is selected, a request to use a kernel feature that is
          implemented by an unloaded module will first have to satisfy the
          access rules of MODAUTORESTRICT. Furthermore, this allows system
          administrators or sandbox mechanisms to prevent loading unneeded
          modules.
          Further information can be found in Documentation/security/ModAutoRestrict.txt.

	  If you are unsure how to answer this question, answer N.
```

## security/nsalinux/Kconfig
```kconfig
config SECURITY_NSALINUX
	bool "NSALinux Support"
	depends on SECURITY_NETWORK && AUDIT && NET && INET
	select NETWORK_SECMARK
	default n
	help
	  This selects NSALinux.
	  You will also need a policy configuration and a labeled filesystem.
	  If you are unsure how to answer this question, answer N.

config SECURITY_NSALINUX_BOOTPARAM
	bool "NSALinux boot parameter"
	depends on SECURITY_NSALINUX
	default n
	help
	  This option adds a kernel parameter 'nsalinux', which allows NSALinux
	  to be disabled at boot.  If this option is selected, NSALinux
	  functionality can be disabled with nsalinux=0 on the kernel
	  command line.  The purpose of this option is to allow a single
	  kernel image to be distributed with NSALinux built in, but not
	  necessarily enabled.

	  If you are unsure how to answer this question, answer N.

config SECURITY_NSALINUX_BOOTPARAM_VALUE
	int "NSALinux boot parameter default value"
	depends on SECURITY_NSALINUX_BOOTPARAM
	range 0 1
	default 1
	help
	  This option sets the default value for the kernel parameter
	  'nsalinux', which allows NSALinux to be disabled at boot.  If this
	  option is set to 0 (zero), the NSALinux kernel parameter will
	  default to 0, disabling NSALinux at bootup.  If this option is
	  set to 1 (one), the NSALinux kernel parameter will default to 1,
	  enabling NSALinux at bootup.

	  If you are unsure how to answer this question, answer 1.

config SECURITY_NSALINUX_DISABLE
	bool "NSALinux runtime disable"
	depends on SECURITY_NSALINUX
	default n
	help
	  This option enables writing to a nsalinuxfs node 'disable', which
	  allows NSALinux to be disabled at runtime prior to the policy load.
	  NSALinux will then remain disabled until the next boot.
	  This option is similar to the nsalinux=0 boot parameter, but is to
	  support runtime disabling of NSALinux, e.g. from /sbin/init, for
	  portability across platforms where boot parameters are difficult
	  to employ.

	  If you are unsure how to answer this question, answer N.

config SECURITY_NSALINUX_DEVELOP
	bool "NSALinux Development Support"
	depends on SECURITY_NSALINUX
	default y
	help
	  This enables the development support option of NSALinux,
	  which is useful for experimenting with NSALinux and developing
	  policies.  If unsure, say Y.  With this option enabled, the
	  kernel will start in permissive mode (log everything, deny nothing)
	  unless you specify enforcing=1 on the kernel command line.  You
	  can interactively toggle the kernel between enforcing mode and
	  permissive mode (if permitted by the policy) via /nsalinux/enforce.

config SECURITY_NSALINUX_AVC_STATS
	bool "NSALinux AVC Statistics"
	depends on SECURITY_NSALINUX
	default y
	help
	  This option collects access vector cache statistics to
	  /nsalinux/avc/cache_stats, which may be monitored via
	  tools such as avcstat.

config SECURITY_NSALINUX_CHECKREQPROT_VALUE
	int "NSALinux checkreqprot default value"
	depends on SECURITY_NSALINUX
	range 0 1
	default 0
	help
	  This option sets the default value for the 'checkreqprot' flag
	  that determines whether NSALinux checks the protection requested
	  by the application or the protection that will be applied by the
	  kernel (including any implied execute for read-implies-exec) for
	  mmap and mprotect calls.  If this option is set to 0 (zero),
	  NSALinux will default to checking the protection that will be applied
	  by the kernel.  If this option is set to 1 (one), NSALinux will
	  default to checking the protection requested by the application.
	  The checkreqprot flag may be changed from the default via the
	  'checkreqprot=' boot parameter.  It may also be changed at runtime
	  via /nsalinux/checkreqprot if authorized by policy.

	  If you are unsure how to answer this question, answer 0.

config SECURITY_NSALINUX_POLICYDB_VERSION_MAX
	bool "NSALinux maximum supported policy format version"
	depends on SECURITY_NSALINUX
	default n
	help
	  This option enables the maximum policy format version supported
	  by NSALinux to be set to a particular value.  This value is reported
	  to userspace via /nsalinux/policyvers and used at policy load time.
	  It can be adjusted downward to support legacy userland (init) that
	  does not correctly handle kernels that support newer policy versions.

	  Examples:
	  For the Fedora Core 3 or 4 Linux distributions, enable this option
	  and set the value via the next option. For Fedora Core 5 and later,
	  do not enable this option.

	  If you are unsure how to answer this question, answer N.

config SECURITY_NSALINUX_POLICYDB_VERSION_MAX_VALUE
	int "NSALinux maximum supported policy format version value"
	depends on SECURITY_NSALINUX_POLICYDB_VERSION_MAX
	range 15 23
	default 19
	help
	  This option sets the value for the maximum policy format version
	  supported by NSALinux.

	  Examples:
	  For Fedora Core 3, use 18.
	  For Fedora Core 4, use 19.

	  If you are unsure how to answer this question, look for the
	  policy format version supported by your policy toolchain, by
	  running 'checkpolicy -V'. Or look at what policy you have
	  installed under /etc/nsalinux/$NSALINUXTYPE/policy, where
	  NSALINUXTYPE is defined in your /etc/nsalinux/config.
```

## security/ptags/Kconfig
```kconfig
config SECURITY_PTAGS
	bool "Secure process tagging support (PTAGS)"
	depends on SECURITY
	default n
	help
	  PTags module allows to tag the processes through
	  the special files /proc/<pid>/attr/ptags.

config SECURITY_PTAGS_WITH_USER_NS
	bool "PTAGS with user namespace support (EXPERIMENTAL)"
	depends on SECURITY_PTAGS && USER_NS
	default n
	help
	  Activating this option allows PTAGS module to
	  manage tags by user namespaces.
```

## security/sara/Kconfig
```kconfig
menu S.A.R.A.

config SECURITY_SARA
	bool "Enable S.A.R.A."
	depends on SECURITY
	select SECURITYFS
	default n
	help
	  This selects S.A.R.A. LSM which aims to collect heterogeneous
	  security measures providing a common interface to manage them.
	  This LSM will always be stacked with the selected primary LSM and
	  other stacked LSMs.
	  Further information can be found in Documentation/security/SARA.rst.

	  If unsure, answer N.

config SECURITY_SARA_DEFAULT_DISABLED
	bool "S.A.R.A. will be disabled at boot."
	depends on SECURITY_SARA
	default n
	help
	  If you say Y here, S.A.R.A. will not be enabled at startup. You can
	  override this option at boot time via "sara=[1|0]" kernel parameter
	  or via user-space utilities.
	  This option is useful for distro kernels.

	  If unsure, answer N.

config SECURITY_SARA_NO_RUNTIME_ENABLE
	bool "S.A.R.A. can be turn on only at boot time."
	depends on SECURITY_SARA_DEFAULT_DISABLED
	default y
	help
	  By enabling this option it won't be possible to turn on S.A.R.A.
	  at runtime via user-space utilities. However it can still be
	  turned on at boot time via the "sara=1" kernel parameter.
	  This option is functionally equivalent to "sara=0" kernel parameter.
	  This option is useful for distro kernels.

	  If unsure, answer Y.

config SECURITY_SARA_USB_FILTERING
	bool "USB Filtering"
	depends on SECURITY_SARA && USB_SUPPORT
	default y
	help
	  Enable S.A.R.A. USB filtering capability. To prevent the connection
	  of unwanted USB devices, e.g. custom USB devices designed to
	  exploit vulnerabilities found in device drivers.
	  User-space utilities can be used to manage the configuration file.
	  Further information can be found in Documentation/security/SARA.rst.

	  If unsure, answer Y.

config SECURITY_SARA_USB_FILTERING_DENY
	bool "Default action for new USB devices is DENY"
	depends on SECURITY_SARA_USB_FILTERING
	default n
	help
	  If you say Y here any device that is not explicitly allowed via the
	  configuration will be blocked. If you don't enable this option
	  any USB device connected at boot will be allowed, regardless of
	  your settings. However, if you enable this and you don't
	  set your user-space utilities adequately your machine could become
	  unusable (e.g. your USB keyboard will be disabled).
	  This option can be overridden at boot time via
	  "sara_usb_filtering_default=[d|a]" kernel parameter.

	  If unsure, answer N.

config SECURITY_SARA_USB_FILTERING_DISABLED
	bool "USB filtering will be disabled at boot."
	depends on SECURITY_SARA_USB_FILTERING
	default n
	help
	  If you say Y here USB filtering won't be enabled at startup. You can
	  override this option via user-space utilities or at boot time via
	  "sara_usb_filtering=[0|1]" kernel parameter.
	  This option is useful for distro kernels.

	  If unsure, answer N.

endmenu
```

## security/tpe/Kconfig
```kconfig
config SECURITY_TPE
	bool "Trusted Path Execution (TPE)"
	default n
	help
	  If you say Y here, you will be able to choose a gid to add to the
	  supplementary groups of users you want to mark as "trusted."
	  Untrusted users will not be able to execute any files that are not in
	  root-owned directories writable only by root.  If the sysctl option
	  is enabled, a sysctl option with name "tpe.enabled" is created.

config SECURITY_TPE_GID
	int
	default SECURITY_TPE_TRUSTED_GID if (SECURITY_TPE && !SECURITY_TPE_INVERT_GID)
	default SECURITY_TPE_UNTRUSTED_GID if (SECURITY_TPE && SECURITY_TPE_INVERT_GID)

config SECURITY_TPE_TRUSTED_GID
	int "GID for TPE-trusted users"
	depends on SECURITY_TPE && !SECURITY_TPE_INVERT_GID
	default 0
	help
	  Setting this GID determines what group TPE restrictions will be
	  *disabled* for. If the sysctl option is enabled, a sysctl option
	  with name "tpe.gid" is created.

config SECURITY_TPE_UNTRUSTED_GID
	int "GID for TPE-untrusted users"
	depends on SECURITY_TPE && SECURITY_TPE_INVERT_GID
	default 0
	help
	  Setting this GID determines what group TPE restrictions will be
	  *enabled* for. If the sysctl option is enabled, a sysctl option
	  with name "tpe.gid" is created.

config SECURITY_TPE_INVERT_GID
	bool "Invert GID option"
	depends on SECURITY_TPE
	help
	  If you say Y here, the group you specify in the TPE configuration will
	  decide what group TPE restrictions will be *enabled* for.  This
	  option is useful if you want TPE restrictions to be restricted to a
	  small subset of users. If the sysctl option is enabled, a sysctl option
	  with name "tpe.invert_gid" is created.

config SECURITY_TPE_STRICT
	bool "Partially restrict all non-root users"
	depends on SECURITY_TPE
	help
	  If you say Y here, all non-root users will be covered under
	  a weaker TPE restriction.  This is separate from, and in addition to,
	  the main TPE options that you have selected elsewhere.  Thus, if a
	  "trusted" GID is chosen, this restriction applies to even that GID.
	  Under this restriction, all non-root users will only be allowed to
	  execute files in directories they own that are not group or
	  world-writable, or in directories owned by root and writable only by
	  root.  If the sysctl option is enabled, a sysctl option with name
	  "tpe.strict" is created.

config SECURITY_TPE_RESTRICT_ROOT
	bool "Restrict root"
	depends on SECURITY_TPE
	help
	  If you say Y here, root will be marked as untrusted. This will require
	  root to pass all the same checks as any other untrusted user.
```

## sound/sdw/Kconfig
```kconfig
config SOUND_SDW
	tristate
	help
	  SoundWire interface is typically used for transporting data
	  related to audio functions. Concerned drivers should "select"
	  this.
```

## sound/soc/axentia/Kconfig
```kconfig
config SND_SOC_AXENTIA_TSE850_PCM5142
	tristate "ASoC driver for the Axentia TSE-850"
	depends on ARCH_AT91 && OF
	select ATMEL_SSC
	select SND_ATMEL_SOC
	select SND_ATMEL_SOC_SSC_DMA
	select SND_SOC_PCM512x_I2C
	help
	  Say Y if you want to add support for the ASoC driver for the
	  Axentia TSE-850 with a PCM5142 codec.
```

## sound/soc/dwc/Kconfig
```kconfig
config SND_DESIGNWARE_I2S
	tristate "Synopsys I2S Device Driver"
	depends on CLKDEV_LOOKUP
	select SND_SOC_GENERIC_DMAENGINE_PCM
	help
	 Say Y or M if you want to add support for I2S driver for
	 Synopsys desigwnware I2S device. The device supports upto
	 maximum of 8 channels each for play and record.

config SND_DESIGNWARE_PCM
	tristate "Synopsys I2S PCM Driver"
	help
	 Say Y or M if you want to add support for ALSA ASoC platform driver
	 using I2S.

	 Select this option if you want to be able to create a sound interface
	 using the I2S device driver as CPU driver. Instead of using ALSA
	 DMA engine by selecting this driver a custom PCM driver will be used.
```
