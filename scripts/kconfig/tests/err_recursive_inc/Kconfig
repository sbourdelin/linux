## sound/soc/sof/Kconfig
```kconfig
config SND_SOC_SOF
	tristate "Sound Open Firmware Support"
	select SND_SOC_TOPOLOGY
	select SND_SOC_COMPRESS
	help
          This adds support for Sound Open Firmware (SOF). SOF is a free and
	  generic open source audio DSP firmware for multiple devices.
          Say Y if you have such a device that is supported by SOF.
          If unsure select "N".

config SND_SOC_SOF_DEBUG
	bool "SOF debugging features"
	depends on SND_SOC_SOF
	help
	  This option can be used to enable or disable individual SOF firmware
	  and driver debugging options.
	  Say Y if you are debugging SOF FW or drivers.
          If unsure select "N".

config SND_SOC_SOF_DEBUG_XRUN_STOP
	bool "SOF stop on XRUN"
	depends on SND_SOC_SOF_DEBUG
	help
	  This option forces PCMs to stop on any XRUN event. This is useful to
	  preserve any trace data ond pipeline status prior to the XRUN.
	  Say Y if you are debugging SOF FW pipeline XRUNs.
          If unsure select "N".

config SND_SOC_SOF_DEBUG_VERBOSE_IPC
	bool "SOF verbose IPC logs"
	depends on SND_SOC_SOF_DEBUG
	help
	  This option enables more verbose IPC logs, with command types in
	  human-readable form instead of just 32-bit hex dumps. This is useful
	  if you are trying to debug IPC with the DSP firmware.
          If unsure select "N".
```

## sound/soc/stm/Kconfig
```kconfig
menuconfig SND_SOC_STM32_DFSDM
	tristate "SoC Audio support for STM32 DFSDM"
	depends on (ARCH_STM32 && OF && STM32_DFSDM_ADC) || COMPILE_TEST
	depends on SND_SOC
	select SND_SOC_GENERIC_DMAENGINE_PCM
	select SND_SOC_DMIC
	help
	  Select this option to enable the STM32 Digital Filter
	  for Sigma Delta Modulators (DFSDM) driver used
	  in various STM32 series for digital microphone capture.
```

## sound/soc/sunxi/Kconfig
```kconfig
menu "Allwinner SoC Audio support"
	depends on ARCH_SUNXI || COMPILE_TEST

config SND_SUN4I_CODEC
	tristate "Allwinner A10 Codec Support"
	select SND_SOC_GENERIC_DMAENGINE_PCM
	select REGMAP_MMIO
	help
	  Select Y or M to add support for the Codec embedded in the Allwinner
	  A10 and affiliated SoCs.

config SND_SUN4I_I2S
	tristate "Allwinner A10 I2S Support"
	select SND_SOC_GENERIC_DMAENGINE_PCM
	select REGMAP_MMIO
	help
	  Say Y or M if you want to add support for codecs attached to
	  the Allwinner A10 I2S. You will also need to select the
	  individual machine drivers to support below.

config SND_SUN4I_SPDIF
	tristate "Allwinner A10 SPDIF Support"
	depends on OF
	select SND_SOC_GENERIC_DMAENGINE_PCM
	select REGMAP_MMIO
	help
	  Say Y or M to add support for the S/PDIF audio block in the Allwinner
	  A10 and affiliated SoCs.

config SND_SUN8I
	tristate "Allwinner SUN6I/SUN8I audio card support"
	select SND_SUN8I_CODEC
	select SND_SUN4I_I2S
	select SND_SUN8I_CODEC_ANALOG
	select REGMAP_MMIO
	help
	  This option enables the audio card for Allwinner A33 (sun8i) SoC.
	  It enables the DAI driver (SND_SUN4I_I2S), the digital audio
	  codec driver (SND_SUN8I_CODEC) and the analog codec driver
	  (SND_SUN8I_CODEC_ANALOG).

	  Say Y or M if you want to add sun8i/6i card support

config SND_SUN8I_CODEC
	tristate "Allwinner SUN8I audio codec"
	select REGMAP_MMIO
        help
	  This option enables the digital part of the internal audio codec for
	  Allwinner sun8i SoC.

	  Say Y or M if you want to add sun8i digital audio codec support.

config SND_SUN8I_CODEC_ANALOG
	tristate "Allwinner SUN8I analog codec"
	select REGMAP_MMIO
        help
	  Say Y or M if you want to add sun8i analog audiocodec support

endmenu
```
