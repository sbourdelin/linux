## Documentation/devicetree/bindings/cpufreq/nvidia,tegra20-cpufreq.txt
```
Binding for NVIDIA Tegra20 CPUFreq
==================================

Required properties:
- clocks: Must contain an entry for each entry in clock-names.
  See ../clocks/clock-bindings.txt for details.
- clock-names: Must include the following entries:
  - pll_x: main-parent for CPU clock, must be the first entry
  - backup: intermediate-parent for CPU clock
  - cpu: the CPU clock
- operating-points-v2: See ../bindings/opp/opp.txt for details.
- #cooling-cells: Should be 2. See ../thermal/thermal.txt for details.

Example:
	cpu0_opp_table: opp_table0 {
		compatible = "operating-points-v2";

		opp@216000000 {
			clock-latency-ns = <300000>;
			opp-hz = /bits/ 64 <216000000>;
			opp-microvolt = <7500000>;
			opp-suspend;
		};

		...
	};

	cpus {
		cpu@0 {
			compatible = "arm,cortex-a9";
			clocks = <&tegra_car TEGRA20_CLK_PLL_X>,
				 <&tegra_car TEGRA20_CLK_PLL_P>,
				 <&tegra_car TEGRA20_CLK_CCLK>;
			clock-names = "pll_x", "backup", "cpu";
			operating-points-v2 = <&cpu0_opp_table>;
			#cooling-cells = <2>;
		};
	};
```

## Documentation/devicetree/bindings/crypto/msm/ice.txt
```
* Inline Crypto Engine (ICE)

Required properties:
  - compatible			: should be "qcom,ice"
  - reg 			: <register mapping>

Optional properties:
  - interrupt-names     	: name describing the interrupts for ICE IRQ
  - interrupts          	: <interrupt mapping for ICE IRQ>
  - qcom,enable-ice-clk 	: should enable clocks for ICE HW
  - clocks              	: List of phandle and clock specifier pairs
  - clock-names         	: List of clock input name strings sorted in the same
				  order as the clocks property.
  - qcom,op-freq-hz     	: max clock speed sorted in the same order as the clocks
				  property.
  - qcom,instance-type  	: describe the storage type for which ICE node is defined
				  currently, only "ufs" and "sdcc" are supported storage type
  - power-domains		: regulator supply to be used by ICE HW

Example:
	ufs_ice: ufsice@1d90000 {
		compatible = "qcom,ice";
		reg = <0x1d90000 0x8000>;
		qcom,enable-ice-clk;
		clock-names = "ufs_core_clk", "bus_clk",
				"iface_clk", "ice_core_clk";
		clocks = <&gcc GCC_UFS_PHY_AXI_CLK>,
			 <&gcc GCC_UFS_MEM_CLKREF_CLK>,
			 <&gcc GCC_UFS_PHY_AHB_CLK>,
			 <&gcc GCC_UFS_PHY_ICE_CORE_CLK>;
		qcom,op-freq-hz = <0>, <0>, <0>, <300000000>;
		power-domains = <&gcc UFS_PHY_GDSC>;
		qcom,instance-type = "ufs";
	};
```

## Documentation/devicetree/bindings/crypto/rk-crypto.txt
```
Rockchip Electronics And Security Accelerator

Required properties:
- compatible: should be "rockchip,crypto"
- reg: base physical address of the engine and length of memory mapped
       region.
- interrupts: interrupt number
- clocks: clock specifiers
- clock-names: "aclk_crypto" used to clock data
			   "hclk_crypto" used to clock data
			   "srst_crypto" used to clock crypto accelerator
			   "apb_pclk"    used to clock dma
-status: Enable

Examples:

	crypto: cypto-controller@ff8a0000 {
		compatible = "rockchip,crypto";
		reg = <0xff8a0000 0x4000>;
		interrupts = <GIC_SPI 48 IRQ_TYPE_LEVEL_HIGH>;
		clocks = <&cru ACLK_CRYPTO>,
			 <&cru HCLK_CRYPTO>,
			 <&cru SRST_CRYPTO>,
			 <&cru ACLK_DMAC1>;

		clock-names = "aclk_crypto",
			      "hclk_crypto",
			      "srst_crypto",
				  "apb_pclk";
		status = "okay";
	};
```

## Documentation/devicetree/bindings/crypto/rockchip-crypto.txt
```
Rockchip Electronics And Security Accelerator

Required properties:
- compatible: Should be "rockchip,rk3288-crypto"
- reg: base physical address of the engine and length of memory mapped
       region
- interrupts: interrupt number
- clocks: reference to the clocks about crypto
- clock-names: "aclk" used to clock data
	       "hclk" used to clock data
	       "srst" used to clock crypto accelerator
	       "apb_pclk" used to clock dma

Examples:

	crypto: cypto-controller@ff8a0000 {
		compatible = "rockchip,rk3288-crypto";
		reg = <0xff8a0000 0x4000>;
		interrupts = <GIC_SPI 48 IRQ_TYPE_LEVEL_HIGH>;
		clocks = <&cru ACLK_CRYPTO>,
			 <&cru HCLK_CRYPTO>,
			 <&cru SCLK_CRYPTO>,
			 <&cru ACLK_DMAC1>;
		clock-names = "aclk",
			      "hclk",
			      "sclk",
			      "apb_pclk";
		status = "okay";
	};
```

## Documentation/devicetree/bindings/crypto/st,stm32-crc.txt
```
* STMicroelectronics STM32 CRC

Required properties:
- compatible: Can be either "st,stm32f7-crc" or "st,srm32f4-crc".
- reg: The address and length of the peripheral registers space
- clocks: The input clock of the CRC instance

Optional properties: none

Example:

crc: crc@40023000 {
	compatible = "st,stm32f7-crc", "st,stm32f4-crc";
	reg = <0x40023000 0x400>;
	clocks = <&rcc 0 12>;
};
```

## Documentation/devicetree/bindings/devfreq/exynos5422-dmc.txt
```
* Exynos5422 frequency and voltage scaling for Dynamic Memory Controller device

The Samsung Exynos5422 SoC has DMC (Dynamic Memory Controller) to which the DRAM
memory chips are connected. The driver is to monitor the controller in runtime
and switch frequency and voltage. To monitor the usage of the controller in
runtime, the driver uses the PPMU (Platform Performance Monitoring Unit), which
is able to measure the current load of the memory.
When 'userspace' governor is used for the driver, an application is able to
switch the DMC frequency.

Required properties for DMC device for Exynos5422:
- compatible: Should be "samsung,exynos5422-bus".
- clock-names : the name of clock used by the bus, "bus".
- clocks : phandles for clock specified in "clock-names" property.
- devfreq-events : phandles for PPMU devices connected to this DMC.

The example definition of a DMC and PPMU devices declared in DT is shown below:

	ppmu_dmc0_0: ppmu@10d00000 {
		compatible = "samsung,exynos-ppmu";
		reg = <0x10d00000 0x2000>;
		clocks = <&clock CLK_PCLK_PPMU_DREX0_0>;
		clock-names = "ppmu";
		status = "okay";
		events {
			ppmu_event_dmc0_0: ppmu-event3-dmc0_0 {
				event-name = "ppmu-event3-dmc0_0";
			};
		};
	};


	ppmu_dmc0_1: ppmu@10d10000 {
		compatible = "samsung,exynos-ppmu";
		reg = <0x10d10000 0x2000>;
		clocks = <&clock CLK_PCLK_PPMU_DREX0_1>;
		clock-names = "ppmu";
		status = "okay";
		events {
			ppmu_event_dmc0_1: ppmu-event3-dmc0_1 {
				event-name = "ppmu-event3-dmc0_1";
			};
		};
	};

	ppmu_dmc1_0: ppmu@10d10000 {
		compatible = "samsung,exynos-ppmu";
		reg = <0x10d60000 0x2000>;
		clocks = <&clock CLK_PCLK_PPMU_DREX1_0>;
		clock-names = "ppmu";
		status = "okay";
		events {
			ppmu_event_dmc1_0: ppmu-event3-dmc1_0 {
				event-name = "ppmu-event3-dmc1_0";
			};
		};
	};

	ppmu_dmc1_1: ppmu@10d70000 {
		compatible = "samsung,exynos-ppmu";
		reg = <0x10d70000 0x2000>;
		clocks = <&clock CLK_PCLK_PPMU_DREX1_1>;
		clock-names = "ppmu";
		status = "okay";
		events {
			ppmu_event_dmc1_1: ppmu-event3-dmc1_1 {
				event-name = "ppmu-event3-dmc1_1";
			};
		};
	};

	dmc: memory-controller@10c20000 {
		compatible = "samsung,exynos5422-dmc";
		reg = <0x10c20000 0x10000>, <0x10c30000 0x10000>,
			<0x10030000 0x1000>, <0x10000000 0x1000>;
		clocks = 	<&clock CLK_FOUT_SPLL>,
				<&clock CLK_MOUT_SCLK_SPLL>,
				<&clock CLK_FF_DOUT_SPLL2>,
				<&clock CLK_FOUT_BPLL>,
				<&clock CLK_MOUT_BPLL>,
				<&clock CLK_SCLK_BPLL>,
				<&clock CLK_MOUT_MX_MSPLL_CCORE>,
				<&clock CLK_MOUT_MX_MSPLL_CCORE_PHY>,
				<&clock CLK_MOUT_MCLK_CDREX>,
				<&clock CLK_DOUT_CLK2X_PHY0>,
				<&clock CLK_CLKM_PHY0>,
				<&clock CLK_CLKM_PHY1>;
		clock-names =	"fout_spll",
				"mout_sclk_spll",
				"ff_dout_spll2",
				"fout_bpll",
				"mout_bpll",
				"sclk_bpll",
				"mout_mx_mspll_ccore",
				"mout_mx_mspll_ccore_phy",
				"mout_mclk_cdrex",
				"dout_clk2x_phy0",
				"clkm_phy0",
				"clkm_phy1";

		status = "okay";
		devfreq-events = <&ppmu_dmc0_0>, <&ppmu_dmc0_1>,
				<&ppmu_dmc1_0>, <&ppmu_dmc1_1>;
	};
```

## Documentation/devicetree/bindings/devfreq/rk3399_dmc.txt
```
* Rockchip rk3399 dmc device

Required properties:
- compatible: Must be "rockchip,rk3399-dmc".
- devfreq-events: Node to get ddr loading, Refer to
		  Documentation/devicetree/bindings/devfreq/rockchip-dif.txt
- interrupts: The interrupt number to the cpu. The interrupt specifier format
	      depends on the interrupt controller. 
- clocks: Phandles for clock specified in "clock-names" property
- clock-names : The name of clock used by the DFI, must be "pclk_ddr_mon";
- operating-points-v2: Refer to Documentation/devicetree/bindings/power/opp.txt
		       for details.
- center-supply: Dmc supply node.
- status: Marks the node enabled/disabled.

Optional properties:
- ddr_timing: ddr timing need to pass to arm trust firmware
- upthreshold: the upthreshold to simpleondeamnd policy
- downdifferential: The downdifferential to simpleondeamnd policy

Example:
	dmc: dmc {
		compatible = "rockchip,rk3399-dmc";
		devfreq-events = <&dfi>;
		interrupts = <GIC_SPI 1 IRQ_TYPE_LEVEL_HIGH>;
		clocks = <&cru SCLK_DDRCLK>;
		clock-names = "dmc_clk";
		ddr_timing = <&ddr_timing>;
		operating-points-v2 = <&dmc_opp_table>;
		center-supply = <&ppvar_centerlogic>;
		upthreshold = <15>;
		downdifferential = <10>;
		status = "disabled";
	};
```

## Documentation/devicetree/bindings/display/altr,vip-fb2.txt
```
Intel Video and Image Processing(VIP) Frame Buffer II bindings

Supported hardware: Intel FPGA SoC Arria10 and above with display port IP

The Video Frame Buffer II in Video Image Processing (VIP) suite is an IP core
that interfaces between system memory and Avalon-ST video ports. The IP core
can be configured to support the memory reader (from memory to Avalon-ST)
and/or memory writer (from Avalon-ST to memory) interfaces.

More information the FPGA video IP component can be acquired from
https://www.altera.com/content/dam/altera-www/global/en_US/pdfs\
/literature/ug/ug_vip.pdf

DT-Bindings:
=============
Required properties:
----------------------------
- compatible: "altr,vip-frame-buffer-2.0"
- reg: Physical base address and length of the framebuffer controller's
	registers.
- altr,max-width: The maximum width of the framebuffer in pixels.
- altr,max-height: The maximum height of the framebuffer in pixels.
- altr,mem-port-width = the bus width of the avalon master port
	on the frame reader

Optional sub-nodes:
- ports: The connection to the encoder

Optional properties
----------------------------
- compatible: "altr, display-port"
- reg: Physical base address and length of the display port controller's
	registers
- clocks: required clock handles for specified pairs in clock name
- clock-names: required clock names. Contains:
	- aux_clk: auxiliary clock,
	- clk: 100 MHz output clock
	- xcvr_mgmt_clk: transceiver management clock

Optional sub-nodes:
- ports: The connection to the controller

Connections between the Frame Buffer II and other video IP cores in the system
are modelled using the OF graph DT bindings. The Frame Buffer II node has up
to two OF graph ports. When the memory writer interface is enabled, port 0
maps to the Avalon-ST Input (din) port. When the memory reader interface is
enabled, port 1 maps to the Avalon-ST Output (dout) port.

The encoder is built into the FPGA HW design and therefore would not
be accessible from the DDR.

		Port 0				Port1
---------------------------------------------------------
ARRIA10 AVALON_ST (DIN)		AVALON_ST (DOUT)

Required Properties Example:
----------------------------

framebuffer@100000280 {
		compatible = "altr,vip-frame-buffer-2.0";
		reg = <0x00000001 0x00000280 0x00000040>;
		altr,max-width = <1280>;
		altr,max-height = <720>;
		altr,mem-port-width = <128>;

		ports {
				#address-cells = <1>;
				#size-cells = <0>;

			port@1 {
				reg = <1>;
					fb_output: endpoint {
						remote-endpoint = <&dp_encoder_input>;
					};
			};
		};
};

Optional Properties Example:
This is not required unless there are needs to customize
Display Port controller settings.

displayport@100002000 {
		compatible = "altr, display-port";
		reg = <0x00000001 0x00002000 0x00000800>;
		clocks = <&dp_0_clk_16 &dp_0_clk_100 &dp_0_clk_100>;
		clock-names = "aux_clk", "clk", "xcvr_mgmt_clk";

		ports {
			#address-cells = <1>;
			#size-cells = <0>;

			port@0 {
				reg = <1>;
					dp_input: endpoint {
						remote-endpoint = <&dp_controller_input>;
					};
			};
};
```

## Documentation/devicetree/bindings/display/atmel/lcdc-display-controller.txt
```
Atmel LCD Controller (LCDC) Display Controller

Required properties:
 - compatible: value should be one of the following:
   "atmel,lcdc-display-controller"

Optional properties:
- lcd-supply: phandle to a regulator that supply the display

Required children nodes:
 One child node that references the panel connected.
 (See ../graph.txt)
 At least one port node is required.


Example:
	lcdc0: lcdc@700000 {
		compatible = "atmel,at91sam9263-lcdc-mfd";
		reg = <0x700000 0x1000>;
		interrupts = <26 IRQ_TYPE_LEVEL_HIGH 3>;
		clocks = <&lcd_clk>, <&lcd_clk>;
		clock-names = "lcdc_clk", "hclk";

		lcdc-display-controller {
			compatible = "atmel,lcdc-display-controller";
			lcd-supply = <&lcdc_reg>;
			#address-cells = <1>;
			#size-cells = <0>;

			port@0 {
				reg = <0>;
				#address-cells = <1>;
				#size-cells = <0>;
				lcdc_panel_output: endpoint@0 {
					reg = <0>;
					remote-endpoint = <&panel_input>;
				};
			};
		};
	};
```

## Documentation/devicetree/bindings/display/bridge/cdns,dsi.txt
```
Cadence DSI bridge
==================

The Cadence DSI bridge is a DPI to DSI bridge supporting up to 4 DSI lanes.

Required properties:
- compatible: should be set to "cdns,dsi".
- reg: physical base address and length of the controller's registers.
- interrupts: interrupt line connected to the DSI bridge.
- clocks: DSI bridge clocks.
- clock-names: must contain "pclk" and "sysclk".
- phys: phandle link to the MIPI D-PHY controller.
- phy-names: must contain "dphy".
- #address-cells: must be set to 1.
- #size-cells: must be set to 0.

Required subnodes:
- ports: Ports as described in Documentation/devicetree/bindings/graph.txt.
  Currently contains a single input port at address 0 representing the DPI
  input. Other ports will be added later to support the SDI inputs.
  Port 0 should be connected to a DPI encoder output.
- one subnode per DSI device connected on the DSI bus. Each DSI device should
  contain a reg property encoding its address on the bus.

Example:

	dsi0: dsi@fd0c0000 {
		compatible = "cdns,dsi";
		reg = <0x0 0xfd0c0000 0x0 0x1000>;
		clocks = <&pclk>, <&sysclk>;
		clock-names = "pclk", "hclk";
		interrupts = <1>;
		phys = <&dphy1>;
		phy-names = "dphy";
		#address-cells = <1>;
		#size-cells = <0>;

		ports {
			#address-cells = <1>;
			#size-cells = <0>;

			port@0 {
				reg = <0>;
				dsi0_dpi_input: endpoint {
					remote-endpoint = <&xxx_dpi_output>;
				};
			};
		};

		panel: dsi-dev@0 {
			compatible = "<vendor,panel>";
			reg = <0>;
		};
	};
```

## Documentation/devicetree/bindings/display/bridge/cdns,mhdp.txt
```
Cadence MHDP bridge
==========================

The Cadence MHDP bridge is a DPI to DP bridge.

Required properties:
 - compatible: should be "cdns,mhdp",
 - reg: physical base address and length of the controller's registers,
 - clocks: DP bridge clock, it's used by the IP to know how to translate
	   a number of clock cycles into a time (which is used to comply
	   with DP standard timings and delays),
 - clock-names: must be "clk",

Required subnodes:
 - ports: Ports as described in Documentation/devictree/bindings/graph.txt
   Currently contains a single input port at address 0 representing the DPI
   input.
   Port 0 should be connected to a DPI encoder output.

Example:

	mhdp: mhdp@0xf0fb000000 {
		compatible = "cdns,mhdp";
		reg = <0xf0 0xfb000000 0x0 0x1000000>;
		clocks = <&mhdp_clock>;
		clock-names = "clk";

		ports {
			#address-cells = <1>;
			#size-cells = <0>;

			port@0 {
				reg = <0>;
				mhdp0_dpi_input: endpoint {
					remote-endpoint = <&xxx_dpi_output>;
				};
			};
		};
	};
```
