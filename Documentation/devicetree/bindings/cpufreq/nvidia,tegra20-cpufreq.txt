## Documentation/devicetree/bindings/display/bridge/raspberrypi,7inch-touchscreen-bridge.txt
```
Official 7" (800x480) Raspberry Pi touchscreen panel's bridge.

This DSI panel contains:

- TC358762 DSI->DPI bridge
- Atmel microcontroller on I2C for power sequencing the DSI bridge and
  controlling backlight
- Touchscreen controller on I2C for touch input

and this covers the TC358762 bridge and Atmel microcontroller, while
../panel/raspberrypi,7inch-touchscreen-panel.txt covers the panel.

Required properties:
- compatible:	Must be "raspberrypi,7inch-touchscreen-bridge"
- raspberrypi,touchscreen-bridge:
		Handle to the I2C device for Atmel microcontroller

Example:

dsi1: dsi@7e700000 {
	#address-cells = <1>;
	#size-cells = <0>;
	<...>

	lcd-bridge@0 {
		compatible = "raspberrypi,7inch-touchscreen-bridge";
		reg = <0>;

		raspberrypi,touchscreen-bridge = <&pitouchscreen_bridge>;
		ports {
			#address-cells = <1>;
			#size-cells = <0>;
			port@0 {
				reg = <0>;
				pitouchscreen_bridge_port: endpoint {
					remote-endpoint = <&pitouchscreen_panel_port>;
				};
			};
		};
	};
};

i2c_dsi: i2c {
	compatible = "i2c-gpio";
	#address-cells = <1>;
	#size-cells = <0>;
	gpios = <&gpio 28 0
		 &gpio 29 0>;

	pitouchscreen_bridge: bridge@45 {
		compatible = "raspberrypi,touchscreen-bridge-i2c";
		reg = <0x45>;
	};
};

lcd {
	compatible = "raspberrypi,7inch-touchscreen-panel";
	ports {
		#address-cells = <1>;
		#size-cells = <0>;
		port@0 {
			reg = <0>;
			pitouchscreen_panel_port: endpoint {
				remote-endpoint = <&pitouchscreen_bridge_port>;
			};
		};
	};
};
```

## Documentation/devicetree/bindings/display/bridge/sii9234.txt
```
Silicon Image SiI9234 HDMI/MHL bridge bindings

Required properties:
	- compatible : "sil,sii9234".
	- reg : I2C address for TPI interface, use 0x39
	- avcc33-supply : MHL/USB Switch Supply Voltage (3.3V)
	- iovcc18-supply : I/O Supply Voltage (1.8V)
	- avcc12-supply : TMDS Analog Supply Voltage (1.2V)
	- cvcc12-supply : Digital Core Supply Voltage (1.2V)
	- interrupts, interrupt-parent: interrupt specifier of INT pin
	- reset-gpios: gpio specifier of RESET pin (active low)
	- video interfaces: Device node can contain video interface port
			    node for HDMI encoder according to [1].

[1]: Documentation/devicetree/bindings/media/video-interfaces.txt

Example:
	sii9234@39 {
		compatible = "sil,sii9234";
		reg = <0x39>;
		avcc33-supply = <&vcc33mhl>;
		iovcc18-supply = <&vcc18mhl>;
		avcc12-supply = <&vsil12>;
		cvcc12-supply = <&vsil12>;
		reset-gpios = <&gpf3 4 GPIO_ACTIVE_LOW>;
		interrupt-parent = <&gpf3>;
		interrupts = <5 IRQ_TYPE_LEVEL_HIGH>;

		port {
			mhl_to_hdmi: endpoint {
				remote-endpoint = <&hdmi_to_mhl>;
			};
		};
	};
```

## Documentation/devicetree/bindings/display/bridge/sil902x.txt
```
sil902x HDMI bridge bindings

Required properties:
	- compatible: "sil,sil9022"
	- reg: i2c address of the bridge
	- reset-gpios: OF device-tree gpio specification for RST_N pin.

Optional properties:
	- interrupts-extended or interrupt-parent + interrupts: describe
	  the interrupt line used to inform the host about hotplug events.

Optional subnodes:
	- video input: Device node can contain video input port node to
	  connect the bridge to a display controller output (See this
	  documentation [1]).

[1]: Documentation/devicetree/bindings/media/video-interfaces.txt

Example:
	hdmi-bridge@39 {
		compatible = "sil,sil9022";
		reg = <0x39>;
		reset-gpios = <&gpx1 5 1 0 0>;
		ports {
			port@0 {
				bridge_in: endpoint {
					remote-endpoint = <&dc_out>;
				};
			};
		};
	};
```

## Documentation/devicetree/bindings/display/bridge/toshiba,tc358764.txt
```
TC358764 MIPI-DSI to LVDS panel bridge

Required properties:
  - compatible: "toshiba,tc358764"
  - reg: the virtual channel number of a DSI peripheral
  - vddc-supply: core voltage supply, 1.2V
  - vddio-supply: I/O voltage supply, 1.8V or 3.3V
  - vddlvds-supply: LVDS1/2 voltage supply, 3.3V
  - reset-gpios: a GPIO spec for the reset pin

The device node can contain zero to two 'port' child nodes, each with one
child 'endpoint' node, according to the bindings defined in [1].
The following are properties specific to those nodes.

port:
  - reg: (required) can be 0 for DSI port or 1 for LVDS port;

[1]: Documentation/devicetree/bindings/media/video-interfaces.txt

Example:

	bridge@0 {
		reg = <0>;
		compatible = "toshiba,tc358764";
		vddc-supply = <&vcc_1v2_reg>;
		vddio-supply = <&vcc_1v8_reg>;
		vddlvds-supply = <&vcc_3v3_reg>;
		reset-gpios = <&gpd1 6 GPIO_ACTIVE_LOW>;
		#address-cells = <1>;
		#size-cells = <0>;
		port@1 {
			reg = <1>;
			lvds_ep: endpoint {
				remote-endpoint = <&panel_ep>;
			};
		};
	};
```

## Documentation/devicetree/bindings/display/bridge/virtual-display-bridge.txt
```
Virtual Display Bridge

This represents a display that is contained within an emulated
environment.

This means that the display engine mainly expects some timing
parameters to be written into it, and after that the emulator will
respond by creating a virtual display with the requested
resolution characteristics.

As the operating system cannot "detect" such a display, rather the
emulator will respond to what the controller outputs, a
chicken-and-egg problem needs to be solved: the resolution and
timing characteristics need to be defined and set up somewhere.

The virtual display bridge solves this by defining a bridge with
all timing characteristics encoded into the device tree node.

Required properies:
- compatible: shall be "virtual-display-bridge"

Required subnodes:
- display-timings: contains in turn a display timing node
  see display-timing.txt
- ports: contains the display ports, see media/video-interfaces.txt

Example:

bridge {
	compatible = "virtual-display-bridge";
	#address-cells = <1>;
	#size-cells = <0>;

	display-timings {
		/* Some standard VGA timing */
		timing0 {
			clock-frequency = <23750>;
			hactive = <640>;
			vactive = <480>;
			hfront-porch = <48>;
			hback-porch = <16>;
			hsync-len = <96>;
			vfront-porch = <33>;
			vback-porch = <9>;
			vsync-len = <3>;
			vrefresh = <60>;
		};
	};

	ports {
		#address-cells = <1>;
		#size-cells = <0>;

		port@0 {
			reg = <0>;

			display_bridge_in: endpoint {
				remote-endpoint = <&foo>;
			};
		};
	};
};
```

## Documentation/devicetree/bindings/display/panel/ampire,am-800480aytzqw-00h.txt
```
Ampire AM-800480AYTZQW-00H 7.0" WVGA TFT LCD panel

Required properties:
- compatible: should be "ampire,am-800480aytzqw-00h"

This binding is compatible with the simple-panel binding, which is specified
in simple-panel.txt in this directory.
```

## Documentation/devicetree/bindings/display/panel/auo,g104sn02.txt
```
AU Optronics Corporation 10.4" (800x600) color TFT LCD panel

Required properties:
- compatible: should be "auo,g104sn02"

This binding is compatible with the simple-panel binding, which is specified
in simple-panel.txt in this directory.
```

## Documentation/devicetree/bindings/display/panel/bananapi,s070wv20-ct16-icn6211.txt
```
Bananapi S070WV20-CT16 ICN6211 MIPI-DSI to RGB bridge

Required properties:
- compatible: must be "bananapi,s070wv20-ct16-icn6211"
- reg: DSI virtual channel used by that screen
- avdd-supply: analog regulator dc1 switch
- dvdd-supply: 3v3 digital regulator
- reset-gpios: a GPIO phandle for the reset pin

Optional properties:
- backlight: phandle for the backlight control.

Example:
panel@0 {
	compatible = "bananapi,s070wv20-ct16-icn6211";
	reg = <0>;
	avdd-supply = <&reg_dc1sw>;
	dvdd-supply = <&reg_dldo1>;
	reset-gpios = <&pio 3 6 GPIO_ACTIVE_HIGH>; /* PD6 */
	backlight = <&backlight_dsi>;
};
```

## Documentation/devicetree/bindings/display/panel/boe,hv070wsa-100.txt
```
BOE HV070WSA-100 7.01" WSVGA TFT LCD panel

Required properties:
- compatible: should be "boe,hv070wsa-100"

This binding is compatible with the simple-panel binding, which is specified
in simple-panel.txt in this directory.
```

## Documentation/devicetree/bindings/display/panel/edt,etm0700g0bdh6.txt
```
Emerging Display Technology Corp. ETM0700G0BDH6 7.0" WVGA TFT LCD panel

Required properties:
	compatible: "edt,etm0700g0bdh6"

This panel is exactly the same as ETM0700G0DH6 except the pixelclock polarity.

This binding is compatible with the simple-panel binding, which is specified
in simple-panel.txt in this directory.
```

## Documentation/devicetree/bindings/display/panel/huarui,lhr050h41.txt
```
Huarui LHR050H41 MIPI-DSI panel

Required properties:
  - compatible: "huarui,lhr050h41"
  - reg: DSI virtual channel used by that screen
  - power-gpios: a GPIO phandle for the power pin
  - reset-gpios: a GPIO phandle for the reset pin

Optional properties:
  - backlight: phandle to the backlight used

Example:
panel@0 {
	compatible = "huarui,lhr050h41";
	reg = <0>;
	power-gpios = <&pio 1 7 GPIO_ACTIVE_HIGH>; /* PB07 */
	reset-gpios = <&r_pio 0 5 GPIO_ACTIVE_LOW>; /* PL05 */
	backlight = <&pwm_bl>;
};
```

## Documentation/devicetree/bindings/display/panel/jdi,lt070me05000.txt
```
JDI model LT070ME05000 1200x1920 7" DSI Panel

Required properties:
- compatible: should be "jdi,lt070me05000"
- power-supply: phandle of the regulator that provides the supply voltage
  IOVCC , power supply for LCM (1.8V)
- vddp-supply: phandle of the regulator that provides the supply voltage
  Power IC supply (3-5V)
- dcdc_en-supply: phandle of the regulator that provides the supply voltage
  Power IC supply enable, High active
- reset-gpio: phandle of gpio for reset line
  This should be 8mA, gpio can be configured using mux and pinctrl.
  XRES, Reset, Low active
- enable-gpio: phandle of gpio for enable line
  LED_EN, LED backlight enable, High active
- vcc-gpio: phandle of regulator/gpio that provides the supply voltage
  VDD, LED power supply (3-5V)

Optional properties:
- pwm-gpio: phandle of gpio/pwm
  pwm backlight control, this should be mapped to the backlight level
  display brightness (0x51)

Example:

	dsi0: qcom,mdss_dsi@4700000 {
		panel@0 {
			compatible = "jdi,lt070me05000";
			reg = <0>;
			pinctrl-names = "default";
			pinctrl-0 = <&dsi_panel_pinctrl>;

			power-supply = <&pm8921_lvs5>;
			vddp-supply = <&pm8921_l17>;
			dcdc_en-supply = <&pm8921_lvs7>;

			reset-gpio = <&tlmm_pinmux 54 0>;
			enable-gpio = <&pm8921_gpio 36 GPIO_ACTIVE_HIGH>;
			vcc-gpio = <&pm8921_gpio 23 GPIO_ACTIVE_HIGH>;

			pwm-gpio = <&pm8921_gpio 26 GPIO_ACTIVE_HIGH>;
		};
	};
```

## Documentation/devicetree/bindings/display/panel/koe,tx31d200vm0baa.txt
```
Kaohsiung Opto-Electronics. TX31D200VM0BAA 12.3" HSXGA LVDS panel

Required properties:
- compatible: should be "koe,tx31d200vm0baa"

This binding is compatible with the simple-panel binding, which is specified
in simple-panel.txt in this directory.
```

## Documentation/devicetree/bindings/display/panel/logictechnologies,lttd800480070-l2rt.txt
```
LOGIC Technologies Inc. LTTD800x480 L2RT 7" (800x480 pixels) TFT LCD panel

Required properties:
- compatible: should be "logictechnologies,lttd800480070-l2rt"

This binding is compatible with the simple-panel binding, which is specified
in simple-panel.txt in this directory.
```
