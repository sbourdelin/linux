## Documentation/devicetree/bindings/ge/b850v3_lvds_dp.txt
```
Driver for GE B850v3 LVDS/DP++ display bridge

Required properties:
  - compatible : should be "ge,b850v3_lvds_dp".
  - reg : should contain the address used to ack the interrupts.
  - interrupt-parent : should link to the gpio used as interrupt
    source on the host.
  - interrupts : one interrupt should be described here, as in
    <0 IRQ_TYPE_LEVEL_HIGH>.
  - edid-reg : should contain the address used to read edid information
  - port : should describe the vide signal connection between the host
    and the bridge.

Example:

&mux2_i2c2 {
	status = "okay";
	clock-frequency = <100000>;

	b850v3_dp_bridge {
		compatible = "ge,b850v3_lvds_dp";
		#address-cells = <1>;
		#size-cells = <0>;

		reg = <0x73>;
		interrupt-parent = <&gpio2>;
		interrupts = <0 IRQ_TYPE_LEVEL_HIGH>;

		edid-reg = <0x72>;

		port@0 {
			reg = <0>;
			b850v3_dp_bridge_in: endpoint {
				remote-endpoint = <&lvds0_out>;
			};
		};
	};
};
```

## Documentation/devicetree/bindings/goldfish/google,goldfish-fb.txt
```
Android Goldfish framebuffer

Android Goldfish framebuffer device used by Android emulator.

Required properties:

- compatible : should contain "google,goldfish-fb"
- reg        : <registers mapping>
- interrupts : <interrupt mapping>

Example:

	goldfish_fb@1f008000 {
		compatible = "google,goldfish-fb";
		interrupts = <0x10>;
		reg = <0x1f008000 0x0 0x100>;
		compatible = "google,goldfish-fb";
	};
```

## Documentation/devicetree/bindings/gpio/brcm,bcm6345-gpio.txt
```
Bindings for the Broadcom's brcm,bcm6345-gpio memory-mapped GPIO controllers.

These bindings should only be used for BCM6338 and BCM6345 SoCs, since newer
ones need a proper pinctrl driver.
BCM6338 have 8-bit data and dirout registers, where GPIO state can be read
and/or written, and the direction changed from input to output.
BCM6345 have 16-bit data and dirout registers, where GPIO state can be read
and/or written, and the direction changed from input to output.

Required properties:
	- compatible: should be "brcm,bcm6345-gpio"
	- reg-names: must contain
		"dat" - data register
		"dirout" - direction (output) register
	- reg: address + size pairs describing the GPIO register sets;
		order must correspond with the order of entries in reg-names
	- #gpio-cells: must be set to 2. The first cell is the pin number and
			the second cell is used to specify the gpio polarity:
			0 = active high
			1 = active low
	- gpio-controller: Marks the device node as a gpio controller.

Optional properties:
	- big-endian: Memory is big endian.

Examples:
	- BCM6338:
	gpio0: gpio-controller@fffe0407 {
		compatible = "brcm,bcm6345-gpio";
		reg-names = "dirout", "dat";
		reg = <0xfffe0407 1>, <0xfffe040f 1>;

		#gpio-cells = <2>;
		gpio-controller;
	};

	- BCM6345:
	gpio0: gpio-controller@fffe0406 {
		compatible = "brcm,bcm6345-gpio";
		reg-names = "dirout", "dat";
		reg = <0xfffe0406 2>, <0xfffe040a 2>;
		big-endian;

		#gpio-cells = <2>;
		gpio-controller;
	};
```

## Documentation/devicetree/bindings/gpio/cdns,gpio.txt
```
Cadence GPIO controller bindings

Required properties:
- compatible: should be "cdns,gpio-r1p02".
- reg: the register base address and size.
- #gpio-cells: should be 2.
  * first cell is the GPIO number.
  * second cell specifies the GPIO flags, as defined in
    <dt-bindings/gpio/gpio.h>. Only the GPIO_ACTIVE_HIGH and GPIO_ACTIVE_LOW
    flags are supported.
- gpio-controller: marks the device as a GPIO controller.
- clocks: should contain one entry referencing the peripheral clock driving the
  GPIO controller.

Optional properties:
- interrupt-parent: phandle of the parent interrupt controller.
- interrupts: interrupt specifier for the controllers interrupt.
- interrupt-controller: marks the device as an interrupt controller. When
  defined, interrupts, interrupt-parent and #interrupt-cells are required.
- interrupt-cells: should be 2.
  * first cell is the GPIO number you want to use as an IRQ source.
  * second cell specifies the IRQ type, as defined in
    <dt-bindings/interrupt-controller/irq.h>.

Example:

	gpio-controller@d050000 {
		compatible = "cdns,gpio";
		reg = <0xd050000 0x10000>;

		clocks = <&gpio_pclk>;

		interrupt-parent = <&intc>;
		interrupts = <4 IRQ_TYPE_LEVEL_HIGH>;

		gpio-controller;
		#gpio-cells = <2>;

		interrupt-controller;
		#interrupt-cells = <2>;
	};
```

## Documentation/devicetree/bindings/gpio/gpio-lmp92001.txt
```
* Texas Instruments' LMP92001 GPIOs

Required properties:
 - compatible: Must be set to "ti,lmp92001-gpio".
 - reg: i2c chip address for the device.
 - gpio-controller: Marks the device node as a gpio controller.
 - #gpio-cells : Should be two.  The first cell is the pin number and the
  second cell is used to specify the gpio polarity:
        0 = Active high
        1 = Active low

Example:
lmp92001@20 {
        compatible = "ti,lmp92001";
        reg = <0x20>;

        lmp92001_gpio: lmp92001-gpio {
                compatible = "ti,lmp92001-gpio";
                gpio-controller;
                #gpio-cells = <2>;
        };
};
```

## Documentation/devicetree/bindings/gpio/gpio-madera.txt
```
Cirrus Logic Madera class audio codecs gpio driver

This is a subnode of the parent mfd node.

See also the core bindings for the parent MFD driver:
See Documentation/devicetree/bindings/mfd/madera.txt

Required properties:
  - compatible : must be "cirrus,madera-gpio"
  - gpio-controller : Indicates this device is a GPIO controller.
  - #gpio-cells : Must be 2. The first cell is the pin number. The second cell
    is reserved for future use and must be zero

Example:

codec: cs47l85@0 {
	compatible = "cirrus,cs47l85";

	gpio {
		compatible = "cirrus,madera-gpio";
		gpio-controller;
		#gpio-cells = <2>;
	}
};
```

## Documentation/devicetree/bindings/gpio/gpio-max77650.txt
```
GPIO driver for MAX77650 PMIC from Maxim Integrated.

This module is part of the MAX77650 MFD device. For more details
see Documentation/devicetree/bindings/mfd/max77650.txt.

The GPIO controller is represented as a sub-node of the PMIC node on
the device tree.

This device has a single GPIO pin.

Required properties:
--------------------
- compatible:		Must be "maxim,max77650-gpio"
- gpio-controller : 	Marks the device node as a gpio controller.
- #gpio-cells : 	Must be <2>. The first cell is the pin number and
			the second cell is used to specify the gpio active
			state.

Optional properties:
--------------------
gpio-line-names:	Single string containing the name of the GPIO line.

For more details, please refer to the generic GPIO DT binding document
<devicetree/bindings/gpio/gpio.txt>.

Example:
--------

	gpio {
		compatible = "maxim,max77650-gpio";
		gpio-line-names = "max77650-charger";
		gpio-controller;
		#gpio-cells = <2>;
	};
```

## Documentation/devicetree/bindings/gpio/gpio-mmio.txt
```
Bindings for the generic driver for memory-mapped GPIO controllers.

Required properties:
	- compatible: should be "linux,gpio-mmio"
	- reg-names: must contain
		"dat" - data register
		may contain
		"set" - data set register
		"clr" - data clear register
		"dirout" - direction output register
		"dirin" - direction input register
	- reg: address + size pairs describing the GPIO register sets;
		order must correspond with the order of entries in reg-names
	- #gpio-cells = must be set to 2
	- gpio-controller: Marks the device node as a gpio controller.

Optional properties:
	- ngpio: specifies the number of gpio mapped in the register.
	- big-endian: force big endian register accesses.
	- big-endian-byte-order: assign GPIOs in reverse order.
	- unreadable-reg-set: data set register is not readable.
	- read-output-reg-set: cache value set for reads.
	- unreadable-reg-dir: dirout/dirin register is not readable.
	- no-output: GPIOs are read-only.

The GPIO generic library provides support for memory-mapped GPIO
controllers. The configuration is detected by which resources are present.
The simplest form of a GPIO controller that the driver support is just a
single "dat" register, where GPIO state can be read and/or written.
However, the driver supports far more:
	- 8/16/32/64 bits registers. The number of GPIOs is automatically
	  determined by the width of the registers.
	- GPIO controllers with clear/set registers.
	- GPIO controllers with a single "dat" register.
	- Big endian bits/GPIOs ordering.

For setting GPIO's there are three configurations:
	1. single input/output register resource (named "dat"),
	2. set/clear pair (named "set" and "clr"),
	3. single output register resource and single input resource
	   ("set" and dat").

For setting the GPIO direction, there are three configurations:
	a. simple bidirectional GPIOs that requires no configuration.
	b. an output direction register (named "dirout")
	   where a 1 bit indicates the GPIO is an output.
	c. an input direction register (named "dirin")
	   where a 1 bit indicates the GPIO is an input.

Examples:

	/* Configuration for single input/output register
	 * for eight simple bidirectional GPIOs.
	 */
	gpio_a_1 {
		compatible = "linux,gpio-mmio";
		reg = <0x18000000 0x1>;
		reg-names = "dat";
		#gpio-cells = <2>;
		gpio-controller;
	};

	/* Configuration for set/clear pair registers with
	 * 32 output direction register GPIOs.
	 */
	gpio_b_2 {
		compatible = "linux,gpio-mmio";
		reg = <0x18000000 0x4>, <0x18000010 0x4>,
		      <0x18000004 0x4>, <0x18000008 0x4>;
		reg-names = "dat", "set", "clr", "dirout";
		#gpio-cells = <2>;
		gpio-controller;
	};
```

## Documentation/devicetree/bindings/gpio/gpio-moxtet.txt
```
Turris Mox Moxtet GPIO expander

Required properties:
 - compatible		: Should be "cznic,moxtet-gpio".
 - gpio-controller	: Marks the device node as a GPIO controller.
 - #gpio-cells		: Should be two. For consumer use see gpio.txt.
 - moxtet,input-mask	: Bitmask. Those bits which correspond to input GPIOs
			  when read from Moxtet bus should be set here.
			  For example if bit 0 and bit 3 are input GPIO bits,
			  this should be set to 0x9.
			  Since there are only 4 input bits, 0xf is max value.
 - moxtet,output-mask	: Bitmask. Those bits which correspond to output GPIOs
			  when written to Moxtet bus should be set here.
			  For example if bit 1 and bit 6 are output GPIO bits,
			  this should be set to 0x41.
			  Since there are at most 8 output bits, 0xff is max
			  value.
Other properties are required for a moxtet bus device, please refer to
Documentation/devicetree/bindings/mfd/moxtet.txt.

Example:

	moxtet_sfp: moxtet-sfp@0 {
		compatible = "cznic,moxtet-gpio";
		gpio-controller;
		#gpio-cells;
		reg = <0>;
		moxtet,id = <1>;
		moxtet,input-mask = <0x7>;
		moxtet,output-mask = <0x3>;
	}
```

## Documentation/devicetree/bindings/gpio/gpio-raspberrypi-firmware.txt
```
Raspberry Pi power domain driver

Required properties:

- compatible:		Should be "raspberrypi,firmware-gpio"
- gpio-controller:	Marks the device node as a gpio controller
- #gpio-cells:		Should be <2> for GPIO number and flags
- ngpios:		Number of GPIO lines to control.  See gpio.txt
- firmware:		Reference to the RPi firmware device node
- raspberrypi,firmware-gpio-offset:
			Number the firmware uses for the first GPIO line
			  controlled by this driver

Example:
fxl6408: firmware-gpio-128 {
	compatible = "raspberrypi,firmware-gpio";
	gpio-controller;
	#gpio-cells = <2>;
	firmware = <&firmware>;
	ngpios = <8>;
	raspberrypi,firmware-gpio-offset = <128>;
};
```

## Documentation/devicetree/bindings/gpio/gpio-sama5d2-piobu.txt
```
GPIO controller for SAMA5D2 PIOBU pins.

These pins have the property of not losing their voltage
during Backup/Self-refresh mode.

These bindings should be set to a node in the dtsi file.

Required properties:
- compatible:		"syscon", "microchip,sama5d2-piobu"
- #gpio-cells:		There are 2. The pin number is the
			first, the second represents additional
			parameters such as GPIO_ACTIVE_HIGH/LOW.
- gpio-controller:	Marks the port as GPIO controller.

Note that the driver uses syscon and should be the child of
the syscon node.

Example:

	secumod@fc040000 {
		compatible = "atmel,sama5d2-secumod", "syscon", "simple-mfd";
		status = "okay";
		reg = <0xfc040000 0x100>;

		pioBU: piobu {
			status = "okay";
			compatible = "microchip,sama5d2-piobu";
			gpio-controller;
			#gpio-cells = <2>;
		};
	};
```

## Documentation/devicetree/bindings/gpio/gpio-thunderx.txt
```
Cavium ThunderX/OCTEON-TX GPIO controller bindings

Required Properties:
- reg: The controller bus address.
- gpio-controller: Marks the device node as a GPIO controller.
- #gpio-cells: Must be 2.
  - First cell is the GPIO pin number relative to the controller.
  - Second cell is standard of_gpio_flags:
     1 - Active Low.
     2 - Single Ended.

Optional Properties:
- compatible: "cavium,thunder-8890-gpio", unused as PCI driver binding is used.
- interrupt-controller: Marks the device node as an interrupt controller.
- #interrupt-cells: Must be present and have value of 2 if
                    "interrupt-controller" is present.
  - First cell is the GPIO pin number relative to the controller.
  - Second cell is triggering flags, one of:
    1 - Edge Rising
    2 - Edge Falling
    4 - Level High
    8 - Level Low

Example:

gpio_6_0: gpio0@6,0 {
	compatible = "cavium,thunder-8890-gpio";
	reg = <0x3000 0 0 0 0>; /*  DEVFN = 0x30 (6:0) */
	gpio-controller;
	#gpio-cells = <2>;
	interrupt-controller;
	#interrupt-cells = <2>;
};
```

## Documentation/devicetree/bindings/gpio/gpio-tps65912.txt
```
* TPS65912 GPIO Controller bindings

Required properties:
 - compatible		: Should be "ti,tps65912-gpio".
 - gpio-controller	: Marks the device node as a GPIO Controller.
 - #gpio-cells		: Should be two.  The first cell is the pin number and
			    the second cell is used to specify flags.
			    See ../gpio/gpio.txt for more information.

Example:

	gpio4: gpio {
		compatible = "ti,tps65912-gpio";
		gpio-controller;
		#gpio-cells = <2>;
	};
```

## Documentation/devicetree/bindings/gpio/gpio-uniphier.txt
```
UniPhier GPIO controller

Required properties:
- compatible: Should be "socionext,uniphier-gpio".
- reg: Specifies offset and length of the register set for the device.
- gpio-controller: Marks the device node as a GPIO controller.
- #gpio-cells: Should be 2.  The first cell is the pin number and the second
  cell is used to specify optional parameters.
- interrupt-parent: Specifies the parent interrupt controller.
- interrupts: Specifies interrupts connected to the parent interrupt controller.
- interrupt-controller: Marks the device node as an interrupt controller.
- #interrupt-cells: Should be 2.  The first cell defines the interrupt number.
  The second cell bits[3:0] is used to specify trigger type as follows:
    1 = low-to-high edge triggered
    2 = high-to-low edge triggered
    4 = active high level-sensitive
    8 = active low level-sensitive
  Valid combinations are 1, 2, 3, 4, 8.
- ngpios: Specifies the number of GPIO lines.
- gpio-ranges: Mapping to pin controller pins (as described in gpio.txt)

Optional properties:
- gpio-ranges-group-names: Used for named gpio ranges (as described in gpio.txt)

Example:
	gpio: gpio@55000000 {
		compatible = "socionext,uniphier-gpio";
		reg = <0x55000000 0x200>;
		interrupt-parent = <&aidet>;
		interrupts = <48 0>, <49 0>, <50 0>, <51 0>,
			     <52 0>, <53 0>, <54 0>, <55 0>,
			     <56 0>, <57 0>, <58 0>, <59 0>,
			     <60 0>, <61 0>, <62 0>, <63 0>,
			     <154 0>, <155 0>, <156 0>, <157 0>,
			     <158 0>;
		interrupt-controller;
		#interrupt-cells = <2>;
		gpio-controller;
		#gpio-cells = <2>;
		gpio-ranges = <&pinctrl 0 0 0>;
		gpio-ranges-group-names = "gpio_range";
		ngpios = <248>;
	};
```
