## Documentation/devicetree/bindings/gpio/gpio-xra1403.txt
```
GPIO Driver for XRA1403 16-BIT GPIO Expander With Reset Input from EXAR

The XRA1403 is an 16-bit GPIO expander with an SPI interface. Features available:
	- Individually programmable inputs:
		- Internal pull-up resistors
		- Polarity inversion
		- Individual interrupt enable
		- Rising edge and/or Falling edge interrupt
		- Input filter
	- Individually programmable outputs
		- Output Level Control
		- Output Three-State Control

Properties
----------
Check documentation for SPI and GPIO controllers regarding properties needed to configure the node.

	- compatible = "exar,xra1403".
	- reg = SPI id of the device.
	- gpio-controller: mark the node as gpio.

Optional properties:
-------------------
	- reset-gpios: in case available used to control the device reset line.

Example
--------

	gpioxra0: gpio@2 {
		compatible = "exar,xra1403";
		reg = <2>;
		gpio-controller;
		#gpio-cells = <2>;
		reset-gpios = <&gpio3 6 GPIO_ACTIVE_LOW>;
		spi-max-frequency = <1000000>;
		status = "okay";
	};
```

## Documentation/devicetree/bindings/gpio/ingenic,gpio.txt
```
Ingenic jz47xx GPIO controller

That the Ingenic GPIO driver node must be a sub-node of the Ingenic pinctrl
driver node.

Required properties:
--------------------

 - compatible: Must contain one of:
    - "ingenic,jz4740-gpio"
    - "ingenic,jz4770-gpio"
    - "ingenic,jz4780-gpio"
	And one of:
	- "ingenic,gpio-bank-a"
	- "ingenic,gpio-bank-b"
	- "ingenic,gpio-bank-c"
	- "ingenic,gpio-bank-d"
	- "ingenic,gpio-bank-e" (for SoC version > jz4740)
	- "ingenic,gpio-bank-f" (for SoC version > jz4740)
 - interrupt-controller: Marks the device node as an interrupt controller.
 - interrupts: Interrupt specifier for the controllers interrupt.
 - #interrupt-cells: Should be 2. Refer to
   ../interrupt-controller/interrupts.txt for more details.
 - gpio-controller: Marks the device node as a GPIO controller.
 - #gpio-cells: Should be 2. The first cell is the GPIO number and the second
    cell specifies GPIO flags, as defined in <dt-bindings/gpio/gpio.h>. Only the
    GPIO_ACTIVE_HIGH and GPIO_ACTIVE_LOW flags are supported.
 - gpio-ranges: Range of pins managed by the GPIO controller. Refer to
   'gpio.txt' in this directory for more details.

Example:
--------

&pinctrl {
	gpa: gpio-controller@0 {
		compatible = "ingenic,gpio-bank-a", "ingenic,jz4740-gpio";

		gpio-controller;
		gpio-ranges = <&pinctrl 0 0 32>;
		#gpio-cells = <2>;

		interrupt-controller;
		#interrupt-cells = <2>;

		interrupt-parent = <&intc>;
		interrupts = <28>;
	};
};
```

## Documentation/devicetree/bindings/gpio/jnx,gpio-ptxpmb-cpld.txt
```
Juniper PTXPMB CPLD GPIO block

Required properties:

- compatible:
    Must be "jnx,gpio-ptxpmb-cpld"

- #gpio-cells:
    Should be <2>.  The first cell is the pin number (within the controller's
    pin space), and the second is used for the following flags:
	bit[0]: direction (0 = out, 1 = in)
	bit[1]: init high
	bit[2]: active low

- gpio-controller:
    Specifies that the node is a GPIO controller.

Optional properties:

- reg:
    Address and length of the register set for the device. Usually supplied by
    the parent MFD driver

Example:

gpio_cpld: cpld_gpio {
	compatible = "jnx,gpio-ptxpmb-cpld";
	#gpio-cells = <2>;
	gpio-controller;
};
```

## Documentation/devicetree/bindings/gpio/rockchip,rk3328-gpio-mute.txt
```
Rockchip RK3328 GPIO controller dedicated for the GPIO_MUTE pin.

In Rockchip RK3328, the output only GPIO_MUTE pin, originally for codec mute
control, can also be used for general purpose. It is manipulated by the
GRF_SOC_CON10 register.

Required properties:
- compatible: Should contain "rockchip,rk3328-gpio-mute".
- gpio-controller: Marks the device node as a gpio controller.
- #gpio-cells: Should be 2. The first cell is the pin number and
  the second cell is used to specify the gpio polarity:
    0 = Active high,
    1 = Active low.

Example:

	grf: syscon@ff100000 {
		compatible = "rockchip,rk3328-grf", "syscon", "simple-mfd";

		gpio_mute: gpio-mute {
			compatible = "rockchip,rk3328-gpio-mute";
			gpio-controller;
			#gpio-cells = <2>;
		};
	};

Note: The gpio_mute node should be declared as the child of the GRF (General
Register File) node. The GPIO_MUTE pin is referred to as <&gpio_mute 0>.
```

## Documentation/devicetree/bindings/gpio/snps,creg-gpio.txt
```
Synopsys GPIO via CREG (Control REGisters) driver

Required properties:
- compatible : "snps,creg-gpio-hsdk" or "snps,creg-gpio-axs10x".
- reg : Exactly one register range with length 0x4.
- #gpio-cells : Should be one - the pin number.
- gpio-controller : Marks the device node as a GPIO controller.
- ngpios : Number of GPIO pins.

Example:

gpio: gpio@f00014b0 {
	compatible = "snps,creg-gpio-hsdk";
	reg = <0xf00014b0 0x4>;
	gpio-controller;
	#gpio-cells = <1>;
	ngpios = <2>;
};
```

## Documentation/devicetree/bindings/gpu/samsung-scaler.txt
```
* Samsung Exynos Image Scaler

Required properties:
  - compatible : value should be one of the following:
	(a) "samsung,exynos5420-scaler" for Scaler IP in Exynos5420

  - reg : Physical base address of the IP registers and length of memory
	  mapped region.

  - interrupts : Interrupt specifier for scaler interrupt, according to format
		 specific to interrupt parent.

  - clocks : Clock specifier for scaler clock, according to generic clock
	     bindings. (See Documentation/devicetree/bindings/clock/exynos*.txt)

  - clock-names : Names of clocks. For exynos scaler, it should be "mscl".

Example:
	scaler@12800000 {
		compatible = "samsung,exynos5420-scaler";
		reg = <0x12800000 0x1294>;
		interrupts = <0 220 IRQ_TYPE_LEVEL_HIGH>;
		clocks = <&clock CLK_MSCL0>;
		clock-names = "mscl";
	};
```

## Documentation/devicetree/bindings/hwmon/adcxx.txt
```
adcxx properties

Required properties:
- compatible: Must be one of the following:
	- "national,adcxx1s" for adcxx1s
	- "national,adcxx2s" for adcxx2s
	- "national,adcxx4s" for adcxx4s
	- "national,adcxx8s" for adcxx8s
- reg: SPI address for chip

Optional properties:

- vref-supply
  The external reference in microvolt for this device is set to this value.
  If it does not exists the reference will be set to 3300000uV (3.3V).

Example:

adc@6 {
	compatible = "national,adcxx2s";
	reg = <6 0>;
	spi-max-frequency = <1000000>;
	vref-supply = <&vref>;
};
```

## Documentation/devicetree/bindings/hwmon/adt7475.txt
```
*ADT7475 hwmon sensor.

Required properties:
- compatible: One of
	"adi,adt7473"
	"adi,adt7475"
	"adi,adt7476"
	"adi,adt7490"

- reg: I2C address

optional properties:

- pwm-polarity: This configures the polarity of the PWM. 0
		(PWM_POLARITY_NORMAL) uses logic high for 100% duty cycle. 1
                (PWM_POLARITY_INVERSED) uses logic low for 100% duty cycle.

Example:

hwmon@2e {
	compatible = ;
	reg = <0x2e>;
	pwm-polarity = <1>;
};
```

## Documentation/devicetree/bindings/hwmon/apm-xgene-hwmon.txt
```
APM X-Gene hwmon driver

Hwmon driver accesses sensors over the "SLIMpro" mailbox.

Required properties :
 - compatible : should be "apm,xgene-slimpro-hwmon"
 - mboxes : use the label reference for the mailbox as the first parameter.
	    The second parameter is the channel number.

Example :
	hwmonslimpro {
		compatible = "apm,xgene-slimpro-hwmon";
		mboxes = <&mailbox 7>;
	};
```

## Documentation/devicetree/bindings/hwmon/aspeed-pwm-tacho.txt
```
ASPEED AST2400/AST2500 PWM and Fan Tacho controller device driver

The ASPEED PWM controller can support upto 8 PWM outputs. The ASPEED Fan Tacho
controller can support upto 16 Fan tachometer inputs.

There can be upto 8 fans supported. Each fan can have one PWM output and
one/two Fan tach inputs.

Required properties for pwm-tacho node:
- #address-cells : should be 1.

- #size-cells : should be 1.

- reg : address and length of the register set for the device.

- pinctrl-names : a pinctrl state named "default" must be defined.

- pinctrl-0 : phandle referencing pin configuration of the PWM ports.

- compatible : should be "aspeed,aspeed2400-pwm-tacho" for AST2400 or
	       "aspeed,aspeed2500-pwm-tacho" for AST2500.

- clocks : a fixed clock providing input clock frequency(PWM
	   and Fan Tach clock)

fan subnode format:
========================
Under fan subnode there can upto 8 child nodes, with each child node
representing a fan. If there are 8 fans each fan can have one PWM port and
one/two Fan tach inputs.

Required properties for each child node(starting from PWM A through PWM H):
- pwm-port : should specify PWM source port.
	     integer value in the range 0 to 7 with 0 indicating PWM port
	     A and 7 indicating PWM port H.

- fan-ctrl-gpios : should specify the tachometer input GPIO pin on the hardware.
		   Fan Tachometer function can only work when GPIO is in
		   ”input mode”.

- fan-tach-ch : should specify the Fan tach input channel.
	        integer value in the range 0 through 15, with 0 indicating
		Fan tach channel 0 and 15 indicating Fan tach channel 15.

Examples:

pwm-tacho-fixed-clk: fixedclk {
	compatible = "fixed-clock";
	#clock-cells = <0>;
	clock-frequency = <24000000>;
}

pwm-tacho: pwm-tacho-controller@1e786000 {
	#address-cells = <1>;
	#size-cells = <1>;
	reg = <0x1E786000 0x1000>;
	compatible = "aspeed,aspeed2500-pwm-tacho";
	clocks = <&pwm-tacho-fixed-clk>;
	pinctrl-names = "default";
	pinctrl-0 = <&pinctrl_pwm0_default &pinctrl_pwm1_default>;

	fan0 {
		pwm-port = /bits/ 8 <0x00>;
		fan-ctrl-gpios = <&gpio ASPEED_GPIO(O, 0) GPIO_ACTIVE_HIGH>;
		fan-tach-ch = /bits/ 8 <0x00>;
	};

	fan1 {
		pwm-port = /bits/ 8 <0x01>;
		fan-ctrl-gpios = <&gpio ASPEED_GPIO(O, 1) GPIO_ACTIVE_HIGH>;
		fan-tach-ch = /bits/ 8 <0x01>;
	};
};
```

## Documentation/devicetree/bindings/hwmon/aspeed_adc.txt
```
Aspeed AST2400/2500 ADC

This device is a 10-bit converter for 16 voltage channels.  All inputs are
single ended.  Each channel can be individually enabled to allow for use of
alternate pin functions.

1) adc node

  Required properties:
  - compatible : Should be one of
	"aspeed,ast2400-adc"
	"aspeed,ast2500-adc"
  - reg : memory window mapping address and length
  - #address-cells : must be <1> corresponding to the channel child binding
  - #size-cells : must be <0> corresponding to the channel child binding
  - clocks : Input clock used to derive the sample clock. Expected to be the
    SoC's APB clock.
  - update-interval-ms : initial time between updates on a channel

  The node contains child nodes for each channel that the platform uses.

  Example adc node:
    adc@1e6e9000 {
	#address-cells = <1>;
	#size-cells = <0>;
	compatible = "aspeed,ast2400-adc";
	reg = <0x1e6e9000 0xB0>;
	clocks = <&clk_apb>;
	update-interval-ms = <100>;

	[ child node definitions... ]
    };

2) channel nodes

  Optional properties:
  - status: indicates the operational status of the device.
    Value must be either "disabled" or "okay".
  - label : string describing the monitored value

  Example channel node:
  channel@1 {
	status = "okay";
	label = "3V3 rail";

	pinctrl-names = "default";
	pinctrl-0 = <&pinctrl_adc0_default>;
  };
```
