## Documentation/devicetree/bindings/hwmon/ti-lmu-hwmon.txt
```
TI LMU Hardware Monotoring device tree bindings

LMU HWON driver monitors hardware fault situation of LMU devices,
LM3633 and LM3697.

Required properties:
  - compatible: Should be one of lists below.
                "ti,lm3633-hwmon"
                "ti,lm3697-hwmon"

Examples: Please refer to ti-lmu dt-bindings.
          Documentation/devicetree/bindings/mfd/ti-lmu.txt
```

## Documentation/devicetree/bindings/hwmon/tmp108.txt
```
TMP108 temperature sensor
-------------------------

This device supports I2C only.

Requires node properties:
- compatible : "ti,tmp108"
- reg : the I2C address of the device. This is 0x48, 0x49, 0x4a, or 0x4b.

Optional node properties:
- ti,thermostat-mode-comparitor : (boolean) select the comparitor mode for the
      thermostat rather than the default interrupt-mode.
- ti,alert-active-high : (boolean) make the alert pin active-high instead of
      the default active-low.
- ti,conversion-rate-cHz : (integer, cHz) select the conversion frequency for
      continuous mode, in centi-Hz: 25, 100 (default), 400, or 1600.
- ti,hysteresis : (integer, C) select the hysteresis value: 0, 1, 2, or 4
      (celcius).

Example:
	tmp108@48 {
		compatible = "ti,tmp108";
		reg = <0x48>;
		ti,alert-active-high;
		ti,hysteresis = <2>;
		ti,conversion-rate-cHz = <25>;
	};
```

## Documentation/devicetree/bindings/i2c/i2c-arb-pca9541.txt
```
* NXP PCA9541 I2C bus master selector

Required Properties:

  - compatible: Must be "nxp,pca9541"

  - reg: The I2C address of the device.

  The following required properties are defined externally:

  - Standard I2C mux properties. See i2c-mux.txt in this directory.
  - I2C child bus nodes. See i2c-mux.txt in this directory.


Example:

	i2c-arbitrator@74 {
		compatible = "nxp,pca9541";
		#address-cells = <1>;
		#size-cells = <0>;
		reg = <0x74>;

		i2c@0 {
			#address-cells = <1>;
			#size-cells = <0>;
			reg = <0>;

			eeprom@54 {
				compatible = "at,24c08";
				reg = <0x54>;
			};
		};
	};
```

## Documentation/devicetree/bindings/i2c/i2c-fsi.txt
```
Device-tree bindings for FSI-attached I2C master driver
-------------------------------------------------------

Required properties:
 - compatible = "ibm,i2cm-fsi";
 - reg = < address size >;		: The FSI CFAM address and address space
					  size.
 - #address-cells = <1>;		: Number of address cells in child nodes
 - #size-cells = <0>;			: Number of size cells in child nodes.
 - child nodes				: Nodes to describe ports off the I2C
					  master.

Child node required properties:
 - reg = < port number >		: The port number on the I2C master.

Examples:

    i2cm@1800 {
        compatible = "ibm,i2cm-fsi";
        reg = < 0x1800 0x400 >;
        #address-cells = <1>;
        #size-cells = <0>;

        port@0 {
            reg = <0>;
        };

        port@1 {
            reg = <1>;
        };
    };
```

## Documentation/devicetree/bindings/i2c/i2c-gate.txt
```
Common i2c gate properties.

- i2c-gate child node

Required properties for the i2c-gate child node:
- #address-cells = <1>;
- #size-cells = <0>;

Optional properties for i2c-gate child node:
- Child nodes conforming to i2c bus binding


Example :

	/*
	   An Invensense mpu9150 at address 0x68 featuring an on-chip Asahi
	   Kasei ak8975 compass behind a gate.
	 */

	mpu9150@68 {
		compatible = "invensense,mpu9150";
		reg = <0x68>;
		interrupt-parent = <&gpio1>;
		interrupts = <18 1>;

		i2c-gate {
			#address-cells = <1>;
			#size-cells = <0>;

			ax8975@0c {
				compatible = "ak,ak8975";
				reg = <0x0c>;
			};
		};
	};
```

## Documentation/devicetree/bindings/i2c/i2c-pca-platform.txt
```
* NXP PCA PCA9564/PCA9665 I2C controller

The PCA9564/PCA9665 serves as an interface between most standard
parallel-bus microcontrollers/microprocessors and the serial I2C-bus
and allows the parallel bus system to communicate bi-directionally
with the I2C-bus.

Required properties :

 - reg : Offset and length of the register set for the device
 - compatible : one of "nxp,pca9564" or "nxp,pca9665"

Optional properties
 - interrupts : the interrupt number
 - interrupt-parent : the phandle for the interrupt controller.
   If an interrupt is not specified polling will be used.
 - reset-gpios : gpio specifier for gpio connected to RESET_N pin.
 - clock-frequency : I2C bus frequency.
```

## Documentation/devicetree/bindings/i2c/i2c-stm32.txt
```
* I2C controller embedded in STMicroelectronics STM32 I2C platform

Required properties :
- compatible : Must be one of the following
  - "st,stm32f4-i2c"
  - "st,stm32f7-i2c"
- reg : Offset and length of the register set for the device
- interrupts : Must contain the interrupt id for I2C event and then the
  interrupt id for I2C error.
- resets: Must contain the phandle to the reset controller.
- clocks: Must contain the input clock of the I2C instance.
- A pinctrl state named "default" must be defined to set pins in mode of
  operation for I2C transfer
- #address-cells = <1>;
- #size-cells = <0>;

Optional properties :
- clock-frequency : Desired I2C bus clock frequency in Hz. If not specified,
  the default 100 kHz frequency will be used.
  For STM32F4 SoC Standard-mode and Fast-mode are supported, possible values are
  100000 and 400000.
  For STM32F7 SoC, Standard-mode, Fast-mode and Fast-mode Plus are supported,
  possible values are 100000, 400000 and 1000000.
- st,i2c-timing : A 32-bit I2C timing refister value.
  This value is only required for "st,stm32f7-i2c".
  A specific external tool delivered by ST is used to compute the value to be
  set here according to i2C speed frequency, i2c clock source frequency,
  i2c rise time and i2c fall time inputs.
  - bit 31:28: PRESC[3:0]: Timing prescaler
  - bit 27:24: Reserved
  - bit 23:20: SCLDEL[3:0]: Data setup time
  - bit 19:16: SDADEL[3:0]: Data hold time
  - bit 15:8:  SCLH[7:0]: SCL high period
  - bit 7:0:   SCLL[7:0]: SCL low period

Example :

	i2c@40005400 {
		compatible = "st,stm32f4-i2c";
		#address-cells = <1>;
		#size-cells = <0>;
		reg = <0x40005400 0x400>;
		interrupts = <31>,
			     <32>;
		resets = <&rcc 277>;
		clocks = <&rcc 0 149>;
		pinctrl-0 = <&i2c1_sda_pin>, <&i2c1_scl_pin>;
		pinctrl-names = "default";
	};
```

## Documentation/devicetree/bindings/i2c/jnx,i2c-mux-ptxpmb-cpld.txt
```
* Juniper PTXPMB CPLD I2C Mux

I2C mux on the PTXPMB CPLD on Juniper series of routers.

Required properties:

  - compatible: Must contain one of the following.
    "jnx,i2c-mux-ptxpmb-cpld", "jnx,i2c-mux-ngpmb-bcpld"
  - num-enable: Number of muxes to enable.

  The following required properties are defined externally:

  - Standard I2C mux properties. See i2c-mux.txt in this directory.
  - I2C child bus nodes. See i2c-mux.txt in this directory.

Optional Properties:

  - num-channels: Number of channels. If not present the default is 8.
  - base-bus-num: Base bus number. If not present it is 0.
  - use-force: Use the force method of the controller.


Example:

cpld-i2c-mux {
	compatible = "jnx,i2c-mux-ptxpmb-cpld";
	#address-cells = <1>;
	#size-cells = <0>;

	i2c-parent = <&i2c1>;

	num-enable = <1>;

	i2c@0 {
		reg = <0>;
		#address-cells = <1>;
		#size-cells = <0>;

		/* PMB devices are accessed through FPC */

		temp-sensor@1a { /* FPC */
			compatible = "maxim,max6697";
			reg = <0x1a>;
			smbus-timeout-disable;
			resistance-cancellation;
			alert-mask = <0xff>;
			over-temperature-mask = <0xff>;
		};
	};
};
```

## Documentation/devicetree/bindings/i3c/i3c.txt
```
Generic device tree bindings for I3C busses
===========================================

This document describes generic bindings that should be used to describe I3C
busses in a device tree.

Required properties
-------------------

- #address-cells  - should be <1>. Read more about addresses below.
- #size-cells     - should be <0>.
- compatible      - name of I3C bus controller following generic names
		    recommended practice.

For other required properties e.g. to describe register sets,
clocks, etc. check the binding documentation of the specific driver.

Optional properties
-------------------

These properties may not be supported by all I3C master drivers. Each I3C
master bindings should specify which of them are supported.

- i3c-scl-frequency: frequency (in Hz) of the SCL signal used for I3C
		     transfers. When undefined the core set it to 12.5MHz.

- i2c-scl-frequency: frequency (in Hz) of the SCL signal used for I2C
		     transfers. When undefined, the core looks at LVR values
		     of I2C devices described in the device tree to determine
		     the maximum I2C frequency.

I2C devices
===========

Each I2C device connected to the bus should be described in a subnode with
the following properties:

All properties described in Documentation/devicetree/bindings/i2c/i2c.txt are
valid here.

New required properties:
------------------------
- i3c-lvr: 32 bits integer property (only the lowest 8 bits are meaningful)
	   describing device capabilities as described in the I3C
	   specification.

	   bit[31:8]: unused
	   bit[7:5]: I2C device index. Possible values
	    * 0: I2C device has a 50 ns spike filter
	    * 1: I2C device does not have a 50 ns spike filter but supports high
		 frequency on SCL
	    * 2: I2C device does not have a 50 ns spike filter and is not
		 tolerant to high frequencies
	    * 3-7: reserved

	   bit[4]: tell whether the device operates in FM or FM+ mode
	    * 0: FM+ mode
	    * 1: FM mode

	   bit[3:0]: device type
	    * 0-15: reserved

I3C devices
===========

I3C are not described in the device tree yet. We could decide to represent them
at some point to assign a specific dynamic address to a device or to force an
I3C device to act as an I2C device if it has a static address.

Example:

	i3c-master@0d040000 {
		compatible = "cdns,i3c-master";
		clocks = <&coreclock>, <&i3csysclock>;
		clock-names = "pclk", "sysclk";
		interrupts = <3 0>;
		reg = <0x0d040000 0x1000>;
		#address-cells = <1>;
		#size-cells = <0>;

		status = "okay";
		i2c-scl-frequency = <100000>;

		nunchuk: nunchuk@52 {
			compatible = "nintendo,nunchuk";
			reg = <0x52>;
			i3c-lvr = <0x10>;
		};
	};
```
