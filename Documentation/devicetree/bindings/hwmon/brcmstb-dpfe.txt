## Documentation/devicetree/bindings/hwmon/brcmstb-dpfe.txt
```
DDR PHY Front End (DPFE) for Broadcom STB
=========================================

DPFE and the DPFE firmware provide an interface for the host CPU to
communicate with the DCPU, which resides inside the DDR PHY.

There are three memory regions for interacting with the DCPU.

The DCPU Register Space
-----------------------

Required properties:
  - compatible: must be one of brcm,bcm7271-dpfe-cpu, brcm,dpfe-cpu-v12.0.0.0
    or brcm,dpfe-cpu
  - reg: must reference the start address and length of the DCPU register
    space

Optional properties:
  - cell-index: the index of the DPFE instance; will default to 0 if not set

Example:
	dpfe_cpu0: dpfe-cpu@f1132000 {
		compatible = "brcm,bcm7271-dpfe-cpu",
			"brcm,dpfe-cpu-v12.0.0.0",
			"brcm,dpfe-cpu";
		reg = <0xf1132000 0x180>;
		cell-index = <0>;
	};

The DCPU Data Memory Space
--------------------------

Required properties:
  - compatible: must be one of brcm,bcm7271-dpfe-dmem, brcm,dpfe-dmem-v12.0.0.0
    or brcm,dpfe-dmem
  - reg: must reference the start address and length of the DCPU DMEM space

Optional properties:
  - cell-index: the index of the DPFE instance; will default to 0 if not set

Example:
	dpfe_dmem0: dpfe-dmem@f1134000 {
		compatible = "brcm,bcm7271-dpfe-dmem",
			"brcm,dpfe-dmem-v12.0.0.0",
			"brcm,dpfe-dmem";
		reg = <0xf1134000 0x1000>;
		cell-index = <0>;
	};

The DCPU Instruction Memory Space
---------------------------------

Required properties:
  - compatible: must be one of brcm,bcm7271-dpfe-imem, brcm,dpfe-imem-v12.0.0.0
    or brcm,dpfe-imem
  - reg: must reference the start address and length of the DCPU IMEM space

Optional properties:
  - cell-index: the index of the DPFE instance; will default to 0 if not set

Example:
	dpfe_imem0: dpfe-imem@f1138000 {
		compatible = "brcm,bcm7271-dpfe-imem",
			"brcm,dpfe-imem-v12.0.0.0",
			"brcm,dpfe-imem";
		reg = <0xf1138000 0x4000>;
		cell-index = <0>;
	};
```

## Documentation/devicetree/bindings/hwmon/cros-ec-hwmon.txt
```
Chromium Embedded Controller EC temperature and fan control
-----------------------------------------------------------

Google's Chromium EC HWMON is a hwmon implemented byimplemented by the Chromium EC
firmware attached to the Embedded Controller (EC) and controlled via a host-command
interface.

An EC HWMON node should be only found as a sub-node of the EC node (see
Documentation/devicetree/bindings/mfd/cros-ec.txt).

Required properties:
- compatible: Must contain "google,cros-ec-hwmon"

Example:
	embedded-controller@1e {
		reg = <0x1e>;
		compatible = "google,cros-ec-i2c";
		interrupts = <0 IRQ_TYPE_LEVEL_LOW>;
		interrupt-parent = <&gpio0>;

		hwmon {
			compatible = "google,cros-ec-hwmon";
		};
};
```

## Documentation/devicetree/bindings/hwmon/generic-pwm-tachometer.txt
```
Device tree bindings for fan tach output connected to PWM controller with
PWM capture capability.

Required properties:
- compatible : Should be "generic-pwm-tachometer"
- pwms       : PWM handle. Please refer pwm.txt DT binding for more details.

Example:
	tegra_tachometer: tachometer@39c0000 {
		compatible = "nvidia,tegra186-pwm-tachometer";
		reg = <0x0 0x039c0000 0x0 0x10>;
		clocks = <&bpmp_clks TEGRA194_CLK_TACH>;
		clock-names = "tachometer";
		resets = <&bpmp_resets TEGRA194_RESET_TACH>;
		reset-names = "tachometer";
		nvidia,pulse-per-rev = <2>;
		nvidia,sampling-window = <2>;
		status = "okay";
	};

	generic_pwm_tachometer {
		compatible = "generic-pwm-tachometer";
		pwms = <&tegra_tachometer 0 1000000>;
		status = "okay";
	};
```

## Documentation/devicetree/bindings/hwmon/ibmpowernv-occ.txt
```
IBM POWERNV OCC inband platform sensors

Required device-tree property:
- compatible: "ibm,p9-occ-inband-sensor"
```

## Documentation/devicetree/bindings/hwmon/ina3221.txt
```
Texas Instruments INA3221 Device Tree Bindings

1) ina3221 node
  Required properties:
  - compatible: Must be "ti,ina3221"
  - reg: I2C address

  = The node contains optional child nodes for three channels =
  = Each child node describes the information of input source =

  Example:

  ina3221@40 {
          compatible = "ti,ina3221";
          reg = <0x40>;
          [ child node definitions... ]
  };

2) child nodes
  Required properties:
  - input-id: Must be 1, 2 or 3

  Optional properties:
  - input-label: Name of the input source
  - shunt-resistor: Shunt resistor value in micro-Ohm
  - status: Should be "disabled" if no input source

  Example:

  input1 {
          input-id = <0x1>;
          status = "disabled";
  };
  input2 {
          input-id = <0x2>;
          shunt-resistor = <5000>;
  };
  input3 {
          input-id = <0x3>;
          input-label = "VDD_5V";
          shunt-resistor = <5000>;
  };
```

## Documentation/devicetree/bindings/hwmon/jc42.txt
```
Properties for Jedec JC-42.4 compatible temperature sensors

Required properties:
- compatible: May include a device-specific string consisting of the
	      manufacturer and the name of the chip. A list of supported
	      chip names follows.
	      Must include "jedec,jc-42-4" for any Jedec JC-42.4 compatible
	      temperature sensor.

	      Supported chip names:
		adt7408
		at30ts00
		at30tse004
		cat6095
		cat34ts02
		max6604
		mcp9804
		mcp9805
		mcp9808
		mcp98243
		mcp98244
		mcp9843
		se97
		se98
		stts2002
		stts2004
		stts3000
		stts424
		stts424e
		tse2002
		tse2004
		ts3000
		ts3001

- reg: I2C address

Example:

temp-sensor@1a {
	compatible = "jedec,jc-42-4";
	reg = <0x18>;
};
```

## Documentation/devicetree/bindings/hwmon/lm75.txt
```
*LM75 hwmon sensor.

Required properties:
- compatible: one of
	"national,lm75"
	"st,stlm75"

- reg: I2C address

Example:

sensor@48 {
	compatible = "st,stlm75";
	reg = <0x48>;
};
```

## Documentation/devicetree/bindings/hwmon/ltq-cputemp.txt
```
Lantiq cpu temperatur sensor driver

Requires node properties:
- "compatible" value :
	"lantiq,cputemp"

Example:
	cputemp@0 {
		compatible = "lantiq,cputemp";
	};
```

## Documentation/devicetree/bindings/hwmon/max6650.txt
```
Bindings for MAX6651 and MAX6650 I2C fan controllers

Required properties:
- compatible : One of "max6650" or "max6651"
- reg        : I2C address

Optional properties:
- fan-voltage    : The supply voltage of the fan. Valid values are 5 and 12.
                   Default is to use the chip's current setting.
- fan-prescale   : Pre-scaling value as per datasheet. Valid are 1, 2, 4, 8, 16.
                   Default is to use the chip's current setting.
 

Example:
	fan-max6650: max6650@1b {
		reg = <0x1b>;
		compatible = "max6650";
		fan-voltage = <12>;
		fan-prescale = <4>;
	};
```

## Documentation/devicetree/bindings/hwmon/mcp3021.txt
```
mcp3021 properties

Required properties:
- compatible: Must be one of the following:
	- "microchip,mcp3021" for mcp3021
	- "microchip,mcp3221" for mcp3221
- reg: I2C address

Optional properties:

- reference-voltage
	Reference voltage in millivolt (mV)

Example:

mcp3021@4d {
	compatible = "microchip,mcp3021";
	reg = <0x4d>;

	reference-voltage = <4500>; /* 4.5 V */
};
```

## Documentation/devicetree/bindings/hwmon/nct7802.txt
```
Nuvoton NCT7802Y Hardware Monitoring IC

Required node properties:

 - "compatible": must be "nuvoton,nct7802"
 - "reg": I2C bus address of the device
 - #address-cells = <1>;
 - #size-cells = <0>;

Optional subnodes:

Sensor subnodes properties:
 - "compatible", allowed values:
	 - "nuvoton,nct7802-sensor"
 - "sensor-type", allowed values:
	"thermal-diode"
	"thermistor"
	"voltage"
	"local" (only one instance, no "reg" required)
For sensors of types "thermal-diode", "thermistor" and "voltage" required
 - "reg": sensor index in range 0 .. 2

Except sensor at address 2 can't be "thermal-diode".

Voltage monitor subnodes properties:
 - "compatible", allowed values:
	 - "nuvoton,nct7802-vmon"
 - "vmon-type", allowed values:
	"vcore"
	"vcc"
 - "reg" is not used because there is only one instance of
 vcore and vcc voltage monitors.

Fan subnodes:

Fan tachometer subnode (input):

Required properties:
 - "reg" :sensor index of in range 0 .. 2.
 - "compatible", should be "nuvoton,nct7802-fan-in"

Fan PWM (or DC) subnode (output or control):

Required properties:
 - "reg" :sensor index of in range 0 .. 2.
 - "compatible", should be "nuvoton,nct7802-fan-ctl"
Optional boolean properties:
 - "direct-current" :direct current powered fan instead default PWM
 - "invert" :inverted polarity
 - "open-drain" :open-drain output instead push pull

Subnode "peci" properties:
 - "reg" :sensor index in range 0 .. 1
 - "compatible", should be "nuvoton,nct7802-peci"

Not defined sensors, fans and PECI modules will be disabled.

Example nct7802 node:

nct7802-example@28 {
	compatible = "nuvoton,nct7802";
	reg = <0x28>;
	#address-cells = <1>;
	#size-cells = <0>;
	local-sensor {
		compatible = "nuvoton,nct7802-sensor";
		sensor-type = "local";
	};
	sensor@0 {
		compatible = "nuvoton,nct7802-sensor";
		reg = <0>;
		sensor-type = "thermal-diode";
	};
	sensor@1 {
		compatible = "nuvoton,nct7802-sensor";
		reg = <1>;
		sensor-type = "thermistor";
	};
	sensor@2 {
		compatible = "nuvoton,nct7802-sensor";
		reg = <2>;
		sensor-type = "voltage";
	};
	vcc {
		compatible = "nuvoton,nct7802-vmon";
		sensor-type = "vcc";
	};
	vcore {
		compatible = "nuvoton,nct7802-vmon";
		sensor-type = "vcore";
	};
	fan-in@0 {
		compatible = "nuvoton,nct7802-fan-in";
		reg = <0>;
	};
	fan-in@1 {
		compatible = "nuvoton,nct7802-fan-in";
		reg = <1>;
	};
	fan-ctl@0 {
		compatible = "nuvoton,nct7802-fan-ctl";
		reg = <0>;
	};
	dc-fan-ctl@1 {
		compatible = "nuvoton,nct7802-fan-ctl";
		reg = <1>;
		direct-current;
		open-drain;
		invert;
	};
	pwm-fan-ctl@2 {
		compatible = "nuvoton,nct7802-fan-ctl";
		reg = <2>;
		open-drain;
		invert;
	};
	peci@0 {
		compatible = "nuvoton,nct7802-peci";
		reg = <0>;
	};
	peci@1 {
		compatible = "nuvoton,nct7802-peci";
		reg = <1>;
	};
};
```

## Documentation/devicetree/bindings/hwmon/npcm750-pwm-fan.txt
```
Nuvoton NPCM7xx PWM and Fan Tacho controller device driver

The NPCM7xx has two identical Pulse-width modulation (PWM) controller modules,
Each PWM module has four PWM controller outputs, Totally 8 PWM controller outputs.

The NPCM7xx has eight identical Fan tachometer controller modules,
Each Fan module has two Fan controller inputs, Totally 16 Fan controller inputs.

Required properties for pwm-fan node:
- compatible	: "nuvoton,npcm750-pwm-fan" for Poleg NPCM7XX.
- reg 			: specifies physical base address and size of the registers.
- reg-names 	: must contain:
					* "pwm-base" for the PWM registers.
 					* "fan-base" for the Fan registers.
- clocks		: phandle of reference clocks.
- clock-names	: must contain
					* "clk_apb3" for clock of PWM controller.
 					* "clk_apb4" for clock of Fan controller.
- interrupts	: contain the Fan interrupts with flags for falling edge.
- pinctrl-names	: a pinctrl state named "default" must be defined.
- pinctrl-0 	: phandle referencing pin configuration of the PWM and Fan
					controller ports.

pwm subnode format:
===================
Under pwm subnode can be upto 8 child nodes, each child node representing a PWM channel.
Each pwm subnode must have one PWM channel and atleast one Fan tach channel.

For PWM channel can be configured cooling-levels to create cooling device.
Cooling device could be bound to a thermal zone for the thermal control.

Required properties for each child node:
- pwm-ch : specify the PWM output channel.
			integer value in the range 0 through 7, that represent
			the PWM channel number that used.

- fan-ch : specify the Fan input channel.
			integer value in the range 0 through 15, that represent
			the Fan channel number that used.

			At least one Fan tach input channel is required

Optional property for each child node:
- cooling-levels: PWM duty cycle values in a range from 0 to 255
                  which correspond to thermal cooling states.

Examples:

pwm_fan:pwm_fan_controller@103000 {
	compatible = "nuvoton,npcm750-pwm-fan";
	reg = <0x103000 0x2000>,
		<0x180000 0x8000>;
	reg-names = "pwm_base", "fan_base";
	clocks = <&clk NPCM7XX_CLK_APB3>,
		<&clk NPCM7XX_CLK_APB4>;
	clock-names = "clk_apb3","clk_apb4";
	interrupts = <GIC_SPI 96 IRQ_TYPE_LEVEL_HIGH>,
			<GIC_SPI 97 IRQ_TYPE_LEVEL_HIGH>,
			<GIC_SPI 98 IRQ_TYPE_LEVEL_HIGH>,
			<GIC_SPI 99 IRQ_TYPE_LEVEL_HIGH>,
			<GIC_SPI 100 IRQ_TYPE_LEVEL_HIGH>,
			<GIC_SPI 101 IRQ_TYPE_LEVEL_HIGH>,
			<GIC_SPI 102 IRQ_TYPE_LEVEL_HIGH>,
			<GIC_SPI 103 IRQ_TYPE_LEVEL_HIGH>;
	pinctrl-names = "default";
	pinctrl-0 = <&pwm0_pins &pwm1_pins &pwm2_pins
			&fanin0_pins &fanin1_pins &fanin2_pins
			&fanin3_pins &fanin4_pins>;

			pwm@0 {
				pwm-ch = /bits/ 8 <0x00>;
				fan-ch = /bits/ 8 <0x00 0x01>;
				cooling-levels = <127 255>;
				};
			pwm@1 {
				pwm-ch = /bits/ 8 <0x01>;
				fan-ch = /bits/ 8 <0x02 0x03>;
				};
			pwm@2 {
				pwm-ch = /bits/ 8 <0x02>;
				fan-ch = /bits/ 8 <0x04>;
				};

};
```

## Documentation/devicetree/bindings/hwmon/npcm7xx-pwm.txt
```
Nuvoton NPCM7xx Pulse-width modulation (PWM) controller device driver

The NPCM7xx has two identical PWM controller modules,
Each module has four PWM controller outputs.
NPCM7xx PWM controller module 0 outputs PWM0-3 and NPCM7xx PWM controller
module 1 outputs PWM4-7.

Required properties:
- compatible	: "nuvoton,npcm750-pwm" for Poleg NPCM7XX.
- reg		: Offset and length of the registers set for the device.
- clocks	: phandle of pwm reference clock.
- pinctrl-names	: a pinctrl state named "default" must be defined.
- pinctrl-0 	: phandle referencing pin configuration of the PWM ports.

pwm:pwm@f0103000 {
	compatible = "nuvoton,npcm750-pwm";
	reg = <0xf0103000 0x50
		0xf0104000 0x50>;
	clocks = <&clk NPCM7XX_CLK_APB3>;
	pinctrl-names = "default";
	pinctrl-0 = <&pwm0_pins &pwm1_pins
			&pwm2_pins &pwm3_pins
			&pwm4_pins &pwm5_pins
			&pwm6_pins &pwm7_pins>;
};
```

## Documentation/devicetree/bindings/hwmon/peci-cputemp.txt
```
Bindings for Intel PECI (Platform Environment Control Interface) cputemp driver.

Required properties:
- compatible : Should be "intel,peci-cputemp".
- reg        : Should contain address of a client CPU. Address range of CPU
	       clients is starting from 0x30 based on PECI specification.

Example:
	peci-bus@0 {
		#address-cells = <1>;
		#size-cells = <0>;
		< more properties >

		peci-cputemp@30 {
			compatible = "intel,peci-cputemp";
			reg = <0x30>;
		};

		peci-cputemp@31 {
			compatible = "intel,peci-cputemp";
			reg = <0x31>;
		};
	};
```

## Documentation/devicetree/bindings/hwmon/peci-dimmtemp.txt
```
Bindings for Intel PECI (Platform Environment Control Interface) dimmtemp
driver.

Required properties:
- compatible : Should be "intel,peci-dimmtemp".
- reg        : Should contain address of a client CPU. Address range of CPU
	       clients is starting from 0x30 based on PECI specification.

Example:
	peci-bus@0 {
		#address-cells = <1>;
		#size-cells = <0>;
		< more properties >

		peci-dimmtemp@30 {
			compatible = "intel,peci-dimmtemp";
			reg = <0x30>;
		};

		peci-dimmtemp@31 {
			compatible = "intel,peci-dimmtemp";
			reg = <0x31>;
		};
	};
```

## Documentation/devicetree/bindings/hwmon/peci-hwmon.txt
```
Bindings for Intel PECI (Platform Environment Control Interface) hwmon driver.

Required properties:
- compatible
	Should be "intel,peci-hwmon".

- reg
	Should contain address of a client CPU. Address range of CPU clients is
	starting from 0x30 based on PECI specification.
	<0x30> .. <0x37> (depends on the PECI_OFFSET_MAX definition)

Example:
	peci-bus@0 {
		#address-cells = <1>;
		#size-cells = <0>;
		< more properties >

		peci-hwmon@cpu0 {
			compatible = "intel,peci-hwmon";
			reg = <0x30>;
		};

		peci-hwmon@cpu1 {
			compatible = "intel,peci-hwmon";
			reg = <0x31>;
		};
	};
```
