## Documentation/devicetree/bindings/phy/phy-zynqmp.txt
```
Xilinx ZynqMP PHY binding

This binding describes a ZynqMP PHY device that is used to control ZynqMP
High Speed Gigabit Transceiver(GT). ZynqMP PS GTR provides four lanes
and are used by USB, SATA, PCIE, Display port and Ethernet SGMMI controllers.

Phy provider node
=================

Required properties:
- compatible	: Can be "xlnx,zynqmp-psgtr-v1.1" or "xlnx,zynqmp-psgtr"

- reg           : Address and length of register sets for each device in
                  "reg-names"

- reg-names     : The names of the register addresses corresponding to the
		  registers filled in "reg":
			- serdes: SERDES block register set
			- siou: SIOU block register set

Optional properties:
- xlnx,tx-termination-fix : Include this for fixing functional issue with the
		  TX termination resistance in GT, which can be out of spec for
		  the XCZU9EG silicon version. This property is not required for
		  "xlnx,zynqmp-psgtr-v1.1"

Required nodes	:  A sub-node is required for each lane the controller
		   provides.

Phy sub-nodes
=============

Required properties:
lane@0:
- #phy-cells	: Should be 4

lane@1:
- #phy-cells	: Should be 4

lane@2:
- #phy-cells	: Should be 4

lane@3:
- #phy-cells	: Should be 4

Example:
	zynqmp_phy: phy@fd400000 {
		compatible = "xlnx,zynqmp-psgtr-v1.1";
		status = "okay";
		reg = <0x0 0xfd400000 0x0 0x40000>, <0x0 0xfd3d0000 0x0 0x1000>;
		reg-names = "serdes", "siou";

		lane0: lane@0 {
			#phy-cells = <4>;
		};
		lane1: lane@1 {
			#phy-cells = <4>;
		};
		lane2: lane@2 {
			#phy-cells = <4>;
		};
		lane3: lane@3 {
			#phy-cells = <4>;
		};
	};

Specifying phy control of devices
=================================

Device nodes should specify the configuration required in their "phys"
property, containing a phandle to the phy port node and a device type.

phys = <PHANDLE CONTROLLER_TYPE CONTROLLER_INSTANCE LANE_REF_CLK LANE_FREQ>;

PHANDLE                 = &lane0 or &lane1 or &lane2 or &lane3
CONTROLLER_TYPE         = PHY_TYPE_PCIE or PHY_TYPE_SATA or PHY_TYPE_USB
			  or PHY_TYPE_DP or PHY_TYPE_SGMII
CONTROLLER_INSTANCE     = Depends on controller type used, can be any of
				PHY_TYPE_PCIE : 0 or 1 or 2 or 3
				PHY_TYPE_SATA : 0 or 1
				PHY_TYPE_USB  : 0 or 1
				PHY_TYPE_DP   : 0 or 1
				PHY_TYPE_SGMII: 0 or 1 or 2 or 3
LANE_REF_CLK            = Depends on which lane clock is used as ref clk, can be
			  0 or 1 or 2 or 3
LANE_FREQ               = Frequency of the reference clock, can be any of the
			  below mentioned based on the phy type used
- PHY_TYPE_PCIE         = 100Mhz
- PHY_TYPE_SGMII        = 125Mhz
- PHY_TYPE_SATA         = 125Mhz, 150Mhz
- PHY_TYPE_USB          = 26Mhz, 52Mhz, 100Mhz
- PHY_TYPE_DP           = 27Mhz, 108Mhz, 135Mhz

Example:

#include <dt-bindings/phy/phy.h>

	usb@fe200000 {
		...
		phys = <&lane2 PHY_TYPE_USB3 0 2 2600000>;
		...
	};

	zynqmp-display@fd4a0000 {
		...
		phys = <&lane1 PHY_TYPE_DP 0 1 27000000>,
		       <&lane0 PHY_TYPE_DP 1 1 27000000>;
		...
	};
```

## Documentation/devicetree/bindings/phy/qcom,usb-hs-phy.txt
```
Qualcomm's USB HS PHY

PROPERTIES

- compatible:
    Usage: required
    Value type: <string>
    Definition: Should contain "qcom,usb-hs-phy"

- ulpi-vendor:
    Usage: required
    Value type: <u16>
    Definition: Should be 0x05c6

- ulpi-product:
    Usage: required
    Value type: <u16>
    Definition: Should be 0x0000

- #phy-cells:
    Usage: required
    Value type: <u32>
    Definition: Should contain 0

- clocks:
    Usage: required
    Value type: <prop-encoded-array>
    Definition: Should contain clock specifier for the reference and sleep
                clocks

- clock-names:
    Usage: required
    Value type: <stringlist>
    Definition: Should contain "ref" and "sleep" for the reference and sleep
                clocks respectively

- resets:
    Usage: required
    Value type: <prop-encoded-array>
    Definition: Should contain the phy and POR resets

- reset-names:
    Usage: required
    Value type: <stringlist>
    Definition: Should contain "phy" and "por" for the phy and POR resets
                respectively

- v3p3-supply:
    Usage: required
    Value type: <phandle>
    Definition: Should contain a reference to the 3.3V supply

- v1p8-supply:
    Usage: required
    Value type: <phandle>
    Definition: Should contain a reference to the 1.8V supply

- qcom,init-seq:
    Usage: optional
    Value type: <u8 array>
    Definition: Should contain a sequence of ULPI register and address pairs to
                program into the ULPI_EXT_VENDOR_SPECIFIC area. This is related
                to Device Mode Eye Diagram test.

EXAMPLE

otg: usb-controller {
	ulpi {
		phy {
			compatible = "qcom,usb-hs-phy";
			ulpi-vendor = /bits/ 16 <0x05c6>;
			ulpi-product = /bits/ 16 <0x0000>;
			#phy-cells = <0>;
			clocks = <&xo_board>, <&gcc GCC_USB2A_PHY_SLEEP_CLK>;
			clock-names = "ref", "sleep";
			resets = <&gcc GCC_USB2A_PHY_BCR>, <&otg 0>;
			reset-names = "phy", "por";
			v3p3-supply = <&pm8941_l24>;
			v1p8-supply = <&pm8941_l6>;
			qcom,init-seq = /bits/ 8 <0x81 0x63>;
		};
	};
};
```

## Documentation/devicetree/bindings/phy/qcom,usb-hsic-phy.txt
```
Qualcomm's USB HSIC PHY

PROPERTIES

- compatible:
    Usage: required
    Value type: <string>
    Definition: Should contain "qcom,usb-hsic-phy"

- ulpi-vendor:
    Usage: required
    Value type: <u16>
    Definition: Should be 0x05c6

- ulpi-product:
    Usage: required
    Value type: <u16>
    Definition: Should be 0x0000

- #phy-cells:
    Usage: required
    Value type: <u32>
    Definition: Should contain 0

- clocks:
    Usage: required
    Value type: <prop-encoded-array>
    Definition: Should contain clock specifier for phy, calibration and
                a calibration sleep clock

- clock-names:
    Usage: required
    Value type: <stringlist>
    Definition: Should contain "phy, "cal" and "cal_sleep"

- pinctrl-names:
    Usage: required
    Value type: <stringlist>
    Definition: Should contain "init" and "default" in that order

- pinctrl-0:
    Usage: required
    Value type: <prop-encoded-array>
    Definition: List of pinctrl settings to apply to keep HSIC pins in a glitch
                free state

- pinctrl-1:
    Usage: required
    Value type: <prop-encoded-array>
    Definition: List of pinctrl settings to apply to mux out the HSIC pins

EXAMPLE

usb-controller {
	ulpi {
		phy {
			compatible = "qcom,usb-hsic-phy";
			ulpi-vendor = /bits/ 16 <0x05c6>;
			ulpi-product = /bits/ 16 <0x0000>;
			#phy-cells = <0>;
			pinctrl-names = "init", "default";
			pinctrl-0 = <&hsic_sleep>;
			pinctrl-1 = <&hsic_default>;
			clocks = <&gcc GCC_USB_HSIC_CLK>,
				 <&gcc GCC_USB_HSIC_IO_CAL_CLK>,
				 <&gcc GCC_USB_HSIC_IO_CAL_SLEEP_CLK>;
			clock-names = "phy", "cal", "cal_sleep";
			assigned-clocks = <&gcc GCC_USB_HSIC_IO_CAL_CLK>;
			assigned-clock-rates = <960000>;
		};
	};
};
```

## Documentation/devicetree/bindings/phy/qoriq-usb2-phy.txt
```
QorIQ SoC USB 2.0 PHY

Required properties:
 - compatible: should be "fsl,qoriq-usb2-phy",
   Wherever applicable, the version of the USB PHY should
   also be mentioned (for eg. fsl,qoriq-usb2-phy-vX.Y).
   where, X = Phy vendor(Legacy = 1, NXP = 2) and Y = PHY version
 - reg : Address and length of the usb phy control register set.
 - phy_type : For multi port host USB controllers, should be one of
   "ulpi", or "serial". For dual role USB controllers, should be
   one of "ulpi", "utmi", "utmi_wide", or "serial".

The main purpose of this PHY driver is to enable the USB PHY reference clock
gate on the QorIQ SOC for USB2 PHY OR implement errata workaround in
future. Otherwise it is just an NOP PHY driver.

usbphy0: usbphy@8600000 {
        compatible = "fsl,qoriq-usb2-phy" "fsl,qoriq-usb2-phy-vX.Y";
        reg = <0x0 0x8600000 0x0 0x1000>;
        #phy-cells = <0>;
        phy_type = "ulpi";
};
```

## Documentation/devicetree/bindings/phy/ralink-usb-phy.txt
```
Mediatek/Ralink USB PHY

Required properties:
 - compatible: ralink,rt3xxx-usbphy or ralink,mt7620-usbphy
 - #phy-cells: should be 0
 - resets: the two reset controllers for host and device
 - reset-names: the names of the 2 reset controllers

Example:

usbphy: phy {
	compatible = "ralink,mt7620a-usbphy";
	#phy-cells = <0>;

	resets = <&rstctrl 22 &rstctrl 25>;
	reset-names = "host", "device";
};
```

## Documentation/devicetree/bindings/phy/rockchip-pcie-phy.txt
```
Rockchip PCIE PHY
-----------------------

Required properties:
 - compatible: rockchip,rk3399-pcie-phy
 - #phy-cells: must be 0

Example:

grf: syscon@ff770000 {
	compatible = "rockchip,rk3399-grf", "syscon", "simple-mfd";
	#address-cells = <1>;
	#size-cells = <1>;

	...

	pcie_phy: phy@e220 {
		compatible = "rockchip,rk3399-pcie-phy";
		#phy-cells = <0>;
	};
};
```

## Documentation/devicetree/bindings/phy/snps,dphy-rx.txt
```
Synopsys DesignWare MIPI Rx D-PHY block details

Description
-----------

The Synopsys MIPI D-PHY controller supports MIPI-DPHY in receiver mode.
Please refer to phy-bindings.txt for more information.

Required properties:
- compatible		: Shall be "snps,dphy-rx".
- #phy-cells		: Must be 1.
- snps,dphy-frequency	: Output frequency of the D-PHY.
- snps,dphy-te-len	: Size of the communication interface (8 bits->8 or 12bits->12).
- reg			: Physical base address and size of the device memory mapped
		 	  registers;

Optional properties:
- snps,compat-mode	: Compatibility mode control

The per-board settings:
- gpios 		: Synopsys testchip used as reference uses this to change setup
		  	  configurations.

Example:

	mipi_dphy_rx1: dphy@3040 {
		compatible = "snps,dphy-rx";
		#phy-cells = <1>;
		snps,dphy-frequency = <300000>;
		snps,dphy-te-len = <12>;
		snps,compat-mode = <1>;
		reg = < 0x03040 0x20
			0x08000 0x100
			0x09000 0x100>;
	};
```

## Documentation/devicetree/bindings/phy/uniphier-usb3-phy.txt
```
Socionext UniPhier USB3 PHY

This describes the devicetree bindings for PHY interfaces built into
USB3 controller implemented on Socionext UniPhier SoCs.
The controller includes High-Speed PHY and Super-Speed PHY.

USB3 High-Speed (HS) PHY
------------------------

Required properties:
- compatible: Should contain one of the following:
    "socionext,uniphier-pro4-usb3-hsphy" - for Pro4 SoC
    "socionext,uniphier-pxs2-usb3-hsphy" - for PXs2 SoC
    "socionext,uniphier-ld20-usb3-hsphy" - for LD20 SoC
    "socionext,uniphier-pxs3-usb3-hsphy" - for PXs3 SoC
- reg: Specifies offset and length of the register set for the device.
- #phy-cells: Should be 0.
- clocks: A list of phandles to the clock gate for USB3 glue layer.
	According to the clock-names, appropriate clocks are required.
- clock-names: Should contain the following:
    "gio", "link" - for Pro4 SoC
    "link", "phy", "phy-ext" - for PXs3 SoC, "phy-ext" is optional.
    "link", "phy" - for others
- resets: A list of phandles to the reset control for USB3 glue layer.
	According to the reset-names, appropriate resets are required.
- reset-names: Should contain the following:
    "gio", "link" - for Pro4 SoC
    "link", "phy" - for others

Optional properties:
- phy-supply: A phandle to the regulator for USB VBUS.
- nvmem-cells: Phandles to nvmem cell that contains the trimming data.
	Available only for HS-PHY implemented on LD20 and PXs3, and
	if unspecified, default value is used.
- nvmem-cell-names: Should be the following names, which correspond to
	each nvmem-cells.
	All of the 3 parameters associated with the following names are
	required for each port, if any one is omitted, the trimming data
	of the port will not be set at all.
    "rterm", "sel_t", "hs_i" - Each cell name for phy parameters

Refer to phy/phy-bindings.txt for the generic PHY binding properties.

Example:

	usb-glue@65b00000 {
		compatible = "socionext,uniphier-ld20-dwc3-glue",
			     "simple-mfd";
		#address-cells = <1>;
		#size-cells = <1>;
		ranges = <0 0x65b00000 0x400>;

		usb_hsphy0: hs-phy@200 {
			compatible = "socionext,uniphier-ld20-usb3-hsphy";
			reg = <0x200 0x10>;
			#phy-cells = <0>;
			clock-names = "link", "phy";
			clocks = <&sys_clk 14>, <&sys_clk 16>;
			reset-names = "link", "phy";
			resets = <&sys_rst 14>, <&sys_rst 16>;
			phy-supply = <&usb_vbus0>;
			nvmem-cell-names = "rterm", "sel_t", "hs_i";
			nvmem-cells = <&usb_rterm0>, <&usb_sel_t0>,
				      <&usb_hs_i0>;
		};
	};


USB3 Super-Speed (SS) PHY
-------------------------

Required properties:
- compatible: Should contain one of the following:
    "socionext,uniphier-pro4-usb3-ssphy" - for Pro4 SoC
    "socionext,uniphier-pxs2-usb3-ssphy" - for PXs2 SoC
    "socionext,uniphier-ld20-usb3-ssphy" - for LD20 SoC
    "socionext,uniphier-pxs3-usb3-ssphy" - for PXs3 SoC
- reg: Specifies offset and length of the register set for the device.
- #phy-cells: Should be 0.
- clocks: A list of phandles to the clock gate for USB3 glue layer.
	According to the clock-names, appropriate clocks are required.
- clock-names:
    "gio", "link" - for Pro4 SoC
    "link", "phy", "phy-ext" - for PXs3 SoC, "phy-ext" is optional.
    "link", "phy" - for others
- resets: A list of phandles to the reset control for USB3 glue layer.
	According to the reset-names, appropriate resets are required.
- reset-names:
    "gio", "link" - for Pro4 SoC
    "link", "phy" - for others

Optional properties:
- phy-supply: A phandle to the regulator for USB VBUS.

Refer to phy/phy-bindings.txt for the generic PHY binding properties.

Example:

	usb-glue@65b00000 {
		compatible = "socionext,uniphier-ld20-dwc3-glue",
			     "simple-mfd";
		#address-cells = <1>;
		#size-cells = <1>;
		ranges = <0 0x65b00000 0x400>;

		usb_ssphy0: ss-phy@300 {
			compatible = "socionext,uniphier-ld20-usb3-ssphy";
			reg = <0x300 0x10>;
			#phy-cells = <0>;
			clock-names = "link", "phy";
			clocks = <&sys_clk 14>, <&sys_clk 16>;
			reset-names = "link", "phy";
			resets = <&sys_rst 14>, <&sys_rst 16>;
			phy-supply = <&usb_vbus0>;
		};

		other nodes ...
	};
```

## Documentation/devicetree/bindings/pinctrl/fsl,imx8mq-pinctrl.txt
```
* Freescale IMX8MQ IOMUX Controller

Please refer to fsl,imx-pinctrl.txt and pinctrl-bindings.txt in this directory
for common binding part and usage.

Required properties:
- compatible: "fsl,imx8mq-iomuxc"
- fsl,pins: each entry consists of 6 integers and represents the mux and config
  setting for one pin.  The first 5 integers <mux_reg conf_reg input_reg mux_val
  input_val> are specified using a PIN_FUNC_ID macro, which can be found in
  imx8mq-pinfunc.h under device tree source folder.  The last integer CONFIG is
  the pad setting value like pull-up on this pin.  Please refer to i.MX8M Quad
  Reference Manual for detailed CONFIG settings.

Examples:

&uart1 {
       pinctrl-names = "default";
       pinctrl-0 = <&pinctrl_uart1>;
};

&iomuxc {
	pinctrl_uart1: uart1grp {
		fsl,pins = <
			MX8MQ_IOMUXC_UART1_RXD_UART1_DCE_RX 0x49
			MX8MQ_IOMUXC_UART1_TXD_UART1_DCE_TX 0x49
		>;
	};
};
```
