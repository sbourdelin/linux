## Documentation/devicetree/bindings/pinctrl/ingenic,pinctrl.txt
```
Ingenic jz47xx pin controller

Please refer to pinctrl-bindings.txt in this directory for details of the
common pinctrl bindings used by client devices, including the meaning of the
phrase "pin configuration node".

For the jz47xx SoCs, pin control is tightly bound with GPIO ports. All pins may
be used as GPIOs, multiplexed device functions are configured within the
GPIO port configuration registers and it is typical to refer to pins using the
naming scheme "PxN" where x is a character identifying the GPIO port with
which the pin is associated and N is an integer from 0 to 31 identifying the
pin within that GPIO port. For example PA0 is the first pin in GPIO port A, and
PB31 is the last pin in GPIO port B. The jz4740 contains 4 GPIO ports, PA to
PD, for a total of 128 pins. The jz4780 contains 6 GPIO ports, PA to PF, for a
total of 192 pins.


Pin controller node
===================

Required properties:
- compatible: One of:
  - "ingenic,jz4740-pinctrl"
  - "ingenic,jz4780-pinctrl"

Optional properties:
- ingenic,pull-ups: A list of 32-bit bit fields, where each bit set tells the
  driver that a pull-up resistor is available for this pin.
  By default, the driver considers that all pins feature a pull-up resistor.
- ingenic,pull-downs: A list of 32-bit bit fields, where each bit set tells
  the driver that a pull-down resistor is available for this pin.
  By default, the driver considers that all pins feature a pull-down
  resistor.


'functions' sub-node
====================

The 'functions' node will contain sub-nodes that correspond to pin function
nodes, and no properties. Pin function nodes will contain sub-nodes that
correspond to pin groups, and no properties.

The names of the pin function nodes will end up being the available functions
provided by the pinctrl driver.
The names of the pin group nodes will end up being the available groups
provided by the pinctrl driver.

Required properties for pin groups:
- ingenic,pins: <pin mode [pin mode ...]>;
  where 'pin' is the number of the pin, and 'mode' is the function mode of the
  pin that should be enabled for this group.


Example:
=======

pinctrl: ingenic-pinctrl@10010000 {
	compatible = "ingenic,jz4740-pinctrl";
	reg = <0x10010000 0x400>;

	ingenic,pull-ups   = <0xffffffff 0xffffffff 0xffffffff 0xdfffffff>;
	ingenic,pull-downs = <0x00000000 0x00000000 0x00000000 0x00000000>;

	functions {
		mmc {
			mmc-1bit {
				/* CLK, CMD, D0 */
				ingenic,pins = <0x69 0 0x68 0 0x6a 0>;
			};

			mmc-4bit {
				/* D1, D2, D3 */
				ingenic,pins = <0x6b 0 0x6c 0 0x6d 0>;
			};
		};
	};
};
```

## Documentation/devicetree/bindings/pinctrl/marvell,armada-37xx-pinctrl.txt
```
* Marvell Armada 37xx SoC pin and gpio controller

Each Armada 37xx SoC come with two pin and gpio controller one for the
south bridge and the other for the north bridge.

Inside this set of register the gpio latch allows exposing some
configuration of the SoC and especially the clock frequency of the
xtal. Hence, this node is a represent as syscon allowing sharing the
register between multiple hardware block.

GPIO and pin controller:
------------------------

Refer to pinctrl-bindings.txt in this directory for details of the
common pinctrl bindings used by client devices, including the meaning
of the phrase "pin configuration node".

Required properties for pinctrl driver:

- compatible:	"marvell,armada3710-sb-pinctrl", "syscon, "simple-mfd"
		for the south bridge
		"marvell,armada3710-nb-pinctrl", "syscon, "simple-mfd"
		for the north bridge
- reg: The first set of register are for pinctrl/gpio and the second
  set for the interrupt controller
- interrupts: list of the interrupt use by the gpio

Available groups and functions for the North bridge:

group: jtag
 - pins 20-24
 - functions jtag, gpio

group sdio0
 - pins 8-10
 - functions sdio, gpio

group emmc_nb
 - pins 27-35
 - functions emmc, gpio

group pwm0
 - pin 11 (GPIO1-11)
 - functions pwm, gpio

group pwm1
 - pin 12
 - functions pwm, gpio

group pwm2
 - pin 13
 - functions pwm, gpio

group pwm3
 - pin 14
 - functions pwm, gpio

group pmic1
 - pin 17
 - functions pmic, gpio

group pmic0
 - pin 16
 - functions pmic, gpio

group i2c2
 - pins 2-3
 - functions i2c, gpio

group i2c1
 - pins 0-1
 - functions i2c, gpio

group spi_cs1
 - pin 17
 - functions spi, gpio

group spi_cs2
 - pin 18
 - functions spi, gpio

group spi_cs3
 - pin 19
 - functions spi, gpio

group onewire
 - pin 4
 - functions onewire, gpio

group uart1
 - pins 25-26
 - functions uart, gpio

group spi_quad
 - pins 15-16
 - functions spi, gpio

group uart_2
 - pins 9-10
 - functions uart, gpio

Available groups and functions for the South bridge:

group usb32_drvvbus0
 - pin 36
 - functions drvbus, gpio

group usb2_drvvbus1
 - pin 37
 - functions drvbus, gpio

group sdio_sb
 - pins 60-64
 - functions sdio, gpio

group rgmii
 - pins 42-55
 - functions mii, gpio

group pcie1
 - pins 39-40
 - functions pcie, gpio

group ptp
 - pins 56-58
 - functions ptp, gpio

group ptp_clk
 - pin 57
 - functions ptp, mii

group ptp_trig
 - pin 58
 - functions ptp, mii

group mii_col
 - pin 59
 - functions mii, mii_err

Xtal Clock bindings for Marvell Armada 37xx SoCs
------------------------------------------------

see Documentation/devicetree/bindings/clock/armada3700-xtal-clock.txt
```

## Documentation/devicetree/bindings/pinctrl/marvell,armada-98dx3236-pinctrl.txt
```
* Marvell 98dx3236 pinctrl driver for mpp

Please refer to marvell,mvebu-pinctrl.txt in this directory for common binding
part and usage

Required properties:
- compatible: "marvell,98dx3236-pinctrl" or "marvell,98dx4251-pinctrl"
- reg: register specifier of MPP registers

This driver supports all 98dx3236, 98dx3336 and 98dx4251 variants

name          pins     functions
================================================================================
mpp0          0        gpio, spi0(mosi), dev(ad8)
mpp1          1        gpio, spi0(miso), dev(ad9)
mpp2          2        gpio, spi0(sck), dev(ad10)
mpp3          3        gpio, spi0(cs0), dev(ad11)
mpp4          4        gpio, spi0(cs1), smi(mdc), dev(cs0)
mpp5          5        gpio, pex(rsto), sd0(cmd), dev(bootcs)
mpp6          6        gpio, sd0(clk), dev(a2)
mpp7          7        gpio, sd0(d0), dev(ale0)
mpp8          8        gpio, sd0(d1), dev(ale1)
mpp9          9        gpio, sd0(d2), dev(ready0)
mpp10         10       gpio, sd0(d3), dev(ad12)
mpp11         11       gpio, uart1(rxd), uart0(cts), dev(ad13)
mpp12         12       gpio, uart1(txd), uart0(rts), dev(ad14)
mpp13         13       gpio, intr(out), dev(ad15)
mpp14         14       gpio, i2c0(sck)
mpp15         15       gpio, i2c0(sda)
mpp16         16       gpio, dev(oe)
mpp17         17       gpio, dev(clk)
mpp18         18       gpio, uart1(txd)
mpp19         19       gpio, uart1(rxd), dev(rb)
mpp20         20       gpio, dev(we)
mpp21         21       gpio, dev(ad0)
mpp22         22       gpio, dev(ad1)
mpp23         23       gpio, dev(ad2)
mpp24         24       gpio, dev(ad3)
mpp25         25       gpio, dev(ad4)
mpp26         26       gpio, dev(ad5)
mpp27         27       gpio, dev(ad6)
mpp28         28       gpio, dev(ad7)
mpp29         29       gpio, dev(a0)
mpp30         30       gpio, dev(a1)
mpp31         31       gpio, slv_smi(mdc), smi(mdc), dev(we1)
mpp32         32       gpio, slv_smi(mdio), smi(mdio), dev(cs1)
```

## Documentation/devicetree/bindings/pinctrl/nvidia,tegra-io-pad.txt
```
NVIDIA Tegra PMC IO pad controller

NVIDIA Tegra124 and later SoCs support the multi-voltage level and low power
state of some of its IO pads. When IO interface are not used then IO pads can
be configure in low power state to reduce the power from that IO pads. The IO
pads can work in the nominal IO voltage of 1.8V and 3.3V from power rail
sources.

On Tegra124, the voltage of IO power rail source is auto detected by SoC and
hence it is only require to configure in low power mode if IO pads are not
used.

On T210 onwards, the HW based auto-detection for IO voltage is removed and
hence SW need to configure the PMC register explicitly, to set proper voltage
in IO pads, based on IO rail power source voltage.

The voltage configurations and low power state of IO pads should be done in
boot if it is not going to change otherwise dynamically based on IO rail
voltage on that IO pads and usage of IO pads

The DT property of the IO pads must be under the node of pmc i.e.
pmc@7000e400 for Tegra124 onwards.

Please refer to <pinctrl-bindings.txt> in this directory for details of the
common pinctrl bindings used by client devices, including the meaning of the
phrase "pin configuration node".

Tegra's pin configuration nodes act as a container for an arbitrary number of
subnodes. Each of these subnodes represents some desired configuration for an
IO pads, or a list of IO pads. This configuration can include the voltage and
power enable/disable control

The name of each subnode is not important; all subnodes should be enumerated
and processed purely based on their content. Each subnode only affects those
parameters that are explicitly listed. Unspecified is represented as an absent
property,

See the TRM to determine which properties and values apply to each IO pads.

Required subnode-properties:
==========================
- pins : An array of strings. Each string contains the name of an IO pads. Valid
	 values for these names are listed below.

Optional subnode-properties:
==========================
Following properties are supported from generic pin configuration explained
in <dt-bindings/pinctrl/pinctrl-binding.txt>.
low-power-enable:		enable low power mode.
low-power-disable:		disable low power mode.

Valid values for pin for T124 are:
	audio, bb, cam, comp, csia, csib, csie, dsi, dsib, dsic, dsid, hdmi,
	hsic, hv, lvds, mipi-bias, nand, pex-bias, pex-clk1, pex-clk2,
	pex-ctrl, sdmmc1, sdmmc3, sdmmc4, sys-ddc, uart, usb0, usb1, usb2,
	usb-bias

Valid values for pin for T210 are:
	audio, audio-hv, cam, csia, csib, csic, csid, csie, csif,
	dbg, debug-nonao, dmic, dp, dsi, dsib, dsic, dsid, emmc, emmc2,
	gpio, hdmi, hsic, lvds, mipi-bias, pex-bias, pex-clk1, pex-clk2,
	pex-ctrl, sdmmc1, sdmmc3, spi, spi-hv, uart, usb-bias, usb0,
	usb1, usb2, usb3.

To find out the IO rail voltage for setting the voltage of IO pad by SW,
the regulator supply handle must provided from the DT and it is explained
in the regulator DT binding document
	<devicetree/bindings/regulator/regulator.txt>.
For example, for GPIO rail the supply name is vddio-gpio and regulator
handle is supplied from DT as
	vddio-gpio-supply = <&regulator_xyz>;

For T210, following IO pads support the 1.8V/3.3V and the corresponding
IO voltage pin names are as follows:
	audio -> vddio-audio
	audio-hv -> vddio-audio-hv
	cam ->vddio-cam
	dbg -> vddio-dbg
	dmic -> vddio-dmic
	gpio -> vddio-gpio
	pex-ctrl -> vddio-pex-ctrl
	sdmmc1 -> vddio-sdmmc1
	sdmmc3 -> vddio-sdmmc3
	spi -> vddio-spi
	spi-hv -> vddio-spi-hv
	uart -> vddio-uart

Example:
	i2c@7000d000 {
		pmic@3c {
			regulators {
				vddio_sdmmc1: ldo2 {
					/* Regulator entries for LDO2 */
				};

				vdd_cam: ldo3 {
					/* Regulator entries for LDO3 */
				};
			};
		};
	};

	pmc@7000e400 {
		vddio-cam-supply = <&vdd_cam>;
		vddio-sdmmc1-supply = <&vddio_sdmmc1>;

		pinctrl-names = "default";
		pinctrl-0 = <&tegra_io_pad_volt_default>;
		tegra_io_pad_volt_default: common {
			audio-hv {
				pins = "audio-hv";
				low-power-disable;
			};

			gpio {
				pins = "gpio";
				low-power-disable;
			};

			audio {
				pins = "audio", "dmic", "sdmmc3";
				low-power-enable;
			};
		};

	};
```

## Documentation/devicetree/bindings/pinctrl/nvidia,tegra210-io-pad.txt
```
NVIDIA Tegra210 PMC IO pad controller

NVIDIA Tegra210 supports IO pads which can operate at 1.8V or 3.3V I/O
power rail source. SW needs to configure the voltage level of IO pads
based on platform specific power tree.

The voltage configurations of IO pads should be done in boot if it is not
going to change other wise dynamically based on IO rail voltage on that
IO pads.

The DT property of the io pads must be under the node of pmc i.e.
pmc@7000e400 for Tegra210.

Please refer to <pinctrl-bindings.txt> in this directory for details of the
common pinctrl bindings used by client devices, including the meaning of the
phrase "pin configuration node".

Tegra's pin configuration nodes act as a container for an arbitrary number of
subnodes. Each of these subnodes represents some desired configuration for an
IO pads, or a list of IO pads. This configuration can include the voltage and
power enable/disable control

The name of each subnode is not important; all subnodes should be enumerated
and processed purely based on their content. Each subnode only affects those
parameters that are explicitly listed. Unspecified is represented as an absent
property,

See the TRM to determine which properties and values apply to each IO pads.
Macro values for property values are defined in
<dt-bindings/pinctrl/pinctrl-tegra210-io-pad.h>

The voltage supported on the pads are 1.8V and 3.3V. The enums are defined as:
	For 1.8V, use TEGRA_IO_PAD_POWER_SOURCE_1800000UV
	For 3.3V, use TEGRA_IO_PAD_POWER_SOURCE_3300000UV

Required subnode-properties:
==========================
- pins : An array of strings. Each string contains the name of an IO pads. Valid
	 values for these names are listed below.

Optional subnode-properties:
==========================
-nvidia,power-source-voltage:	Integer. The voltage level of IO pads. The
				valid values are 1.8V and 3.3V. Macros are
				defined for these voltage levels in
				<dt-bindings/pinctrl/pinctrl-tegra210-io-pad.h>
				Use TEGRA_IO_PAD_POWER_SOURCE_1800000UV for 1.8V
				Use TEGRA_IO_PAD_POWER_SOURCE_3300000UV for 3.3V

				All IO pads do not support the 1.8V/3.3V
				configurations. Valid values for "pins" are
				audio-hv, dmic, gpio, sdmmc1, sdmmc3, spi-hv.

Other than above, following properties are supported from generic pin
configuration explained in <dt-bindings/pinctrl/pinctrl-binding.txt>.
low-power-enable:		enable low power mode.
low-power-disable:		disable low power mode.

Valid values for pin for low power mode supports are:
	audio, audio-hv, cam, csia, csib, csic, csid, csie, csif,
	dbg, debug-nonao, dmic, dp, dsi, dsib, dsic, dsid, emmc, emmc2,
	gpio, hdmi, hsic, lvds, mipi-bias, pex-bias, pex-clk1, pex-clk2,
	pex-ctrl, sdmmc1, sdmmc3, spi, spi-hv, uart, usb-bias, usb0,
	usb1, usb2, usb3.

Example:
	#include <dt-bindings/pinctrl/pinctrl-tegra210-io-pad.h>
	pmc@7000e400 {

		pinctrl-names = "default";
		pinctrl-0 = <&tegra_io_pad_volt_default>;
		tegra_io_pad_volt_default: common {
			audio-hv {
				pins = "audio-hv";
				nvidia,power-source-voltage = <TEGRA_IO_PAD_POWER_SOURCE_3300000UV>;
			};

			gpio {
				pins = "gpio";
				invidia,power-source-voltage = <TEGRA_IO_PAD_POWER_SOURCE_1800000UV>;
			};

			audio {
				pins = "audio", "dmic", "sdmmc1", "sdmmc3";
				low-power-enable;
			};
		};
	};
```
