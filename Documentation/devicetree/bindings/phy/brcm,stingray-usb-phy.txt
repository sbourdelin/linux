## Documentation/devicetree/bindings/phy/brcm,stingray-usb-phy.txt
```
Broadcom Stingray USB PHY

Required properties:
 - compatible : should be one of the listed compatibles
	- "brcm,sr-usb-phy"
	- "brcm,sr-usb-phy-v2"
 - reg: offset and length of the PHY blocks registers
 - address-cells: should be 1
 - size-cells: should be 0

Sub-nodes:
  Each port's PHY should be represented as a sub-node.

Sub-nodes required properties:
 - reg: required for brcm,sr-usb-phy model phy.
	reg value 0 is HS phy and 1 is SS phy.
 - phy-cells: generic PHY binding; must be 0

Refer to phy/phy-bindings.txt for the generic PHY binding properties

Example:
	usbphy0: usb-phy@0 {
		compatible = "brcm,sr-usb-phy";
		reg = <0x00000000 0x100>;
		#address-cells = <1>;
		#size-cells = <0>;

		usb0_phy0: phy@0 {
			reg = <0>;
			#phy-cells = <0>;
		};

		usb0_phy1: phy@1 {
			reg = <1>;
			#phy-cells = <0>;
		};
	};

	usbphy1: usb-phy@10000 {
		compatible = "brcm,sr-usb-phy";
		reg = <0x00010000 0x100>,
		#address-cells = <1>;
		#size-cells = <0>;

		usb1_phy0: phy@0 {
			reg = <0>;
			#phy-cells = <0>;
		};

		usb1_phy1: phy@1 {
			reg = <1>;
			#phy-cells = <0>;
		};
	};

	usbphy2: usb-phy@20000 {
		compatible = "brcm,sr-usb-phy-v2";
		reg = <0x00020000 0x100>,
		#address-cells = <1>;
		#size-cells = <0>;
		#phy-cells = <0>;
	};
```

## Documentation/devicetree/bindings/phy/cdns-sierra-phy.txt
```
Cadence Sierra PHY
-----------------------

Required properties:
- compatible:	cdns,sierra-phy-t0
- clocks:	Must contain an entry in clock-names.
		See ../clocks/clock-bindings.txt for details.
- clock-names:	Must be "phy_clk"
- resets:	Must contain an entry for each in reset-names.
		See ../reset/reset.txt for details.
- reset-names:	Must include "sierra_reset" and "sierra_apb" and one for each
		sub-node.
		"sierra_reset" must control the reset line to the PHY.
		"sierra_apb" must control the reset line to the APB PHY
		interface.
		Resets for each subnode must control the master lane for the
		subnode lane group.
- reg:		register range for the PHY.
- reg-names:	Must be "reg".
- #address-cells: Should be 1
- #size-cells:	Should be 0

Optional properties:
- cdns,autoconf:	If present, indicates that the PHY registers will
			be configured by hardware.  If not present, all
			sub-node optional properties must be provided.

Sub-nodes:
  Each group of PHY lanes with a single master lane should be represented as
  a sub-node. Note that the actual configuration of each lane is determined by
  hardware strapping, and must match the configuration specified here.

Sub-node required properties:
- #phy-cells:	Generic PHY binding; must be 0.

Sub-node optional properties:
- reg:			The master lane number.
- cdns,num-lanes:	Number of lanes in this group.  From 1 to 4.
- cdns,phy-type:	Can be PHY_TYPE_PCIE or PHY_TYPE_USB3, depending on
			configuration of lanes.

Example:
	pcie_phy4: pcie-phy4@fd240000 {
		compatible = "cdns,sierra-phy-t0";
		reg = <0x0 0xfd240000 0x0 0x40000>;
		reg-names = "reg";
		resets = <&phyrst 0>, <&phyrst 1>,<&phyrst 2>,<&phyrst 4>;
		reset-names = "sierra_reset","sierra_apb","pcie_phy0",pcie_phy1;
		clocks = <&phyclock>;
		clock-names = "phy_clk";
		#address-cells = <1>;
		#size-cells = <0>;
		pcie0_phy0: pcie-phy0@0 {
				reg = <0>;
				cdns,num-lanes = <2>;
				#phy-cells = <0>;
				cdns,phy-type = <PHY_TYPE_PCIE>;
		};
		pcie0_phy1: pcie-phy1@0 {
				reg = <2>;
				cdns,num-lanes = <1>;
				#phy-cells = <0>;
				cdns,phy-type = <PHY_TYPE_PCIE>;
		};
```

## Documentation/devicetree/bindings/phy/phy-da8xx-usb.txt
```
TI DaVinci DA8xx USB PHY

Required properties:
 - compatible: must be "ti,da830-usbphy".
 - #phy-cells: must be 1.

This device controls the PHY for both the USB 1.1 OHCI and USB 2.0 OTG
controllers on DA8xx SoCs. Consumers of this device should use index 1 for
the USB 1.1 phy device and index 2 for the USB 2.0 phy device.

It also requires a "syscon" node with compatible = "ti,da830-cfgchip", "syscon"
to access the CFGCHIP2 register.

Example:

	cfgchip: cfgchip@1417c {
		compatible = "ti,da830-cfgchip", "syscon";
		reg = <0x1417c 0x14>;
	};

	usbphy: usbphy {
		compatible = "ti,da830-usbphy";
		#phy-cells = <1>;
	};

	usb11: usb@225000 {
		compatible = "ti,da830-ohci";
		reg = <0x225000 0x1000>;
		interrupts = <59>;
		phys = <&usbphy 1>;
		phy-names = "usbphy";
	};

	usb20: usb@200000 {
		compatible = "ti,da830-musb";
		reg = <0x200000 0x1000>;
		interrupts = <58>;
		phys = <&usbphy 2>;
		phy-names = "usbphy";
	};
```

## Documentation/devicetree/bindings/phy/phy-hisi-inno-usb2.txt
```
HiSilicon INNO USB2 PHY
-----------------------
Required properties:
- compatible: Should be one of the following strings:
		"hisilicon,inno-usb2-phy",
		"hisilicon,hi3798cv200-usb2-phy",
- #phy-cells: Must be 0
- hisilicon,peripheral-syscon: Phandle of syscon used to control phy.
- clocks: Phandle and clock specifier pair for reference clock utmi_refclk.
- resets: List of phandle and reset specifier pairs for each reset signal in
reset-names.
- reset-names: Should be "por_rst" and "test_rst". The test_rst only
exists in some of SOCs, so it is optional.

Phy node can include up to four subnodes. Each subnode represents one port.
The required properties of port node are as follows:
- clocks: Phandle and clock specifier pair for utmi_clock.
- resets: List of phandle and reset specifier pairs for port reset and utmi reset.
- reset-names: List of reset signal names. Should be "port_rst" and "utmi_rst"

Refer to phy/phy-bindings.txt for the generic PHY binding properties

Example:
usb_phy: phy {
		 compatible = "hisilicon,inno_usb2_phy";
		 #phy-cells = <0>;
		 hisilicon,peripheral-syscon = <&peri_ctrl>;
		 clocks = <&crg USB2_REF_CLK>;
		 resets = <&crg 0xb4 2>;
		 reset-names = "por_rst";
		 port0 {
			 clocks = <&crg USB2_UTMI0_CLK>;
			 resets = <&crg 0xb4 5>, <&crg 0xb4 1>;
			 reset-names = "port_rst", "utmi_rst";
		 };
	 };
```

## Documentation/devicetree/bindings/phy/phy-mapphone-mdm6600.txt
```
Device tree binding documentation for Motorola Mapphone MDM6600 USB PHY

Required properties:
- compatible	Must be "motorola,mapphone-mdm6600"
- enable-gpios	GPIO to enable the USB PHY
- power-gpios	GPIO to power on the device
- reset-gpios	GPIO to reset the device
- mode-gpios	Two GPIOs to configure MDM6600 USB start-up mode for
		normal mode versus USB flashing mode
- status-gpios	Three GPIOs to read the power state of the MDM6600
- cmd-gpios	Three GPIOs to control the power state of the MDM6600

Example:

fsusb1_phy: fsusb1_phy {
	compatible = "motorola,mapphone-mdm6600";
	enable-gpios = <&gpio3 31 GPIO_ACTIVE_LOW>;     /* gpio_95 */
	power-gpios = <&gpio2 22 GPIO_ACTIVE_HIGH>;	/* gpio_54 */
	reset-gpios = <&gpio2 17 GPIO_ACTIVE_HIGH>;	/* gpio_49 */
	mode-gpios = <&gpio5 20 GPIO_ACTIVE_HIGH>,	/* gpio_148 */
		     <&gpio5 21 GPIO_ACTIVE_HIGH>;	/* gpio_149 */
	status-gpios = <&gpio2 23 GPIO_ACTIVE_HIGH>,	/* gpio_55 */
		       <&gpio2 21 GPIO_ACTIVE_HIGH>,	/* gpio_53 */
		       <&gpio2 20 GPIO_ACTIVE_HIGH>;	/* gpio_52 */
	cmd-gpios = <&gpio4 7 GPIO_ACTIVE_HIGH>,	/* gpio_103 */
		    <&gpio4 8 GPIO_ACTIVE_HIGH>,	/* gpio_104 */
		    <&gpio5 14 GPIO_ACTIVE_HIGH>;	/* gpio_142 */
	#phy-cells = <0>;
};
```

## Documentation/devicetree/bindings/phy/phy-nop.txt
```
Generic No-Op PHY
-----------------

Required properties:
 - compatible: compatible list, contains "phy-nop".
 - #phy-cells: must be 0.

Optional properties:
 - clocks: a list of phandles and clock-specifier pairs,
	   one for each entry in clock-names.
 - clock-names: must be "main_clk" for phy core clock,
			"ref_clk" for phy reference clk.
 - resets: a list of phandles and reset controller specifier pairs,
	   one for each entry in reset-names.
 - reset-names: must be	"phy" for reset of phy block.
 - vdd-supply: Phandle to a regulator supply to PHY core block.

Example:
	phy_nop: phy_nop {
		compatible = "phy-nop";
		#phy-cells = <0>;
	};
```

## Documentation/devicetree/bindings/phy/phy-of-simple.txt
```
Generic simple phy device tree binding
--------------------------------------

A good number of phy implementations merely read dts properties,
enable clocks, regulators or do resets without having a dedicated register
map. This binding implements a generic phy driver which can be used for
such simple implementations and avoid boilerplate code duplication.

Required Properties:
-  compatible	: must be "simple-phy"
-  phy-cells    : must be 0

Optional Properties:
-  bus-width	: generic bus-width. Must be positive.
-  max-bitrate	: generic max-bitrate. Must be positive.
-  pwr		: phandle to phy pwr regulator node.

Example:

The following example is a can transceiver implemented as a generic phy.
It has a max-bitrate property and a pwr regulator.


transceiver1: can-transceiver {
	compatible = "simple-phy";
	max-bitrate = <5000000>;
	pwr-supply = <&transceiver1_fixed>;
	#phy-cells = <0>;
};
```

## Documentation/devicetree/bindings/phy/phy-qcom-ipq4019-usb.txt
```
Qualcom Dakota HS/SS USB PHY

Required properties:
 - compatible: "qcom,ipq4019-usb-ss-phy",
	       "qcom,ipq4019-usb-hs-phy"
 - reg: offset and length of the registers
 - #phy-cells: should be 0
 - resets: the reset controllers as listed below
 - reset-names: the names of the reset controllers
	"por" - the POR reset line for SS and HS phys
	"srif" - the SRIF reset line for HS phys
Example:

usb-phy@a8000 {
	compatible = "qcom,ipq4019-usb-hs-phy";
	phy-cells = <0>;
	reg = <0xa8000 0x40>;
	resets = <&gcc USB2_HSPHY_POR_ARES>,
		 <&gcc USB2_HSPHY_S_ARES>;
	reset-names = "por", "srif";
};
```

## Documentation/devicetree/bindings/phy/phy-qoriq-usb3.txt
```
Driver for Freescale USB 3.0 PHY

Required properties:

- compatible :	fsl,qoriq-usb3-phy
- reg :		register mappings for Parameter Configuration Register
		and Phy base offset.
- reg-names :	"param_ctrl" and "phy_base"
- phy_type :	For multi port host USB controllers, should be one of
		"ulpi", or "serial". For dual role USB controllers,
		should be one of "ulpi", "utmi", "utmi_wide", or "serial".

Example:
		usbphy0: usb3-phy@084F0000 {
                        compatible = "fsl,qoriq-usb3-phy";
                        reg = <0x0 0x01570070 0x0 0xC>, <0x0 0x084F0000 0x0 0x5000>;
                        reg-names = "param_ctrl", "phy_base";
                        #phy-cells = <0>;
                        phy_type = "utmi";
                };

                usbphy1: usb3-phy@08500000 {
                        compatible = "fsl,qoriq-usb3-phy";
                        reg = <0x0 0x0157007C 0x0 0xC>, <0x0 0x08500000 0x0 0x5000>;
                        reg-names = "param_ctrl", "phy_base";
                        #phy-cells = <0>;
                        phy_type = "utmi";
                };

                usbphy2: usb3-phy@08510000 {
                        compatible = "fsl,qoriq-usb3-phy";
                        reg = <0x0 0x01570088 0x0 0xC>, <0x0 0x08510000 0x0 0x5000>;
                        reg-names = "param_ctrl", "phy_base";
                        #phy-cells = <0>;
                        phy_type = "utmi";
                };
```

## Documentation/devicetree/bindings/phy/phy-rockchip-inno-usb2.txt
```
ROCKCHIP USB2.0 PHY WITH INNO IP BLOCK

Required properties (phy (parent) node):
 - compatible : should be one of the listed compatibles:
	* "rockchip,rk3366-usb2phy"
	* "rockchip,rk3399-usb2phy"
 - #clock-cells : should be 0.
 - clock-output-names : specify the 480m output clock name.

Optional properties:
 - clocks : phandle + phy specifier pair, for the input clock of phy.
 - clock-names : input clock name of phy, must be "phyclk".
 - vbus_host-supply : phandle to a regulator that supplies host vbus.
 - vbus_otg-supply : phandle to a regulator that supplies otg vbus.

Required nodes : a sub-node is required for each port the phy provides.
		 The sub-node name is used to identify host or otg port,
		 and shall be the following entries:
	* "otg-port" : the name of otg port.
	* "host-port" : the name of host port.

Required properties (port (child) node):
 - #phy-cells : must be 0. See ./phy-bindings.txt for details.
 - interrupts : specify an interrupt for each entry in interrupt-names.
 - interrupt-names : a list which shall be the following entries:
	* "otg_id" : for the otg id interrupt.
	* "otg_bvalid" : for the otg vbus interrupt.
	* "linestate" : for the host/otg linestate interrupt.

Example:

grf: syscon@ff770000 {
	compatible = "rockchip,rk3366-grf", "syscon", "simple-mfd";
	#address-cells = <1>;
	#size-cells = <1>;

...

	u2phy: usb2-phy {
		compatible = "rockchip,rk3366-usb2phy";
		#clock-cells = <0>;
		clock-output-names = "sclk_otgphy0_480m";

		u2phy_otg: otg-port {
			#phy-cells = <0>;
			interrupts = <GIC_SPI 93 IRQ_TYPE_LEVEL_HIGH>,
				     <GIC_SPI 94 IRQ_TYPE_LEVEL_HIGH>,
				     <GIC_SPI 95 IRQ_TYPE_LEVEL_HIGH>;
			interrupt-names = "otg_id", "otg_bvalid", "linestate";
			status = "okay";
		};

		u2phy_host: host-port {
			#phy-cells = <0>;
			interrupts = <GIC_SPI 96 IRQ_TYPE_LEVEL_HIGH>;
			interrupt-names = "linestate";
			status = "okay";
		};
	};
};
```
