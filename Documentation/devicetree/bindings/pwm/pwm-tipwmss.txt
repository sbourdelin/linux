## Documentation/devicetree/bindings/remoteproc/qcom,adsp.txt
```
Qualcomm ADSP Peripheral Image Loader

This document defines the binding for a component that loads and boots firmware
on the Qualcomm ADSP core.

- compatible:
	Usage: required
	Value type: <string>
	Definition: must be one of:
		    "qcom,adsp-pil"

- interrupts-extended:
	Usage: required
	Value type: <prop-encoded-array>
	Definition: must list the watchdog, fatal IRQs ready, handover and
		    stop-ack IRQs

- interrupt-names:
	Usage: required
	Value type: <stringlist>
	Definition: must be "wdog", "fatal", "ready", "handover", "stop-ack"

- cx-supply:
	Usage: required
	Value type: <phandle>
	Definition: reference to the regulator to be held on behalf of the
		    booting of the Hexagon core

- memory-region:
	Usage: required
	Value type: <phandle>
	Definition: reference to the reserved-memory for the ADSP

- qcom,smem-states:
	Usage: required
	Value type: <phandle>
	Definition: reference to the smem state for requesting the ADSP to
		    shut down

- qcom,smem-state-names:
	Usage: required
	Value type: <stringlist>
	Definition: must be "stop"

= EXAMPLE
The following example describes the resources needed to boot control the
ADSP, as it is found on MSM8974 boards.

	adsp {
		compatible = "qcom,adsp-pil";

		interrupts-extended = <&intc 0 162 1>,
				      <&adsp_smp2p_in 0 0>,
				      <&adsp_smp2p_in 1 0>,
				      <&adsp_smp2p_in 2 0>,
				      <&adsp_smp2p_in 3 0>;
		interrupt-names = "wdog",
				  "fatal",
				  "ready",
				  "handover",
				  "stop-ack";

		cx-supply = <&pm8841_s2>;

		memory-region = <&adsp_region>;

		qcom,smem-states = <&adsp_smp2p_out 0>;
		qcom,smem-state-names = "stop";
	};
```

## Documentation/devicetree/bindings/remoteproc/qcom,q6v5-wcss.txt
```
Qualcomm Hexagon (Q6) - WCSS Peripheral Image Loader

This document defines the binding for a component that loads and boots firmware
on the integrated Qualcomm Hexagon - WCSS core.

- compatible:
	Usage: required
	Value type: <string>
	Definition: must be one of:
		    "qcom,q6v5-wcss-pil",
- reg:
	Usage: required
	Value type: <prop-encoded-array>
	Definition: must specify the base address and size of the qdsp6 and
		    mpm (msm power manager) register blocks.

- reg-names:
	Usage: required
	Value type: <stringlist>
	Definition: must be "q6" and "mpm"

- interrupts-extended:
	Usage: required
	Value type: <prop-encoded-array>
	Definition: must list the watchdog, fatal IRQs ready, handover and
		    stop-ack IRQs

- interrupt-names:
	Usage: required
	Value type: <stringlist>
	Definition: must be "wdog", "fatal", "ready", "handover", "stop-ack"

- clocks:
	Usage: required
	Value type: <phandle>
	Definition: references to the axim-q6, axim2-q6, axi-wcss,
		    ahb-q6, ahbs-q6, ahb-wcss, ahbs-wcss, sysnoc and mem.
		    to be held on behalf of the booting of the Hexagon and WCSS
		    core. These are the interface, bus, mem clocks required for
		    the Q6 and WCSS cores.

- clock-names:
	Usage: required
	Value type: <stringlist>
	Definition: must be "axim-q6", "axim2-q6", "axi-wcss", "ahb-q6",
			    "ahbs-q6", "ahb-wcss", "ahbs-wcss", "sysnoc", "mem"

- resets:
	Usage: required
	Value type: <phandle>
	Definition: reference to the reset-controller for the Q6-WCSS sub-system

- reset-names:
	Usage: required
	Value type: <stringlist>
	Definition: must be "wcss_aon_reset", "wcss_reset", "wcss_q6_reset"

- qcom,smem-states:
	Usage: required
	Value type: <phandle>
	Definition: reference to the smem state for requesting the Hexagon to
		    shut down

- qcom,smem-state-names:
	Usage: required
	Value type: <stringlist>
	Definition: must be "stop"

- qcom,halt-regs:
	Usage: required
	Value type: <prop-encoded-array>
	Definition: a phandle reference to a syscon representing TCSR followed
		    by the three offsets within syscon for q6, wcss and tcsr global
		    halt registers.

= SUBNODES:
The Hexagon node must contain a subnode, named "q6" representing
the memory region used by the Hexagon firmware. The sub-node must contain:

- memory-region:
	Usage: required
	Value type: <phandle>
	Definition: reference to the reserved-memory for the Q6 firmware region

= EXAMPLE
The following example describes the resources needed to boot control the
Hexagon, as it is found on IPQ8074 boards.

	q6v5_wcss: q6v5_wcss@CD00000 {
		compatible = "q6v5-wcss-pil";
		reg = <0xCD00000 0x4040>,
		      <0x4ab000 0x20>;
		reg-names = "q6",
			    "mpm";
		interrupts-extended = <&intc 0 325 1>,
				      <&wcss_smp2p_in 0 0>,
				      <&wcss_smp2p_in 1 0>,
				      <&wcss_smp2p_in 3 0>;
		interrupt-names = "wdog",
				  "fatal",
				  "handover",
				  "stop-ack";
		clocks = <&gcc GCC_SYS_NOC_WCSS_AHB_CLK>,
			 <&gcc GCC_WCSS_AHB_S_CLK>,
			 <&gcc GCC_WCSS_ECAHB_CLK>,
			 <&gcc GCC_Q6_AHB_CLK>,
			 <&gcc GCC_Q6_AHB_S_CLK>,
			 <&gcc GCC_WCSS_AXI_M_CLK>,
			 <&gcc GCC_MEM_NOC_Q6_AXI_CLK>,
			 <&gcc GCC_Q6_AXIM_CLK>,
			 <&gcc GCC_Q6_AXIM2_CLK>;
		clock-names = "sysnoc",
			      "ahb-wcss",
			      "ahbs-wcss",
			      "ahb-q6",
			      "ahbs-q6",
			      "axi-wcss",
			      "memnoc",
			      "axim-q6",
			      "axim2-q6";

		resets = <&gcc GCC_WCSSAON_RESET>,
			 <&gcc GCC_WCSS_BCR>,
			 <&gcc GCC_WCSS_Q6_BCR>;

		reset-names = "wcss_aon_reset",
			      "wcss_reset",
			      "wcss_q6_reset";

		qcom,halt-regs = <&tcsr_mutex_block 0x0 0xA000 0xD000>;

		qcom,smem-states = <&wcss_smp2p_out 0>,
				   <&wcss_smp2p_out 1>;
		qcom,smem-state-names = "shutdown",
					"stop";
		q6 {
			memory-region = <&q6_region>;
		};
	};
```

## Documentation/devicetree/bindings/remoteproc/remoteproc.txt
```
Common remoteproc properties

A remoteproc node represents the mechanism and resources needed for controlling
a co-processor's life cycle; including loading firmware, booting, shutting down
and handling exceptions.


= Consumer properties
A consumer node referencing a remoteproc node, so that it can requests life
cycle transitions can use the following properties:

- rprocs:
	Usage: required
	Value type: <prop-encoded-array>
	Definition: a list of phandle references to remoteproc nodes

- rproc-names:
	Usage: optional
	Value type: <stringlist>
	Definition: a list of strings naming each entry in "rprocs", allowing
		    consumer drivers to look up remoteprocs by name
```

## Documentation/devicetree/bindings/reset/oxnas,reset.txt
```
Oxford Semiconductor OXNAS SoC Family RESET Controller
================================================

Please also refer to reset.txt in this directory for common reset
controller binding usage.

Required properties:
- compatible: Should be "oxsemi,ox810se-reset" or "oxsemi,ox820-reset"
- #reset-cells: 1, see below

Parent node should have the following properties :
- compatible: Should be "oxsemi,ox810se-sys-ctrl", "syscon", "simple-mfd" or
	"oxsemi,ox820-sys-ctrl", "syscon", "simple-mfd"

example:

sys: sys-ctrl@000000 {
	compatible = "oxsemi,ox810se-sys-ctrl", "syscon", "simple-mfd";
	reg = <0x000000 0x100000>;

	reset: reset-controller {
		compatible = "oxsemi,ox810se-reset";
		#reset-cells = <1>;
	};
};
```

## Documentation/devicetree/bindings/reset/qcom,aoss-reset.txt
```
Qualcomm AOSS Reset Controller
======================================

This binding describes a reset-controller found on AOSS (Always on SubSysem)
for Qualcomm SDM845 SoCs.

Required properties:
- compatible:
	Usage: required
	Value type: <string>
	Definition: must be:
		    "qcom,aoss-reset-sdm845", "syscon"

- reg:
	Usage: required
	Value type: <prop-encoded-array>
	Definition: must specify the base address and size of the
		    syscon device.


- #reset-cells:
	Usage: required
	Value type: <uint>
	Definition: must be 1; cell entry represents the reset index.

example:

aoss_reset: qcom,reset-controller@b2e0100 {
	compatible = "qcom,aoss-reset-sdm845", "syscon";
	reg = <0xc2b0000 0x20004>;
	#reset-cells = <1>;
};


Specifying reset lines connected to IP modules
==============================================

Device nodes that need access to reset lines should
specify them as a reset phandle in their corresponding node as
specified in reset.txt.

Example:

	modem-pil@4080000 {
		...

		resets = <&aoss_reset AOSS_CC_MSS_RESTART>;
		reset-names = "mss_restart";

		...
        };

For list of all valid reset indicies see
<dt-bindings/reset/qcom,aoss-sdm845.h>
```
