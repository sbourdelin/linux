## Documentation/devicetree/bindings/pwm/pwm-tipwmss.txt
```
TI SOC based PWM Subsystem

Required properties:
- compatible: Must be "ti,am33xx-pwmss";
- reg: physical base address and size of the registers map.
- address-cells: Specify the number of u32 entries needed in child nodes.
		  Should set to 1.
- size-cells: specify number of u32 entries needed to specify child nodes size
		in reg property. Should set to 1.
- ranges: describes the address mapping of a memory-mapped bus. Its value
	  should be empty since no address translation is needed between the
	  parent and the child.

Also child nodes should also populated under PWMSS DT node.

Example:
pwmss0: pwmss@48300000 {
	compatible = "ti,am33xx-pwmss";
	reg = <0x48300000 0x10>;
	ti,hwmods = "epwmss0";
	#address-cells = <1>;
	#size-cells = <1>;
	status = "disabled";
	ranges;

	/* child nodes go here */
};
```

## Documentation/devicetree/bindings/regulator/act8945a-regulator.txt
```
Device-Tree bindings for regulators of Active-semi ACT8945A Multi-Function Device

Required properties:
 - compatible: "active-semi,act8945a-regulator"

Optional properties:
- active-semi,vsel-high: Indicates if the VSEL pin is set to logic-high.
  If this property is missing, assume the VSEL pin is set to logic-low.

Optional input supply properties:
  - vp1-supply: The input supply for DCDC_REG1
  - vp2-supply: The input supply for DCDC_REG2
  - vp3-supply: The input supply for DCDC_REG3
  - inl45-supply: The input supply for LDO_REG1 and LDO_REG2
  - inl67-supply: The input supply for LDO_REG3 and LDO_REG4

Any standard regulator properties can be used to configure the single regulator.

The valid names for regulators are:
	DCDC_REG1, DCDC_REG2, DCDC_REG3, LDO_REG1, LDO_REG2, LDO_REG3, LDO_REG4.

Example:

	pmic {
		compatible = "active-semi,act8945a-regulator";
		active-semi,vsel-high;

		regulators {
			vdd_1v35_reg: DCDC_REG1 {
				regulator-name = "VDD_1V35";
				regulator-min-microvolt = <1350000>;
				regulator-max-microvolt = <1350000>;
				regulator-always-on;
			};

			vdd_1v2_reg: DCDC_REG2 {
				regulator-name = "VDD_1V2";
				regulator-min-microvolt = <1100000>;
				regulator-max-microvolt = <1300000>;
				regulator-always-on;
			};

			vdd_3v3_reg: DCDC_REG3 {
				regulator-name = "VDD_3V3";
				regulator-min-microvolt = <3300000>;
				regulator-max-microvolt = <3300000>;
				regulator-always-on;
			};

			vdd_fuse_reg: LDO_REG1 {
				regulator-name = "VDD_FUSE";
				regulator-min-microvolt = <2500000>;
				regulator-max-microvolt = <2500000>;
				regulator-always-on;
			};

			vdd_3v3_lp_reg: LDO_REG2 {
				regulator-name = "VDD_3V3_LP";
				regulator-min-microvolt = <3300000>;
				regulator-max-microvolt = <3300000>;
				regulator-always-on;
			};

			vdd_led_reg: LDO_REG3 {
				regulator-name = "VDD_LED";
				regulator-min-microvolt = <3300000>;
				regulator-max-microvolt = <3300000>;
				regulator-always-on;
			};

			vdd_sdhc_1v8_reg: LDO_REG4 {
				regulator-name = "VDD_SDHC_1V8";
				regulator-min-microvolt = <1800000>;
				regulator-max-microvolt = <1800000>;
				regulator-always-on;
			};
		};
	};
```

## Documentation/devicetree/bindings/regulator/arizona-regulator.txt
```
Cirrus Logic Arizona class audio SoCs

These devices are audio SoCs with extensive digital capabilities and a range
of analogue I/O.

This document lists regulator specific bindings, see the primary binding
document:
  ../mfd/arizona.txt

Optional properties:
  - wlf,ldoena : GPIO specifier for the GPIO controlling LDOENA

Optional subnodes:
  - ldo1 : Initial data for the LDO1 regulator, as covered in
    Documentation/devicetree/bindings/regulator/regulator.txt
  - micvdd : Initial data for the MICVDD regulator, as covered in
    Documentation/devicetree/bindings/regulator/regulator.txt

  - MICBIASx : Initial data for the MICBIAS regulators, as covered in
    Documentation/devicetree/bindings/regulator/regulator.txt but the
    following additional properties are also supported:
      - wlf,ext-cap : Specifies if the MICBIAS has external decoupling
        capacitors attached.
```

## Documentation/devicetree/bindings/regulator/coupled-voltage.txt
```
Coupled voltage regulators

Required properties:
- compatible		: Must be "coupled-voltage-regulator".

Optional properties:
- vinX-supply		: Phandle to the regulators it aggregates

Any property defined as part of the core regulator binding defined in
regulator.txt can also be used.

Example:
	vcc_wifi: wifi_reg {
		compatible = "coupled-voltage-regulator";
		regulator-name = "vcc-wifi";
		vin0-supply = <&reg_ldo3>;
		vin1-supply = <&reg_ldo4>;
	};
```

## Documentation/devicetree/bindings/regulator/fixed-regulator.txt
```
Fixed Voltage regulators

Required properties:
- compatible: Must be "regulator-fixed";
- regulator-name: Defined in regulator.txt as optional, but required here.

Optional properties:
- gpio: gpio to use for enable control
- startup-delay-us: startup time in microseconds
- enable-active-high: Polarity of GPIO is Active high
  If this property is missing, the default assumed is Active low.
  If the phandle flags to the GPIO handle also flag the line as active
  low or high, that will be ignored for fixed regulators and the
  presence or absence of this flag solely controls the inversion
  semantics.
-vin-supply: Input supply name.

Deprecated properties:
- gpio-open-drain: GPIO is open drain type.
  If this property is missing then default assumption is false.
  Do not use this property in new device trees: instead use the
  phandle flag to indicate to the GPIO provider that the line
  should be handled as open drain.

Any property defined as part of the core regulator
binding, defined in regulator.txt, can also be used.
However a fixed voltage regulator is expected to have the
regulator-min-microvolt and regulator-max-microvolt
to be the same.

Example:

	abc: fixedregulator@0 {
		compatible = "regulator-fixed";
		regulator-name = "fixed-supply";
		regulator-min-microvolt = <1800000>;
		regulator-max-microvolt = <1800000>;
		gpio = <&gpio1 16 0>;
		startup-delay-us = <70000>;
		enable-active-high;
		regulator-boot-on;
		gpio-open-drain;
		vin-supply = <&parent_reg>;
	};
```

## Documentation/devicetree/bindings/regulator/hisilicon,hi655x-regulator.txt
```
Hisilicon Hi655x Voltage regulators

Note:
The hi655x regulator control is managed by hi655x Power IC.
So the node of this regulator must be child node of hi655x
pmic node.

The driver uses the regulator core framework, so please also
take the bindings of regulator.txt for reference.

Example:
        pmic: pmic@f8000000 {
                compatible = "hisilicon,hi655x-pmic";
		...
		ldo2: ldo2@a21 {
			compatible = "hisilicon,hi655x-regulator";
			regulator-name = "ldo2";
			regulator-min-microvolt = <2500000>;
			regulator-max-microvolt = <3200000>;
			regulator-valid-modes-mask = <0x02>;
			regulator-enable-ramp-delay = <120>;
		};
		...
	}
```

## Documentation/devicetree/bindings/regulator/lm363x-regulator.txt
```
TI LMU LM363x regulator device tree bindings

LM363x regulator driver supports LM3631 and LM3632.
LM3631 has five regulators and LM3632 supports three regulators.

Required properties:
  - compatible: "ti,lm363x-regulator"

Child nodes:
  LM3631
  - vboost
  - vcont
  - voref
  - vpos
  - vneg

  LM3632
  - vboost
  - vpos
  - vneg

  Optional properties of each node:
  Please refer to [1].

Examples: Please refer to ti-lmu dt-bindings [2].

[1] Documentation/devicetree/bindings/regulator/regulator.txt
[2] Documentation/devicetree/bindings/mfd/ti-lmu.txt
```

## Documentation/devicetree/bindings/regulator/madera-ldo1.txt
```
Cirrus Logic Madera class audio codecs LDO1 regulator driver

Only required if you are using the codec internal LDO1 regulator.
This is a subnode of the parent mfd node.

See also the core bindings for the parent MFD driver:
See Documentation/devicetree/bindings/mfd/madera.txt

Required properties:
  - compatible :  must be "cirrus,madera-ldo1"
  - LDOVDD-supply : Power supply for the LDO1 regulator.

  - enable-gpio	: GPIO to use to enable/disable the regulator.
    As defined in bindings/gpio.txt.

Optional subnodes:
  Standard regulator bindings as described in bindings/regulator/regulator.txt

Example:

codec: cs47l85@0 {
	compatible = "cirrus,cs47l85";

	ldo1 {
		compatible = "cirrus,madera-ldo1";
		LDOVDD-supply = <&pmic_vdd1>;
		enable-gpio = <&gpio 0>;
	};
};
```

## Documentation/devicetree/bindings/regulator/madera-micsupp.txt
```
Cirrus Logic Madera class audio codecs mic supply regulator driver

Only required if the codec has an internal mic supply regulator.
This is a subnode of the parent mfd node.

See also the core bindings for the parent MFD driver:
See Documentation/devicetree/bindings/mfd/madera.txt

Required properties:
  - compatible :  must be "cirrus,madera-micsupp"

Optional subnodes:
  Standard regulator bindings as described in bindings/regulator/regulator.txt

Example:

codec: cs47l85@0 {
	compatible = "cirrus,cs47l85";

	micvdd {
		compatible = "cirrus,madera-micsupp";
		regulator-min-microvolt = <900000>;
		regulator-max-microvolt = <3300000>;
		regulator-allow-bypass = <1>;
	};
};
```

## Documentation/devicetree/bindings/regulator/mt6380-regulator.txt
```
Mediatek MT6380 Regulator Driver

All voltage regulators are defined as subnodes of the regulators node. A list
of regulators provided by this controller are defined as subnodes of the
PMIC's node. Each regulator is named according to its regulator type,
buck_<name> and ldo_<name>. The definition for each of these nodes is defined
using the standard binding for regulators at
Documentation/devicetree/bindings/regulator/regulator.txt.

The valid names for regulators are::
BUCK:
  buck_vcore1, buck_vcore, buck_vrf
LDO:
  ldo_vmldo ,ldo_valdo , ldo_vphyldo, ldo_vddrldo, ldo_vtldo

Example:

	mt6380regulator: mt6380regulator {
		compatible = "mediatek,mt6380-regulator";

		mt6380_vcpu_reg: buck_vcore1 {
			regulator-name = "vcpu";
			regulator-min-microvolt = < 600000>;
			regulator-max-microvolt = <1393750>;
			regulator-ramp-delay = <6250>;
			regulator-always-on;
			regulator-boot-on;
		};

		mt6380_vcore_reg: buck_vcore {
			regulator-name = "vcore";
			regulator-min-microvolt = <600000>;
			regulator-max-microvolt = <1393750>;
			regulator-ramp-delay = <6250>;
		};

		mt6380_vrf_reg: buck_vrf {
			regulator-name = "vrf";
			regulator-min-microvolt = <1200000>;
			regulator-max-microvolt = <1575000>;
			regulator-ramp-delay = <0>;
			regulator-always-on;
			regulator-boot-on;
		};

		mt6380_vm_reg: ldo_vmldo {
			regulator-name = "vmldo";
			regulator-min-microvolt = <1050000>;
			regulator-max-microvolt = <1400000>;
			regulator-ramp-delay = <0>;
			regulator-always-on;
			regulator-boot-on;
		};

		mt6380_va_reg: ldo_valdo {
			regulator-name = "valdo";
			regulator-min-microvolt = <2200000>;
			regulator-max-microvolt = <3300000>;
			regulator-ramp-delay = <0>;
			regulator-always-on;
			regulator-boot-on;
		};

		mt6380_vphy_reg: ldo_vphyldo {
			regulator-name = "vphyldo";
			regulator-min-microvolt = <1800000>;
			regulator-max-microvolt = <1800000>;
			regulator-ramp-delay = <0>;
			regulator-always-on;
			regulator-boot-on;
		};

		mt6380_vddr_reg: ldo_vddrldo {
			regulator-name = "vddr";
			regulator-min-microvolt = <1240000>;
			regulator-max-microvolt = <1840000>;
			regulator-ramp-delay = <0>;
			regulator-always-on;
			regulator-boot-on;
		};

		mt6380_vt_reg: ldo_vtldo {
			regulator-name = "vadc18";
			regulator-min-microvolt = <2200000>;
			regulator-max-microvolt = <3300000>;
			regulator-ramp-delay = <0>;
			regulator-always-on;
			regulator-boot-on;
		};
	};
```

## Documentation/devicetree/bindings/regulator/pwm-regulator.txt
```
Bindings for the Generic PWM Regulator
======================================

Currently supports following modes of operation:

Voltage Table:		When in this mode, a voltage table (See below) of
			predefined voltage <=> duty-cycle values must be
			provided via DT. Limitations are that the regulator can
			only operate at the voltages supplied in the table.
			Intermediary duty-cycle values which would normally
			allow finer grained voltage selection are ignored and
			rendered useless.  Although more control is given to
			the user if the assumptions made in continuous-voltage
			mode do not reign true.

Continuous Voltage:	This mode uses the regulator's maximum and minimum
			supplied voltages specified in the
			regulator-{min,max}-microvolt properties to calculate
			appropriate duty-cycle values.  This allows for a much
			more fine grained solution when compared with
			voltage-table mode above.  This solution does make an
			assumption that a %50 duty-cycle value will cause the
			regulator voltage to run at half way between the
			supplied max_uV and min_uV values.

Linear Equal Step:	This modes divides the regulator's maximum and minimum
			supplied voltages into specified equal steps. The
			number of steps must equally divides the PWM periods.
			On this case, step is translated into number of pulse
			in PWM periods and then multiplied by voltage
			selectors number to get the duty cycles of PWM.

Required properties:
--------------------
- compatible:		Should be "pwm-regulator"

- pwms:			PWM specification (See: ../pwm/pwm.txt)

Optional properties:
--------------------
For Voltage Table Mode, following properties must be supplied:
- voltage-table: 	Voltage and Duty-Cycle table consisting of 2 cells
			    First cell is voltage in microvolts (uV)
			    Second cell is duty-cycle in percent (%)

For Linear Equal Steps, following properties must be supplied:
- regulator-n-voltages:	Number of voltage steps between regulator's minimum
			and maximum.

NB: To be clear, if voltage-table is provided, then the device will be used
in Voltage Table Mode.  If regulator-n-voltages is provided then the device
will be used in Linear Equal Step Mode. If both properties are not provided,
then the device will be used in Continuous Voltage Mode.

Any property defined as part of the core regulator binding can also be used.
(See: ../regulator/regulator.txt)

Continuous Voltage Example:
	pwm_regulator {
		compatible = "pwm-regulator;
		pwms = <&pwm1 0 8448 0>;
		regulator-min-microvolt = <1016000>;
		regulator-max-microvolt = <1114000>;
		regulator-name = "vdd_logic";
	};

Voltage Table Example:
	pwm_regulator {
		compatible = "pwm-regulator;
		pwms = <&pwm1 0 8448 0>;
		regulator-min-microvolt = <1016000>;
		regulator-max-microvolt = <1114000>;
		regulator-name = "vdd_logic";

			      /* Voltage Duty-Cycle */
		voltage-table = <1114000 0>,
				<1095000 10>,
				<1076000 20>,
				<1056000 30>,
				<1036000 40>,
				<1016000 50>;
	};

Linear Equal Step Mode Example:
	pwm-regulator@1 {
		compatible = "pwm-regulator";
		pwms = <&pwm 1 4880>;
		regulator-name = "vdd-gpu";
		regulator-min-microvolt = <710000>;
		regulator-max-microvolt = <1320000>;
		regulator-n-voltages = <62>;
	};
```
