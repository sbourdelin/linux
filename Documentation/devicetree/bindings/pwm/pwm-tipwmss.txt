## Documentation/devicetree/bindings/regulator/st-flashss.txt
```
ST Voltage regulator for FlashSS vsense

This documents the voltage regulator driver which manages the vsense inside the ST flash
sub-system that is used for configuring MMC, NAND, SPI voltages.

Required properties:
- compatible:		Can be "st,vqmmc", "st,vnand" or "st,vspi" because it is shared
			among these devices inside the ST FlashSS.
- regulator-name:	Regulator name.
- reg:			The vsense top config base address in the flashSS hardware.

Any property defined as part of the core regulator binding, in
Documentation/devicetree/bindings/regulator/regulator.txt can also be used.

Example:

vqmmc_reg: voltage-regulator {
	compatible = "st,vqmmc";
	regulator-name = "vqmmc0";
	/* Control register for the VSENSE Module */
	reg = <0x9061004 0x4>;
	status = "disabled";
	regulator-min-microvolt = <1800000>;
	regulator-max-microvolt = <3300000>;
	regulator-always-on;
};

mmc0: sdhci@09060000 {
	compatible = "st,sdhci-stih407", "st,sdhci";
	status = "disabled";
	reg = <0x09060000 0x7ff>, <0x9061008 0x20>;
	reg-names = "mmc", "top-mmc-delay";
	interrupts = <GIC_SPI 92 IRQ_TYPE_NONE>;
	interrupt-names = "mmcirq";
	pinctrl-names = "default";
	pinctrl-0 = <&pinctrl_mmc0>;
	clock-names = "mmc";
	clocks = <&clk_s_c0_flexgen CLK_MMC_0>;
	bus-width = <8>;
	non-removable;
	vqmmc-supply = <&vqmmc_reg>;
};
```

## Documentation/devicetree/bindings/regulator/tps6502x.txt
```
TPS6502x family of regulators

Required properties:
- compatible: "ti,tps65020", "ti,tps65021" or "ti,tps65023"
- reg: I2C slave address
- regulators: list of regulators provided by this controller, must be named
  after their hardware counterparts: dcdc[1-3] and ldo[1-2]
- regulators: This is the list of child nodes that specify the regulator
  initialization data for defined regulators. Not all regulators for the given
  device need to be present. The definition for each of these nodes is defined
  using the standard binding for regulators found at
  Documentation/devicetree/bindings/regulator/regulator.txt.

  The valid names for regulators are:
  tps6502x: dcdc1, dcdc2, dcdc3, ldo1 and ldo2

Each regulator is defined using the standard binding for regulators.

Example:

	tps: tps@48 {
		compatible = "ti,tps65023";

		regulators {
			vdcdc1_reg: regulator@0 {
				regulator-name = "vdd_core";
				regulator-min-microvolt = <1200000>;
				regulator-max-microvolt = <1200000>;
				regulator-always-on;
			};
			vdcdc2_reg: regulator@1 {
				regulator-name = "vddshv";
				regulator-min-microvolt = <3300000>;
				regulator-max-microvolt = <3300000>;
				regulator-always-on;
			};
			vdcdc3_reg: regulator@2 {
				regulator-name = "vdds";
				regulator-min-microvolt = <1800000>;
				regulator-max-microvolt = <1800000>;
				regulator-always-on;
			};
			vldo1_reg: regulator@3 {
				regulator-name = "vdda1p8v_usbphy";
				regulator-min-microvolt = <1800000>;
				regulator-max-microvolt = <1800000>;
				regulator-always-on;
			};
			vldo2_reg: regulator@4 {
				regulator-name = "vdda3p3v_usbphy";
				regulator-min-microvolt = <3300000>;
				regulator-max-microvolt = <3300000>;
				regulator-always-on;
			};
		};
	};
```

## Documentation/devicetree/bindings/regulator/tps65086-regulator.txt
```
* TPS65086 regulator bindings

Required properties:
 - compatible		: Should be "ti,tps65086-regulator".
 - list of regulators provided by this controller, must be named after their
     hardware counterparts: buck[1-6], ldoa[1-3], swa1, swb[1-2], and vtt.

Optional properties:
 - Per-regulator optional properties are defined in regulator.txt.
 - ti,regulator-step-size-25mv	: This is applicable for buck[1,2,6], set this
				  if the regulator is factory set with a 25mv
				  step voltage mapping.
 - ti,regulator-decay		: This is applicable for buck[1-6], set this if
				  the output needs to decay, default is for the
				  output to slew down.

Example:

	regulators {
		compatible = "ti,tps65086-regulator";

		buck1 {
			regulator-name = "vcc1";
			regulator-min-microvolt = <1600000>;
			regulator-max-microvolt = <1600000>;
			regulator-boot-on;
			ti,regulator-step-size-25mv;
			ti,regulator-decay;
		};

		swa1 {
			regulator-name = "ls1";
			regulator-boot-on;
		};
	};
```

## Documentation/devicetree/bindings/regulator/tps65218.txt
```
TPS65218 family of regulators

Required properties:
- compatible: "ti,tps65218"
- reg: I2C slave address

- List of regulators provided by this controller, must be named
  after their hardware counterparts: dcdc[1-6] and ldo1
- This is the list of child nodes that specify the regulator
  initialization data for defined regulators. Not all regulators for the given
  device need to be present. The definition for each of these nodes is defined
  using the standard binding for regulators found at ./regulator.txt.

  The valid names for regulators are:
  tps65217: regulator-dcdc1, regulator-dcdc2, regulator-dcdc3, regulator-dcdc4,
  regulator-dcdc5, regulator-dcdc6, regulator-ldo1, regulator-ls3.
  Each regulator is defined using the standard binding for regulators.

Optional properties:
  If any of these properties is absent then the corresponding setting will be
  untouched.
- ti,strict-supply-voltage-supervision: Set/Reset STRICT flag in CONFIG1.
  The supervisor has two modes of operation, controlled by the STRICT bit.
  With the STRICT bit set to 0, all five rails are monitored for under-voltage
  only with relaxed thresholds and deglitch times.
  With the STRCT bit set to 1, all five rails are monitored for under-voltage
  and over-voltage with tight limits and short deglitch times.
- ti,under-voltage-limit-microvolt: Configures UVLO in CONFIG1.
  Valid values are: 2750000, 2950000, 3250000, 3350000
- ti,under-voltage-hyst-microvolt: Select 200mV or 400mV UVLOHYS in CONFIG2
  Power rails are only enabled if the input voltage measured at the IN_BIAS pin
  is greater than the under-voltage lockout threshold plus hysteresis
  (UVLO + UVLOHYS). Once the input voltage rises above this level,
  the input voltage may drop to the UVLO level before the PMIC shuts down.
  UVLO is deglitched by 5 ms on rising and falling edge.

Example:
tps65218: tps65218@24 {
	reg = <0x24>;
	compatible = "ti,tps65218";
	interrupts = <GIC_SPI 7 IRQ_TYPE_NONE>; /* NMIn */
	interrupt-controller;
	ti,strict-supply-voltage-supervision = <1>;
	ti,under-voltage-hyst-microvolt = <400000>;
	ti,under-voltage-limit-microvolt = <3350000>;

	#interrupt-cells = <2>;

	dcdc1: regulator-dcdc1 {
		regulator-name = "vdd_core";
		regulator-min-microvolt = <912000>;
		regulator-max-microvolt = <1144000>;
		regulator-boot-on;
		regulator-always-on;
	};

	dcdc2: regulator-dcdc2 {
		regulator-name = "vdd_mpu";
		regulator-min-microvolt = <912000>;
		regulator-max-microvolt = <1378000>;
		regulator-boot-on;
		regulator-always-on;
	};

	dcdc3: regulator-dcdc3 {
		regulator-name = "vdcdc3";
		regulator-min-microvolt = <1500000>;
		regulator-max-microvolt = <1500000>;
		regulator-boot-on;
		regulator-always-on;
	};

	dcdc5: regulator-dcdc5 {
		regulator-name = "v1_0bat";
		regulator-min-microvolt = <1000000>;
		regulator-max-microvolt = <1000000>;
		regulator-boot-on;
		regulator-always-on;
	};

	dcdc6: regulator-dcdc6 {
		regulator-name = "v1_8bat";
		regulator-min-microvolt = <1800000>;
		regulator-max-microvolt = <1800000>;
		regulator-boot-on;
		regulator-always-on;
	};

	ldo1: regulator-ldo1 {
		regulator-min-microvolt = <1800000>;
		regulator-max-microvolt = <1800000>;
		regulator-boot-on;
		regulator-always-on;
	};

	ls3: regulator-ls3 {
		regulator-min-microvolt = <100000>;
		regulator-max-microvolt = <1000000>;
	};
};
```

## Documentation/devicetree/bindings/regulator/tps65912-regulator.txt
```
* TPS65912 regulator bindings

Required properties:
 - compatible: "ti,tps65912-regulator"
 - list of regulators provided by this controller, must be named
     after their hardware counterparts: dcdc[1-4] and ldo[1-10]

Each regulator is defined using the standard binding for regulators.

Example:

	tps65912_regulator {
		compatible = "ti,tps65912-regulator";

		dcdc1 {
			regulator-name = "vdd_core";
			regulator-min-microvolt = <912000>;
			regulator-max-microvolt = <1144000>;
			regulator-boot-on;
			regulator-always-on;
		};

		ldo1 {
			regulator-name = "ldo1";
			regulator-min-microvolt = <1900000>;
			regulator-max-microvolt = <1900000>;
		};
	};
```

## Documentation/devicetree/bindings/regulator/twl6032-regulator.txt
```
TWL6032 PMIC Voltage Regulator Bindings

The parent node must be MFD TWL Core, ti,twl6032.

Required properties:
- compatible: "ti,twl6032"

Optional properties:
- regulators node containing regulator childs.

The child regulators  must be named after their hardware
counterparts: LDO[1-6], LDOLN, LDOUSB and VANA.

Each regulator is defined using the standard binding
for regulators as described in ./regulator.txt

Example:
twl {
	compatible = "ti,twl6032";

	[...]

	pmic {
		compatible = "ti,twl6032-regulator";

		regulators {
			ldo1: LDO1 {
				regulator-min-microvolt = <1800000>;
				regulator-max-microvolt = <2500000>;

				regulator-state-mem {
					regulator-off-in-suspend;
				};
			};

			ldo2: LDO2 {
				regulator-min-microvolt = <1000000>;
				regulator-max-microvolt = <3000000>;

				regulator-state-mem {
					regulator-off-in-suspend;
				};
			};

			ldo3: LDO3 {
				regulator-min-microvolt = <1800000>;
				regulator-max-microvolt = <1800000>;
				regulator-boot-on;

				regulator-state-mem {
					regulator-off-in-suspend;
				};
			};

			ldo4: LDO4 {
				regulator-min-microvolt = <1800000>;
				regulator-max-microvolt = <1800000>;

				regulator-state-mem {
					regulator-off-in-suspend;
				};
			};

			ldo5: LDO5 {
				regulator-min-microvolt = <1200000>;
				regulator-max-microvolt = <3000000>;

				regulator-state-mem {
					regulator-off-in-suspend;
				};
			};

			ldo6: LDO6 {
				regulator-min-microvolt = <1800000>;
				regulator-max-microvolt = <1800000>;
				regulator-always-on;

				regulator-state-mem {
					regulator-off-in-suspend;
				};
			};

			ldo7: LDO7 {
				regulator-min-microvolt = <1800000>;
				regulator-max-microvolt = <1800000>;
				regulator-boot-on;
				regulator-always-on;
			};

			ldoln: LDOLN {
				regulator-min-microvolt = <1000000>;
				regulator-max-microvolt = <3000000>;
			};

			ldousb: LDOUSB {
				regulator-min-microvolt = <1000000>;
				regulator-max-microvolt = <3000000>;
			};

			vana: VANA {
				regulator-min-microvolt = <2100000>;
				regulator-max-microvolt = <2100000>;
				regulator-always-on;
			};
		};
	};

	[...]
};
```

## Documentation/devicetree/bindings/regulator/vctrl.txt
```
Bindings for Voltage controlled regulators
==========================================

Required properties:
--------------------
- compatible		: must be "vctrl-regulator".
- ctrl-supply:		: a phandle for the regulator supplying the control
			  voltage.
- output-voltage-range	: an array of two integer values specifying the range
			  (min/max) of the output voltage. The min/max voltage
			  constraints of the regulator (if specified) must not
			  exceed this range.
- ctrl-voltage-range	: an array of two integer values specifying the range
			  (min/max) of the control voltage. The values of
			  ctrl-voltage-range and output-voltage-range are used
			  for the conversion between output and control voltage.
			  The min/max values of ctrl-voltage-range must specify
			  the control voltage needed to generate the min/max
			  output voltage.

Optional properties:
--------------------
- ovp-threshold-percent	: overvoltage protection (OVP) threshold of the
			  regulator in percent. Some regulators have an OVP
			  circuitry which shuts down the regulator when the
			  actual output voltage deviates beyond a certain
			  margin from the expected value for a given control
			  voltage. On larger voltage decreases this can occur
			  undesiredly since the output voltage does not adjust
			  inmediately to changes in the control voltage. To
			  avoid this situation the vctrl driver breaks down
			  larger voltage decreases into multiple steps, where
			  each step is within the OVP threshold.
- min-slew-down-rate	: Describes how slowly the regulator voltage will decay
			  down in the worst case (lightest expected load).
			  Specified in uV / us (like main regulator ramp rate).
			  This value is required when ovp-threshold-percent is
			  specified.

Example:

	vctrl_reg {
		compatible = "vctrl-regulator";
		regulator-name = "vctrl_reg";

		ctrl-supply = <&ctrl_supply>;

		regulator-min-microvolt = <800000>;
		regulator-max-microvolt = <1500000>;

		output-voltage-range = <800000 1500000>;
		ctrl-voltage-range = <200000 500000>;

		slew-rate = <225>;
		ovp-threshold-percent = <16>;
	};
```

## Documentation/devicetree/bindings/remoteproc/imx-rproc.txt
```
NXP iMX6SX/iMX7D Co-Processor Bindings
----------------------------------------

This binding provides support for ARM Cortex M4 Co-processor found on some
NXP iMX SoCs.

Required properties:
- compatible		Should be one of:
				"fsl,imx7d-rproc"
				"fsl,imx6sx-rproc"
- clocks		Clock for co-processor (See: ../clock/clock-bindings.txt)
- syscfg		Phandle to syscon block which provide access to
			System Reset Controller

Optional properties:
- reg:			Should contain the address ranges for some of internal
			memory regions.
- reg-names:		Contains the corresponding names for the memory
			regions. These should be named "ddr", "ocram", "ocram-s",
			"ocram-epdc" or "ocram-pxp".
Fallowing memory ranges are expected:
- For "fsl,imx7d-rproc"
	<0x00900000 0x00020000> - "ocram"
	<0x00920000 0x00020000> - "ocram-epdc"
	<0x00940000 0x00008000> - "ocram-pxp"
	<0x80000000 0x0FFF0000> - "ddr" (code area)
	<0x80000000 0x60000000> - "ddr" (data area)
- For "fsl,imx6sx-rproc"
	<0x008F8000 0x00004000> - "ocram-s"
	<0x80000000 0x0FFF8000> - "ddr" (code area)
	<0x80000000 0x60000000> - "ddr" (data area)

Note: the "ddr" code and data ranges are overlapping. Code area is smaller
than data area.  So this range should be carefully chosen according to your
system and application requirements.

Example:
	imx_rproc: imx7d-rp0@0 {
		compatible	= "fsl,imx7d-rproc";
		reg		= <0x80000000 0x80000>, <0x00900000 0x2000>;
		reg-names	= "ddr", "ocram";
		syscon		= <&src>;
		clocks		= <&clks IMX7D_ARM_M4_ROOT_CLK>;
	};
```

## Documentation/devicetree/bindings/remoteproc/mtk,scp.txt
```
Mediatek SCP Bindings
----------------------------------------

This binding provides support for ARM Cortex M4 Co-processor found on some
Mediatek SoCs.

Required properties:
- compatible		Should be "mediatek,mt8183-scp"
- clocks		Clock for co-processor (See: ../clock/clock-bindings.txt)
```
