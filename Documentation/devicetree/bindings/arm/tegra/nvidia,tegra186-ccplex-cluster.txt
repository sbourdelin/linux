## Documentation/devicetree/bindings/char/qcom,fastrpc.txt
```
Qualcomm Technologies, Inc. FastRPC Driver

The FastRPC driver implements an IPC (Inter-Processor Communication)
mechanism that allows for clients to transparently make remote method
invocations across DSP and APPS boundaries. This enables developers
to offload tasks to the DSP and free up the application processor for
other tasks.

- compatible:
	Usage: required
	Value type: <stringlist>
	Definition: must be "qcom,fastrpc"

- reg
	Usage: required
	Value type: <u32>
	Definition: DSP Processor ID.
	Possible values are :
			0 - ADSP
			1 - MDSP
			2 - SDSP
			3 - CDSP

= COMPUTE BANKS
Each subnode of the Fastrpc node represents compute context banks avaiable
on the dsp. The name of the nodes are not important. The properties of these
nodes are defined by the individual bindings for the specific service
- All Compute context banks MUST contain the following property:

- compatible:
	Usage: required
	Value type: <stringlist>
	Definition: must be "qcom,fastrpc-compute-cb"

- reg
	Usage: required
	Value type: <u32>
	Definition: Context Bank ID.

- secured:
	Usage: Optional
	Value type: <boolean>
	Defination: Indicating context bank is secured

- nsessions:
	Usage: Optional
	Value type: <u32>
	Defination: A value indicating how many sessions can share this
		    context bank. Defaults to 'One' when this property
		    is not specified.

Example:

fastrpc {
	compatible = "qcom,fastrpc";
	qcom,smd-channels = "fastrpcsmd-apps-dsp";
	reg = <0>; /* DOMAIN_ADSP */
	#address-cells = <1>;
	#size-cells = <0>;

	cb@1 {
		compatible = "qcom,fastrpc-compute-cb";
		reg = <1>;
		iommus = <&lpass_q6_smmu 1>;
	};

	cb@2 {
		compatible = "qcom,fastrpc-compute-cb";
		reg = <2>;
		iommus = <&lpass_q6_smmu 2>;
	};
	...
};
```

## Documentation/devicetree/bindings/clock/amlogic,mmc-clkc.txt
```
* Amlogic MMC Sub Clock Controller Driver

The Amlogic MMC clock controller generates and supplies clock to support
MMC and NAND controller

Required Properties:

- compatible: should be:
		"amlogic,meson-gx-mmc-clkc"
		"amlogic,meson-axg-mmc-clkc"

- #clock-cells: should be 1.
- clocks: phandles to clocks corresponding to the clock-names property
- clock-names: list of parent clock names
	- "clkin0", "clkin1"

Parent node should have the following properties :
- compatible: "syscon", "simple-mfd, and "amlogic,meson-axg-mmc-clkc"
- reg: base address and size of the MMC control register space.

Example: Clock controller node:

sd_mmc_c_clkc: clock-controller@7000 {
	compatible = "amlogic,mmc-clkc", "syscon", "simple-mfd";
	reg = <0x0 0x7000 0x0 0x4>;
	#clock-cells = <1>;

	clock-names = "clkin0", "clkin1";
	clocks = <&clkc CLKID_SD_MMC_C_CLK0>,
			<&clkc CLKID_FCLK_DIV2>;
};
```

## Documentation/devicetree/bindings/clock/artpec6.txt
```
* Clock bindings for Axis ARTPEC-6 chip

Required properties:
- #clock-cells: Should be <0>
- compatible: Should be "axis,artpec6-pll1-clock"
- reg: Address and length of the DEVSTAT register.
- clocks: The PLL's input clock.

Examples:

pll1_clk: pll1_clk {
	#clock-cells = <0>;
	compatible = "axis,artpec6-pll1-clock";
	reg = <0xf8000000 4>;
	clocks = <&ext_clk>;
};
```

## Documentation/devicetree/bindings/clock/axs10x-i2s-pll-clock.txt
```
Binding for the AXS10X I2S PLL clock

This binding uses the common clock binding[1].

[1] Documentation/devicetree/bindings/clock/clock-bindings.txt

Required properties:
- compatible: shall be "snps,axs10x-i2s-pll-clock"
- #clock-cells: from common clock binding; Should always be set to 0.
- reg : Address and length of the I2S PLL register set.

Example:
	i2s_clock@100a0 {
		compatible = "snps,axs10x-i2s-pll-clock";
		reg = <0x100a0 0x10>;
		#clock-cells = <0>;
	};
```

## Documentation/devicetree/bindings/clock/brcm,bcm53573-ilp.txt
```
Broadcom BCM53573 ILP clock
===========================

This binding uses the common clock binding:
    Documentation/devicetree/bindings/clock/clock-bindings.txt

This binding is used for ILP clock (sometimes referred as "slow clock")
on Broadcom BCM53573 devices using Cortex-A7 CPU.

ILP's rate has to be calculated on runtime and it depends on ALP clock
which has to be referenced.

This clock is part of PMU (Power Management Unit), a Broadcom's device
handing power-related aspects. Its node must be sub-node of the PMU
device.

Required properties:
- compatible: "brcm,bcm53573-ilp"
- reg: iomem address range of PMU (Power Management Unit)
- reg-names: "pmu", the only needed & supported reg right now
- clocks: has to reference an ALP clock
- #clock-cells: should be <0>

Example:

pmu@18012000 {
	compatible = "simple-mfd", "syscon";
	reg = <0x18012000 0x00001000>;

	ilp: ilp@0 {
		compatible = "brcm,bcm53573-ilp";
		clocks = <&alp>;
		#clock-cells = <0>;
		clock-output-names = "ilp";
	};
};
```

## Documentation/devicetree/bindings/clock/brcm,ns-ilp.txt
```
Broadcom Northstar ILP clock
============================

This binding uses the common clock binding:
    Documentation/devicetree/bindings/clock/clock-bindings.txt

This binding is used for ILP clock on Broadcom Northstar devices using
Corex-A7 CPU. ILP clock depends on ALP one and has to be calculated on
runtime.

Required properties:
- compatible: "brcm,ns-ilp"
- reg: iomem address range of PMU (Power Management Unit)
- reg-names: "pmu", the only needed & supported reg right now
- clocks: has to reference an ALP clock
- #clock-cells: should be <0>

Example:

ilp: ilp {
	compatible = "brcm,ns-ilp";
	reg = <0x18012000 0x1000>;
	reg-names = "pmu";
	clocks = <&alp>;
	#clock-cells = <0>;
};
```

## Documentation/devicetree/bindings/clock/clk-max77620.txt
```
* Maxim MAX77620 32KHz clocks *

Maxim Power Management IC (PMIC) has clock output pins for 32KHz.

This binding uses the common clock binding ./clock-bindings.txt.

Required Properties:
--------------------

-#clock-cells : shall be set to 0.

Example:

#include <dt-bindings/mfd/max77620.h>
...

i2c@7000d000 {
	spmic: max77620@3c {
		compatible = "maxim,max77620";
		:::::
		#clock-cells = <0>;
		:::
       };
};

bluetooth {
	compatible = "bcom,bluuetooth-device";
	clocks = <&smic>;
	clock-names = "in-32k";
	:::
};
```

## Documentation/devicetree/bindings/clock/clk-spmi-pmic-div.txt
```
Qualcomm Technologies, Inc. SPMI PMIC clock divider (clkdiv)

clkdiv configures the clock frequency of a set of outputs on the PMIC.
These clocks are typically wired through alternate functions on
gpio pins.

=======================
Properties
=======================

- compatible
	Usage:      required
	Value type: <string>
	Definition: must be one of:
		    "qcom,spmi-clkdiv"
		    "qcom,pm8998-clkdiv"

- reg
	Usage:      required
	Value type: <prop-encoded-array>
	Definition: Addresses and sizes for the memory of this CLKDIV
		    peripheral.

- clocks:
	Usage: required
	Value type: <prop-encoded-array>
	Definition: reference to the xo clock.

- clock-names:
	Usage: required
	Value type: <stringlist>
	Definition: must be "xo".

- clock-cells:
	Usage: required
	Value type: <u32>
	Definition: shall contain 1.

=======
Example
=======

pm8998_clk_divs: qcom,clock@5b00 {
	compatible = "qcom,pm8998-clkdiv";
	reg = <0x5b00>;
	#clock-cells = <1>;
	clocks = <&xo_board>;
	clock-names = "xo";

	assigned-clocks = <&pm8998_clk_divs 1>,
			  <&pm8998_clk_divs 2>,
			  <&pm8998_clk_divs 3>;
	assigned-clock-rates = <9600000>,
			       <9600000>,
			       <9600000>;
};
```

## Documentation/devicetree/bindings/clock/fixed-factor-clock.txt
```
Binding for simple fixed factor rate clock sources.

This binding uses the common clock binding[1].

[1] Documentation/devicetree/bindings/clock/clock-bindings.txt

Required properties:
- compatible : shall be "fixed-factor-clock".
- #clock-cells : from common clock binding; shall be set to 0.
- clock-div: fixed divider.
- clock-mult: fixed multiplier.
- clocks: parent clock.

Optional properties:
- clock-output-names : From common clock binding.
- clock-flags : Additional flags to be used.

Example:
	#include <dt-bindings/clk/clk.h>

	clock {
		compatible = "fixed-factor-clock";
		clocks = <&parentclk>;
		#clock-cells = <0>;
		clock-div = <2>;
		clock-mult = <1>;
		clock-flags = <CLK_SET_RATE_PARENT>;
	};
```

## Documentation/devicetree/bindings/clock/fractional-scale-clock.txt
```
Binding for fractional scale clock source.

This binding uses the common clock binding[1].

[1] Documentation/devicetree/bindings/clock/clock-bindings.txt

Required properties:
- compatible : shall be "fractional-scale-clock".
- clocks : shall be the input parent clock phandle for the clock.
- #clock-cells : shall be set to 1.
- reg : shall be the physical register address for the clock.
- clock-output-names : shall be the name of the clock referenced by derive clock.
- clock-shift: Bit shift of the clock register. Default is 0.
- clock-width: Width of the clock register. Default is 32.
- clock-denom: shall be the denominator value. Default is 2^32.

Optional properties:
- clock-inverted: shall be 1 if the numerator is inverted.
- clock-names : shall be the name of the clock. If missing, use the device name.

Example:
	clock {
		compatible = "fractional-scale-clock";
		clocks = <&parentclk>;
		#clock-cells = <1>;
		reg = <0x0 0xFFFF0000 0x0 0x10>
		clock-shift = <8>;
		clock-width = <3>;
		clock-denom = <8>;
		clock-inverted = <1>;
	};
```

## Documentation/devicetree/bindings/clock/i2s-pll-clock.txt
```
Binding for the AXS10X I2S PLL clock

This binding uses the common clock binding[1].

[1] Documentation/devicetree/bindings/clock/clock-bindings.txt

Required properties:
- compatible: shall be "snps,i2s-pll-clock"
- #clock-cells: from common clock binding; Should always be set to 0.
- reg : Address and length of the I2S PLL register set.

Example:
	clock@0x100a0 {
		compatible = "snps,i2s-pll-clock";
		reg = <0x100a0 0x10>;
		#clock-cells = <0>;
	};
```

## Documentation/devicetree/bindings/clock/imx6q,epit.txt
```
Binding for the i.MX6 EPIT timer

This binding uses the common clock binding[1].

[1] Documentation/devicetree/bindings/clock/clock-bindings.txt

Required properties:
- compatible: should be "fsl,imx6q-epit"
- reg: physical base address of the controller and length of memory mapped
  region.
- interrupts: Should contain EPIT controller interrupt
- clocks: list of clock specifiers, must contain an entry for each required
  entry in clock-names
- clock-names : as described in the clock bindings

Example:
	epit1: epit@20d0000 {
		compatible = "fsl,imx6q-epit";
		reg = <0x020d0000 0x4000>;
		interrupts = <0 56 IRQ_TYPE_LEVEL_HIGH>;
		clocks = <&clks IMX6QDL_CLK_EPIT1>,
			<&clks IMX6QDL_CLK_IPG_PER>,
			<&clks IMX6QDL_CLK_CKIL>;
		clock-names = "ipg", "per", "ckil";
	};
```

## Documentation/devicetree/bindings/clock/intel,grx500-clk.txt
```
Device Tree Clock bindings for GRX500 PLL controller.

This binding uses the common clock binding:
	Documentation/devicetree/bindings/clock/clock-bindings.txt

This GRX500 PLL controller provides the 5 main clock domain of the SoC: CPU/DDR, XBAR,
Voice, WLAN, PCIe and gate clocks for HW modules.

Required properties for osc clock node
- compatible: Should be intel,grx500-xxx-clk
- reg: offset address of the controller memory area.
- clocks: phandle of the external reference clock
- #clock-cells: can be one or zero.
- clock-output-names: Names of the output clocks.

Example:
	pll0aclk: pll0aclk {
		#clock-cells = <1>;
		compatible = "intel,grx500-pll0a-clk";
		clocks = <&pll0a>;
		reg = <0x8>;
		clock-output-names = "cbmclk", "ngiclk", "ssx4clk", "cpu0clk";
	};

	cpuclk: cpuclk {
		#clock-cells = <0>;
		compatible = "intel,grx500-cpu-clk";
		clocks = <&pll0aclk CPU0_CLK>, <&pll0bclk CPU1_CLK>;
		reg = <0x8>;
		clock-output-names = "cpu";
	};

Required properties for gate node:
- compatible: Should be intel,grx500-gatex-clk
- reg: offset address of the controller memory area.
- #clock-cells: Should be <1>
- clock-output-names: Names of the output clocks.

Example:
	clkgate0: clkgate0 {
		#clock-cells = <1>;
		compatible = "intel,grx500-gate0-clk";
		reg = <0x114>;
		clock-output-names = "gate_xbar0", "gate_xbar1", "gate_xbar2",
		"gate_xbar3", "gate_xbar6", "gate_xbar7";
	};
```
