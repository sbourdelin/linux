## Documentation/devicetree/bindings/arm/tegra/nvidia,tegra186-ccplex-cluster.txt
```
NVIDIA Tegra CCPLEX_CLUSTER area

Required properties:
- compatible: Should contain one of the following:
  - "nvidia,tegra186-ccplex-cluster": for Tegra186
- reg: Must contain an (offset, length) pair of the device's MMIO
  register area
- nvidia,bpmp: phandle to BPMP device that can be queried for OPP tables

Example:

	ccplex@e000000 {
		compatible = "nvidia,tegra186-ccplex-cluster";
		reg = <0x0 0x0e000000 0x0 0x3fffff>,

		nvidia,bpmp = <&bpmp>;
	};
```

## Documentation/devicetree/bindings/arm/tegra/nvidia,tegra186-pmc.txt
```
NVIDIA Tegra Power Management Controller (PMC)

Required properties:
- compatible: Should contain one of the following:
  - "nvidia,tegra186-pmc": for Tegra186
  - "nvidia,tegra194-pmc": for Tegra194
- reg: Must contain an (offset, length) pair of the register set for each
  entry in reg-names.
- reg-names: Must include the following entries:
  - "pmc"
  - "wake"
  - "aotag"
  - "scratch"
  - "misc" (Only for Tegra194)

Optional properties:
- nvidia,invert-interrupt: If present, inverts the PMU interrupt signal.

Example:

SoC DTSI:

	pmc@c3600000 {
		compatible = "nvidia,tegra186-pmc";
		reg = <0 0x0c360000 0 0x10000>,
		      <0 0x0c370000 0 0x10000>,
		      <0 0x0c380000 0 0x10000>,
		      <0 0x0c390000 0 0x10000>;
		reg-names = "pmc", "wake", "aotag", "scratch";
	};

Board DTS:

	pmc@c360000 {
		nvidia,invert-interrupt;
	};

== Pad Control Nodes ==

The PMC can be used to set pad power state and voltage configuration.
The pad configuration is done via the pinctrl framework. The driver
implements power-source, low-power-enable, and low-power-disable pinconf
pin configuration node properties. Each pinctrl pin corresponds to a
single Tegra PMC pad. Thus, in the following sections of this document
pin refers to the pinctrl frameworks notion of a Tegra PMC pad.

The pad configuration state nodes are placed under the pmc node and they
are referred to by the pinctrl client device properties. For more
information see the examples presented later and
Documentation/devicetree/bindings/pinctrl/pinctrl-bindings.txt.

The values accepted by power-source property are
TEGRA_IO_PAD_VOLTAGE_1V8 and TEGRA_IO_PAD_VOLTAGE_3V3, which are defined
in dt-bindings/pinctrl/pinctrl-tegra-io-pad.h.

Following pinctrl pin name strings are present on Tegra186:
csia		csib		dsi		mipi-bias
pex-clk-bias	pex-clk3	pex-clk2	pex-clk1
usb0		usb1		usb2		usb-bias
uart		audio		hsic		dbg
hdmi-dp0	hdmi-dp1	pex-cntrl	sdmmc2-hv
sdmmc4		cam		dsib		dsic
dsid		csic		csid		csie
dsif		spi		ufs		dmic-hv
edp		sdmmc1-hv	sdmmc3-hv	conn
audio-hv

All of the listed Tegra186 pins support the low-power-enable and
low-power-disable properties. The power-source property is supported
following Tegra210 pins: sdmmc2-hv, dmic-hv, sdmmc1-hv, sdmmc3-hv, and
audio-hv.

Pad configuration state example:
	pmc: pmc@7000e400 {
		compatible = "nvidia,tegra186-pmc";
		reg = <0 0x0c360000 0 0x10000>,
		      <0 0x0c370000 0 0x10000>,
		      <0 0x0c380000 0 0x10000>,
		      <0 0x0c390000 0 0x10000>;
		reg-names = "pmc", "wake", "aotag", "scratch";

		...

		sdmmc1_3v3: sdmmc1-3v3 {
			pins = "sdmmc1-hv";
			power-source = <TEGRA_IO_PAD_VOLTAGE_3V3>;
		};

		sdmmc1_1v8: sdmmc1-1v8 {
			pins = "sdmmc1-hv";
			power-source = <TEGRA_IO_PAD_VOLTAGE_1V8>;
		};

		hdmi_off: hdmi-off {
			pins = "hdmi";
			low-power-enable;
		}

		hdmi_on: hdmi-on {
			pins = "hdmi";
			low-power-disable;
		}
	};

Pinctrl client example:
	sdmmc1: sdhci@3400000 {
		...
		pinctrl-names = "sdmmc-3v3", "sdmmc-1v8";
		pinctrl-0 = <&sdmmc1_3v3>;
		pinctrl-1 = <&sdmmc1_1v8>;
	};

	...

	sor0: sor@15540000 {
		...
		pinctrl-0 = <&hdmi_off>;
		pinctrl-1 = <&hdmi_on>;
		pinctrl-names = "hdmi-on", "hdmi-off";
	};
```

## Documentation/devicetree/bindings/arm/ts.txt
```
Technologic Systems Platforms Device Tree Bindings
--------------------------------------------------

TS-4800 board
Required root node properties:
	- compatible = "ts,imx51-ts4800", "fsl,imx51";
```

## Documentation/devicetree/bindings/arm/uniphier/uniphier-system-bus.txt
```
UniPhier System Bus
-------------------

The UniPhier System Bus is an external bus where on-board devices are connected
to the UniPhier SoC.  It it a simple parallel bus with address, data, and some
control signals.  It supports up to 8 banks (chip selects).

Required properties for System Bus:
- compatible: should be "socionext,uniphier-system-bus", "simple-bus".
- #address-cells: should be equal to or grater than 2.  The first cell is the
  bank number (chip select).  The rest is the base address within the bank that
  should be mapped onto the parent bus (usually AMBA).

Optional properties for System Bus:
- #size-cells: should be the same as that of the parent bus, if exists.  The
  value of the parent bus is assumed, if not specified.


UniPhier System Bus Controller
------------------------------

The UniPhier System Bus Controller is a hardware block with registers that
controls the System Bus accessing; how each bank is mapped onto the parent bus,
various timing parameters of the bus access, etc.

Required properties for System Bus Controller:
- compatible: should be "socionext,uniphier-system-bus-controller".
- reg: offsets and lengths of the register sets for the device.  It should
  contain 2 regions: base & control register, misc register, in this order.


Example
-------
	system_bus: system-bus {
		compatible = "socionext,uniphier-system-bus", "simple-bus";
		#address-cells = <2>;
		#size-cells = <1>;
		ranges = <1 0x00000000 0x42000000 0x02000000
			  5 0x00000000 0x48000000 0x01000000>;

		eth: ethernet@1,01f00000 {
			compatible = "smsc,lan9115";
			reg = <1 0x01f00000 0x1000>;
			phy-mode = "mii";
			reg-io-width = <4>;
		};

		serial: uart@5,00200000 {
			compatible = "ns16550a";
			reg = <5 0x00200000 0x20>;
			clock-frequency = <12288000>;
			reg-shift = <1>;
		};
	};

	system-bus-controller@58c00000 {
		compatible = "socionext,uniphier-system-bus-controller";
		reg = <0x58c00000 0x400>, <0x59800000 0x2000>;
		system-bus = <&system_bus>;
	};

In this example, the range 0x00000000-0x02000000 of bank 1 (CS1) is mapped to
the range 0x42000000-0x44000000 of the parent bus.
Likewise, the range 0x00000000-0x01000000 of bank 5 (CS5) is mapped to the
range 0x48000000-0x49000000 of the parent bus.

The Ethernet device is connected at the address 0x01f00000 of CS1, and visible
at the address 0x43f00000 in the parent bus.  The UART device is connected at
the address 0x00200000 of CS5, and visible at the address 0x48200000 in the
parent bus.
```

## Documentation/devicetree/bindings/ascii-lcd.txt
```
Binding for simple memory-mapped ASCII LCD displays

Required properties:
- compatible : should be one of:
    "img,boston-lcd"
    "mti,malta-lcd"
- reg : memory region locating the device registers

The layout of the registers & properties of the display are determined
from the compatible string, making this binding somewhat trivial.
```

## Documentation/devicetree/bindings/ata/ahci-da850.txt
```
Device tree binding for the TI DA850 AHCI SATA Controller
---------------------------------------------------------

Required properties:
  - compatible: must be "ti,da850-ahci"
  - reg: physical base addresses and sizes of the controller's register areas
  - interrupts: interrupt specifier (refer to the interrupt binding)

Example:

	sata: ahci@218000 {
		compatible = "ti,da850-ahci";
		reg = <0x218000 0x2000>, <0x22c018 0x4>;
		interrupts = <67>;
	};
```

## Documentation/devicetree/bindings/ata/ahci-dm816.txt
```
Device tree binding for the TI DM816 AHCI SATA Controller
---------------------------------------------------------

Required properties:
  - compatible: must be "ti,dm816-ahci"
  - reg: physical base address and size of the register region used by
         the controller (as defined by the AHCI 1.1 standard)
  - interrupts: interrupt specifier (refer to the interrupt binding)
  - clocks: clock specifiers (refer to the clock binding); two clocks
            must be specified: the functional clock and an external
            reference clock

Example:

	sata: sata@4a140000 {
		compatible = "ti,dm816-ahci";
		reg = <0x4a140000 0xffff>;
		interrupts = <16>;
		clocks = <&sysclk5_ck>, <&sata_refclk>;
	};
```

## Documentation/devicetree/bindings/ata/ahci-mtk.txt
```
MediaTek Seria ATA controller

Required properties:
 - compatible	   : Must be "mediatek,ahci".
 - reg		   : Physical base addresses and length of register sets.
 - interrupts	   : Interrupt associated with the SATA device.
 - interrupt-names : Associated name must be: "hostc".
 - clocks	   : The phandle for the clock.
 - clock-names	   : Associated name must be: "ahb", "axi", "asic", "rbc", "pm"
 - phys		   : The phandle for the PHY port.
 - phy-names	   : Associated name must be: "sata-phy".
 - ports-implemented : Mask that indicates which ports that the HBA supports
		       are available for software to use. Useful if PORTS_IMPL
		       is not programmed by the BIOS, which is true with some
		       embedded SOC's.
Optional properties:
 - power-domains   : A phandle and power domain specifier pair to the power
		     domain which is responsible for collapsing and restoring
		     power to the peripheral.
 - resets	   : Must contain an entry for each entry in reset-names.
		     See ../reset/reset.txt for details.
 - reset-names	   : Associated names must be: "axi-rst", "sw-rst", "reg-rst".
 - mediatek,phy-mode : A phandle to the system controller, used to enable
		       SATA function.

Example:

	sata: sata@1a200000 {
		compatible = "mediatek,ahci";
		reg = <0 0x1a200000 0 0x1100>;
		interrupts = <GIC_SPI 233 IRQ_TYPE_LEVEL_HIGH>;
		interrupt-names = "hostc";
		clocks = <&pciesys CLK_SATA_AHB_EN>,
			 <&pciesys CLK_SATA_AXI_EN>,
			 <&pciesys CLK_SATA_ASIC_EN>,
			 <&pciesys CLK_SATA_RBC_EN>,
			 <&pciesys CLK_SATA_PM_EN>;
		clock-names = "ahb", "axi", "asic", "rbc", "pm";
		phys = <&u3port1 PHY_TYPE_SATA>;
		phy-names = "sata-phy";
		ports-implemented = <0x1>;
		power-domains = <&scpsys MT7622_POWER_DOMAIN_HIF0>;
		resets = <&pciesys MT7622_SATA_AXI_BUS_RST>,
			 <&pciesys MT7622_SATA_PHY_SW_RST>,
			 <&pciesys MT7622_SATA_PHY_REG_RST>;
		reset-names = "axi-rst", "sw-rst", "reg-rst";
		mediatek,phy-mode = <&pciesys>;
	};
```

## Documentation/devicetree/bindings/ata/sata-seattle.txt
```
* AHCI SATA Controller

SATA nodes are defined to describe on-chip Serial ATA controllers.
The AMD Seattle SATA controller mostly conforms to the AHCI interface
with some special SGPIO register to contro activity LED interfaces.

In the case of an AHCI controller, the SGPIO feature is ideally implemented
using the "Enclosure Management" register of the AHCI controller, but
those registeres are not implemented in the Seattle SoC.

Each SATA controller should have its own node.


Required properties:
- compatible        : compatible string should be "amd,seattle-ahci".
- interrupts        : <interrupt mapping for SATA IRQ>
- reg               : <registers mapping>

Optional properties:
- dma-coherent      : Present if dma operations are coherent
- clocks            : a list of phandle + clock specifier pairs
- target-supply     : regulator for SATA target power
- phys              : reference to the SATA PHY node
- phy-names         : must be "sata-phy"

Examples:
        sata0@e0300000 {
		compatible = "amd,seattle-ahci";
		reg = <0x0 0xe0300000 0x0 0xf0000>, <0x0 0xe0000078 0x0 0x1>;
		interrupts = <0x0 0x163 0x4>;
		clocks = <0x2>
		dma-coherent;
        };
```

## Documentation/devicetree/bindings/btmrvl.txt
```
btmrvl
------

Required properties:

  - compatible : must be "marvell,btmrvl"

Optional properties:

  - btmrvl,cal-data : Calibration data downloaded to the device during
		      initialization. This is an array of 28 values(u8).

  - btmrvl,gpio-gap : gpio and gap (in msecs) combination to be
		      configured.
  - interrupt-parent: phandle of the parent interrupt controller
  - interrupts : interrupt number to the cpu
  - gpios: specify GPIO respectively. gpio here is board specific pin.
	   while above gpio-gap represents the device side pin used to
	   wakeup host.
  - pinctrl-names : a pinctrl state named "default" must be defined
  - pinctrl-0 : pin control group to be used for this controller

Example:

GPIO pin 119 and gap 100ms are configured for host wakeup,
pin 13 is configured so that firmware can wakeup host using this device side
pin, calibration data is also available in below example.

btmrvl {
	compatible = "marvell,btmrvl";

	btmrvl,cal-data = /bits/ 8 <
		0x37 0x01 0x1c 0x00 0xff 0xff 0xff 0xff 0x01 0x7f 0x04 0x02
		0x00 0x00 0xba 0xce 0xc0 0xc6 0x2d 0x00 0x00 0x00 0x00 0x00
		0x00 0x00 0xf0 0x00>;
	btmrvl,gpio-gap = <0x0d64>;
	interrupt-parent = <&pio>;
	interrupts = <119 IRQ_TYPE_LEVEL_LOW>;
	gpios = <&pio 119 GPIO_ACTIVE_HIGH>;
	pinctrl-names = "default";
	pinctrl-0 = <&wake_pins>;
};
```

## Documentation/devicetree/bindings/bus/arcx,anybuss-host.txt
```
* Arcx Anybus-S host

This host communicates with the SoC over a parallel bus. It is
expected that its Device Tree node is specified as the child of a node
corresponding to the parallel bus used for communication.

Required properties:

  - compatible : The following string:
        "arcx,anybuss-host"

  - reg : bus memory area where the Anybus-S host dpram is located.

  - interrupts : interrupt connected to the Anybus-S host interrupt line.
	Generic interrupt client node bindings are described in
		interrupt-controller/interrupts.txt

  - resets : the reset line associated with the Anybus-S host.

Example of usage:

This example places the Anybus-S host on top of the i.MX WEIM parallel bus, see:
Documentation/devicetree/bindings/bus/imx-weim.txt

&weim {
	anybus-host@0 {
		compatible = "arcx,anybuss-host";
		reg = <0 0x400000 0x800>;
		interrupt-parent = <&gpio1>;
		interrupts = <1 IRQ_TYPE_LEVEL_LOW>;
		resets = <&anybus_bridge 0>;
		/* fsl,weim-cs-timing is a i.MX WEIM bus specific property */
		fsl,weim-cs-timing = <0x024400b1 0x00001010 0x20081100
				0x00000000 0xa0000240 0x00000000>;
	};
};
```

## Documentation/devicetree/bindings/bus/ts-nbus.txt
```
Technologic Systems NBUS

The NBUS is a bus used to interface with peripherals in the Technologic
Systems FPGA on the TS-4600 SoM.

Required properties :
 - compatible     : "technologic,ts-nbus"
 - #address-cells : must be 1
 - #size-cells    : must be 0
 - pws            : The PWM binded to the FPGA
 - data-gpios	  : The GPIO pin connected to the data line on the FPGA
 - csn-gpios	  : The GPIO pin connected to the csn line on the FPGA
 - txrx-gpios	  : The GPIO pin connected to the txrx line on the FPGA
 - strobe-gpios	  : The GPIO pin connected to the stobe line on the FPGA
 - ale-gpios	  : The GPIO pin connected to the ale line on the FPGA
 - rdy-gpios	  : The GPIO pin connected to the rdy line on the FPGA

Child nodes:

The NBUS node can contain zero or more child nodes representing peripherals
on the bus.

Example:

	nbus {
		compatible = "technologic,ts-nbus";
		pinctrl-0 = <&nbus_pins>;
		#address-cells = <1>;
		#size-cells = <0>;
		pwms = <&pwm 2 83>;
		ts-data-gpios   = <&gpio0 0 GPIO_ACTIVE_HIGH
				   &gpio0 1 GPIO_ACTIVE_HIGH
				   &gpio0 2 GPIO_ACTIVE_HIGH
				   &gpio0 3 GPIO_ACTIVE_HIGH
				   &gpio0 4 GPIO_ACTIVE_HIGH
				   &gpio0 5 GPIO_ACTIVE_HIGH
				   &gpio0 6 GPIO_ACTIVE_HIGH
				   &gpio0 7 GPIO_ACTIVE_HIGH>;
		ts-csn-gpios    = <&gpio0 16 GPIO_ACTIVE_HIGH>;
		ts-txrx-gpios   = <&gpio0 24 GPIO_ACTIVE_HIGH>;
		ts-strobe-gpios = <&gpio0 25 GPIO_ACTIVE_HIGH>;
		ts-ale-gpios    = <&gpio0 26 GPIO_ACTIVE_HIGH>;
		ts-rdy-gpios    = <&gpio0 21 GPIO_ACTIVE_HIGH>;

		watchdog@2a {
			compatible = "...";

			/* ... */
		};
	};
```
