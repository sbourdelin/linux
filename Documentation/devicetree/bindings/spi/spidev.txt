## Documentation/devicetree/bindings/spi/spidev.txt
```
* SPIDEV

spidev is a device driver to access to SPI devices using normal userspace I/O calls.
To make an SPI device compatible with this drivers add:

Required properties:
- compatible : should be "spidev".

Example:

spidev0: spi@0 {
	compatible = "spidev";
	reg = <0>;
	spi-max-frequency = <1000000>;
	status = "okay";
};
```

## Documentation/devicetree/bindings/sram/ti-sram.txt
```
TI SRAM Node:
-------------

Many TI SoC's rely on SRAM for running low-level PM code as part of the
suspend or cpuidle path. Because of this, regions in sram must be mapped
as "memory-exec" or "memory-exec-nocache" in order for the region to be
executable.

Optional sub-node
-----------------
Some TI SoCs have secure variants that require a certain portion of
the SRAM to be reserved for use by secure software. This can be
marked in the parent SRAM node with a subnode as described in
Documentation/devicetree/bindings/sram/sram.txt. This node can be
added in two ways:

- From board dts files for secure platforms to avoid adding it
  for all SoC variants with a fixed size defined.
- As a dummy node in the .dtsi sram node with any size that will be
  modified by a bootloader to the correct size needed.

Sub-node properties:
- compatible : should be "ti,secure-sram"

The rest of the properties should follow the generic mmio-sram discription
found in Documentation/devicetree/bindings/sram/sram.txt

Example:
	/* In parent SoC .dtsi */
	ocmcram: ocmcram@40200000 {
		compatible = "mmio-sram";
		reg = <0x40200000 0x10000>; /* 64k */
		memory-exec-nocache;
		ranges = <0x0 0x40200000 0x10000>;

		#address-cells = <1>;
		#size-cells = <1>;

	};

	/* In board .dts where secure silicon is present */
	&ocmcram {
		sram-hs@0 {
			compatible = "ti,secure-ram";
			reg = <0x0 0xC000>;
		};
	};
```

## Documentation/devicetree/bindings/staging/ion/st,sti-ion.txt
```
STIH4xxSoC ION

Required properties:
- compatible: "st,sti-ion", "linux,ion"
- list of ION heaps:
	- compatible: "st,cma-heap", "linux,ion-heap-dma"

heap bindings are defined in drivers/staging/android/ion/devicetree.txt

Example:
	ion {
		compatible = "st,sti-ion", "linux,ion";

		ion-cma-heap {
			compatible = "st,cma-heap", "linux,ion-heap-dma";
		};
	};
```

## Documentation/devicetree/bindings/thermal/bcm2835-thermal.txt
```
Binding for Thermal Sensor driver for BCM2835 SoCs.

Required parameters:
-------------------

compatible : 	should be: "brcm,bcm2835-thermal"
reg :		Address range of the thermal registers.
clocks : 	Phandle of the clock used by the thermal sensor.

Example:

thermal: thermal@0x7e212000 {
	compatible = "brcm,bcm2835-thermal";
	reg = <0x7e212000 0x8>;
	clocks = <&clocks BCM2835_CLOCK_TSENS>;
};
```

## Documentation/devicetree/bindings/thermal/da9062-thermal.txt
```
* Dialog DA9062/61 TJUNC Thermal Module

This module is part of the DA9061/DA9062. For more details about entire
DA9062 and DA9061 chips see Documentation/devicetree/bindings/mfd/da9062.txt

Junction temperature thermal module uses an interrupt signal to identify
high THERMAL_TRIP_HOT temperatures for the PMIC device.

Required properties:

- compatible: should be one of:
        dlg,da9061-thermal
        dlg,da9062-thermal

Optional properties:

- dlg,tjunc-temp-polling-period-ms : Specify the polling period, measured
    in milliseconds, between thermal zone device update checks.

Example:

	pmic0: da9062@58 {

		thermal {
			compatible = "dlg,da9062-thermal";
			dlg,tjunc-temp-polling-period-ms = <3000>;
		};

	};
```

## Documentation/devicetree/bindings/thermal/imx-sc-thermal.txt
```
* Temperature Monitor (TEMPMON) on NXP i.MX SoCs with System Controller

Required properties:
- compatible : Must be "nxp,imx8qxp-sc-thermal";
- tsens-num : Total number of thermal sensors supported;
- #thermal-sensor-cells : Should be 1. See ./thermal.txt for a description.

Example:
tsens: thermal-sensor {
	compatible = "nxp,imx8qxp-sc-thermal";
	tsens-num = <1>;
	#thermal-sensor-cells = <1>;
};

thermal_zones: thermal-zones {
	cpu-thermal0 {
		polling-delay-passive = <250>;
		polling-delay = <2000>;
		thermal-sensors = <&tsens 355>;
		trips {
			cpu_alert0: trip0 {
				temperature = <107000>;
				hysteresis = <2000>;
				type = "passive";
			};
			cpu_crit0: trip1 {
				temperature = <127000>;
				hysteresis = <2000>;
				type = "critical";
			};
		};
	};
};
```

## Documentation/devicetree/bindings/thermal/tango-thermal.txt
```
* Tango Thermal

The SMP8758 SoC includes 3 instances of this temperature sensor
(in the CPU, video decoder, and PCIe controller).

Required properties:
- compatible: "sigma,smp8758-thermal"
- #thermal-sensor-cells: Should be 0 (see thermal.txt)
- reg: Address range of the thermal registers

Example:

	cpu_temp: thermal@920100 {
		compatible = "sigma,smp8758-thermal";
		#thermal-sensor-cells = <0>;
		reg = <0x920100 12>;
	};
```

## Documentation/devicetree/bindings/thermal/tegra-soctherm.txt
```
Tegra124 SOCTHERM thermal management system

The SOCTHERM IP block contains thermal sensors, support for polled
or interrupt-based thermal monitoring, CPU and GPU throttling based
on temperature trip points, and handling external overcurrent
notifications. It is also used to manage emergency shutdown in an
overheating situation.

Required properties :
- compatible : For Tegra124, must contain "nvidia,tegra124-soctherm".
  For Tegra132, must contain "nvidia,tegra132-soctherm".
  For Tegra210, must contain "nvidia,tegra210-soctherm".
- reg : Should contain 1 entry:
  - SOCTHERM register set
- interrupts : Defines the interrupt used by SOCTHERM
- clocks : Must contain an entry for each entry in clock-names.
  See ../clocks/clock-bindings.txt for details.
- clock-names : Must include the following entries:
  - tsensor
  - soctherm
- resets : Must contain an entry for each entry in reset-names.
  See ../reset/reset.txt for details.
- reset-names : Must include the following entries:
  - soctherm
- #thermal-sensor-cells : Should be 1. See ./thermal.txt for a description
    of this property. See <dt-bindings/thermal/tegra124-soctherm.h> for a
    list of valid values when referring to thermal sensors.

Optional properties:
- hw-trips : A sub-node which is a container of hardware trip points
    for each sensors.
  * sensors: Sub-nodes which are used to describe the HW trip points info,
        must be named as "cpu", "gpu", "mem", "pll".
      Properties:
      - therm-temp : Shutdown temperature in millicelsius, once the
        temperature of this sensor is higher than the therm-temp, the system
        will be reset or shutdown.
      - throt-temp : HW throttle temperature in millicelsius, once the
        temperature of this sensor is higher than the throt-temp, the HW
        throttle will be triggered in soctherm. (Not implement yet)

Example :

	soctherm@0,700e2000 {
		compatible = "nvidia,tegra124-soctherm";
		reg = <0x0 0x700e2000 0x0 0x1000>;
		interrupts = <GIC_SPI 48 IRQ_TYPE_LEVEL_HIGH>;
		clocks = <&tegra_car TEGRA124_CLK_TSENSOR>,
			<&tegra_car TEGRA124_CLK_SOC_THERM>;
		clock-names = "tsensor", "soctherm";
		resets = <&tegra_car 78>;
		reset-names = "soctherm";

		#thermal-sensor-cells = <1>;

		hw-trips {
			cpu {
				therm-temp = <103000>;
				throt-temp = <98500>;
			};
			gpu {
				therm-temp = <103500>;
				throt-temp = <100000>;
			};
			mem {
				therm-temp = <103500>;
			};
			pll {
				therm-temp = <105000>;
			};
		};
	};

Example: referring to thermal sensors :

       thermal-zones {
                cpu {
                        polling-delay-passive = <1000>;
                        polling-delay = <1000>;

                        thermal-sensors =
                                <&soctherm TEGRA124_SOCTHERM_SENSOR_CPU>;
                };
	};
```

## Documentation/devicetree/bindings/thermal/thermal-generic-adc.txt
```
General Purpose Analog To Digital Converter (ADC) based thermal sensor

On some of platforms, thermal sensor like thermistors are connected to
one of ADC channel and sensor resistance is read via voltage across the
sensor. The voltage read across the sensor is mapped to temperature using
voltage-temperature lookup table.

This driver provides the interface to sensor-ADC interconnection and
the relation ship between ADC read value and temperature.

Required properties:
===================
- compatible:		     Must be "generic-adc-thermal".
- lower-temperature:	     Lower temperature for the lookup table
			     in millicelsius.
- upper-temperature:	     Upper temperature for the lookup table
			     in millicelsius.
- step-temperature:	     The temperature steps for the reading ADC
			     value in millicelsius.
- temperature-lookup-table:  The ADC reading value on each step of the
			     temperature starting from lower temperature
			     to upper temperature.
			     When ADC is read, the value is looked up on the
			     table to get the equivalent temperature.
- #thermal-sensor-cells:     Should be 1. See ./thermal.txt for a description
			     of this property. 

Example :
#include <dt-bindings/thermal/thermal.h>

i2c@7000c400 {
	ads1015: ads1015@4a {
		reg = <0x4a>;
		compatible = "ads1015";
		sampling-frequency = <3300>;
		#io-channel-cells = <1>; 
	};
};

thermal-sensor@1 {
	compatible = "generic-adc-thermal";
	#thermal-sensor-cells = <0>;
	io-channels = <&ads1015 1>; 
	io-channel-names = "sensor-channel";
	lower-temperature = <(-40000)>;
	upper-temperature = <125000>;
	step-temperature = <1000>;
	temperature-lookup-table = <2578 2577 2576 2575 2574
				2573 2572 2571 2569 2568
				2567 2565 2563 2561 2559
				::::::::::
				254 247 240 233 226 220 
				214 208>;
};

dummy_cool_dev: dummy-cool-dev {
	compatible = "dummy-cooling-dev";
	#cooling-cells = <2>; /* min followed by max */
};

thermal-zones {
	Tboard {
		polling-delay = <15000>; /* milliseconds */
		polling-delay-passive = <0>; /* milliseconds */
		thermal-sensors = <&tboard_thermistor>;

		trips {
			therm_est_trip: therm_est_trip {
			temperature = <40000>;
			type = "active";
			hysteresis = <1000>;
			writable;
		};
	};

	cooling-maps {
		map0 {
			trip = <&therm_est_trip>;
			cooling-device = <&dummy_cool_dev THERMAL_NO_LIMIT THERMAL_NO_LIMIT>;
			contribution = <100>;
			cdev-type = "therm_est_activ";
			};
		};

	};
};
```

## Documentation/devicetree/bindings/timer/actions,owl-timer.txt
```
Actions Semi Owl Timer

Required properties:
- compatible      :  "actions,s500-timer" for S500
                     "actions,s900-timer" for S900
- reg             :  Offset and length of the register set for the device.
- interrupts      :  Should contain the interrupts.
- interrupt-names :  Valid names are: "2Hz0", "2Hz1",
                                      "Timer0", "Timer1", "Timer2", "Timer3"
                     See ../resource-names.txt

Example:

		timer@b0168000 {
			compatible = "actions,s500-timer";
			reg = <0xb0168000 0x100>;
			interrupts = <GIC_SPI 10 IRQ_TYPE_LEVEL_HIGH>,
			             <GIC_SPI 11 IRQ_TYPE_LEVEL_HIGH>;
			interrupt-names = "Timer0", "Timer1";
		};
```

## Documentation/devicetree/bindings/timer/fsl,imxepit.txt
```
Binding for the i.MX Enhanced Periodic Interrupt Timer (EPIT)

The Enhanced Periodic Interrupt Timer (EPIT) is a 32-bit set-and-forget timer
that is capable of providing precise interrupts at regular intervals with
minimal processor intervention.

Required properties:
- compatible: should be "fsl,<chip>-epit", "fsl,imx31-epit" where <chip> is
  imx25, imx6qdl, imx6sl, imx6sul or imx6sx.
- reg: physical base address of the controller and length of memory mapped
  region.
- interrupts: Should contain EPIT controller interrupt
- clocks : The clock provided by the SoC to drive the timer.

Example for i.MX6QDL:
	epit1: epit@20d0000 {
		compatible = "fsl,imx6qdl-epit", "fsl,imx31-epit";
		reg = <0x020d0000 0x4000>;
		interrupts = <0 56 IRQ_TYPE_LEVEL_HIGH>;
		clocks = <&clks IMX6QDL_CLK_EPIT1>;
	};
```

## Documentation/devicetree/bindings/timer/fsl,imxgpt.txt
```
Freescale i.MX General Purpose Timer (GPT)

Required properties:

- compatible : should be one of following:

  should be "fsl,imx1-gpt" for i.MX1;

  should be one of following for i.MX21/i.MX27:
  - "fsl,imx21-gpt",
  - "fsl,imx27-gpt",

  should be one of following for i.MX31/i.MX25/i.MX50/i.MX51/i.MX53/i.MX6Q:
  - "fsl,imx31-gpt",
  - "fsl,imx25-gpt",
  - "fsl,imx50-gpt",
  - "fsl,imx51-gpt",
  - "fsl,imx53-gpt",
  - "fsl,imx6q-gpt",

  should be one of following for i.MX6DL/i.MX6SL/i.MX6SX:
  - "fsl,imx6dl-gpt",
  - "fsl,imx6sl-gpt",
  - "fsl,imx6sx-gpt".

- reg : specifies base physical address and size of the registers.
- interrupts : should be the gpt interrupt.
- clocks : the clocks provided by the SoC to drive the timer, must contain
           an entry for each entry in clock-names.
- clock-names : must include "ipg" entry first, then "per" entry.

Example:

gpt1: timer@10003000 {
	compatible = "fsl,imx27-gpt", "fsl,imx21-gpt";
	reg = <0x10003000 0x1000>;
	interrupts = <26>;
	clocks = <&clks IMX27_CLK_GPT1_IPG_GATE>,
		 <&clks IMX27_CLK_PER1_GATE>;
	clock-names = "ipg", "per";
};
```

## Documentation/devicetree/bindings/timer/ingenic,tcu.txt
```
Ingenic JZ47xx SoCs Timer/Counter Unit driver
---------------------------------------------

Required properties:

- compatible : should be "ingenic,<socname>-tcu". Valid strings are:
  * ingenic,jz4740-tcu
  * ingenic,jz4770-tcu
  * ingenic,jz4780-tcu
- interrupt-parent : phandle of the TCU interrupt controller.
- interrupts : Specifies the interrupts the controller is connected to.
- clocks : List of phandle & clock specifiers for the TCU clocks.
- clock-names : List of name strings for the TCU clocks.
- ingenic,channels: a list of TCU channels to be used as timers.

Example:

/ {
	regmap {
		compatible = "simple-mfd", "syscon";
		reg = <0x10002000 0x1000>;

		tcu: timer {
			compatible = "ingenic,jz4740-tcu";

			clocks = <&tcu 0>, <&tcu 1>;
			clock-names = "timer0", "timer1";

			interrupt-parent = <&tcu>;
			interrupts = <0>, <1>;

			ingenic,channels = <0>, <1>;
		};
	};
};
```

## Documentation/devicetree/bindings/timer/jcore,pit.txt
```
J-Core Programmable Interval Timer and Clocksource

Required properties:

- compatible: Must be "jcore,pit".

- reg: Memory region for timer/clocksource registers.

- interrupts: An interrupt to assign for the timer. The actual pit
  core is integrated with the aic and allows the timer interrupt
  assignment to be programmed by software, but this property is
  required in order to reserve an interrupt number that doesn't
  conflict with other devices.

Optional properties:

- cpu-offset: For SMP, the per-cpu offset to the local timer
  programming memory range.


Example:

timer@200 {
	compatible = "jcore,pit";
	reg = < 0x200 0x30 >;
	cpu-offset = < 0x300 >;
	interrupts = < 0x48 >;
};
```

## Documentation/devicetree/bindings/timer/mediatek,mtk-systimer.txt
```
Mediatek System Timers
----------------------

Required properties:
- compatible: Should contain
	"mediatek,sys_timer" for those platforms which support system timer.
- reg: Should contain the location and length for system timer registers.
- clocks: System timer is drived by system clock.

Examples:

	sys_timer@10017000 {
		compatible = "mediatek,sys_timer";
		reg = <0 0x10017000 0 0x1000>;
		interrupts = <GIC_SPI 194 IRQ_TYPE_LEVEL_HIGH>;
		clocks = <&sys_clk>;
	};
```
