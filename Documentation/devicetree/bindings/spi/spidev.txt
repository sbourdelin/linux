## Documentation/devicetree/bindings/timer/mediatek,mtk-timer.txt
```
Mediatek Timers
---------------

Mediatek SoCs have two different timers on different platforms,
- GPT (General Purpose Timer)
- SYST (System Timer)

Please bind correct timers in each platforms.


** General Purpose Timer (GPT)

Required properties:
- compatible should contain:
	* "mediatek,mt2701-timer" for MT2701 compatible timers
	* "mediatek,mt6580-timer" for MT6580 compatible timers
	* "mediatek,mt6589-timer" for MT6589 compatible timers
	* "mediatek,mt7623-timer" for MT7623 compatible timers
	* "mediatek,mt8127-timer" for MT8127 compatible timers
	* "mediatek,mt8135-timer" for MT8135 compatible timers
	* "mediatek,mt8173-timer" for MT8173 compatible timers
	* "mediatek,mt6577-timer" for MT6577 and all above compatible timers
- reg: Should contain location and length for GPT register.
- clocks: GPT is drived by system clock.

Examples:

	timer@10008000 {
		compatible = "mediatek,mt6577-timer";
		reg = <0x10008000 0x80>;
		interrupts = <GIC_SPI 113 IRQ_TYPE_LEVEL_LOW>;
		clocks = <&system_clk>;
	};


** System Timer (SYST)

Required properties:
- compatible: Should contain
	* "mediatek,mt6765-systimer" for MT6765 compatible timers
- reg: Should contain the location and length for system timer registers.
- clocks: System timer is drived by system clock.

Examples:

	systimer@10017000 {
		compatible = "mediatek,mt6765-systimer";
		reg = <0 0x10017000 0 0x1000>;
		interrupts = <GIC_SPI 194 IRQ_TYPE_LEVEL_HIGH>;
		clocks = <&system_clk>;
	};
```

## Documentation/devicetree/bindings/timer/nuvoton,npcm7xx-timer.txt
```
Nuvoton NPCM7xx timer

Nuvoton NPCM7xx have three timer modules, each timer module provides five 24-bit
timer counters.

Required properties:
- compatible      : "nuvoton,npcm750-timer" for Poleg NPCM750.
- reg             : Offset and length of the register set for the device.
- interrupts      : Contain the timer interrupt with flags for
                    falling edge.

Required clocking property, have to be one of:
- clocks          : phandle of timer reference clock.
- clock-frequency : The frequency in Hz of the clock that drives the NPCM7xx
                    timer (usually 25000000).

Example:

timer@f0008000 {
    compatible = "nuvoton,npcm750-timer";
    interrupts = <GIC_SPI 32 IRQ_TYPE_LEVEL_HIGH>;
    reg = <0xf0008000 0x1000>;
    clocks = <&clk NPCM7XX_CLK_TIMER>;
};
```

## Documentation/devicetree/bindings/timer/nxp,sysctr_timer.txt
```
NXP System Counter Module(sys_ctr)

The system counter(sys_ctr) is a programmable system counter which provides
a shared time base to Cortex A15, A7, A53, A73, etc. it is intended for use in
applications where the counter is always powered and support multiple,
unrelated clocks.

Required properties:

- compatible :      should be "nxp,sysctr-timer"
- reg :             Specifies the base physical address and size of the comapre
                    frame and the counter control, read & compare.
- interrupts :      should be the compare frames' interrupt
- clock-frequency : Specifies the counter clock frequency.

Example:

	system_counter: timer@306a0000 {
		compatible = "nxp,sysctr-timer";
		reg = <0x0 0x306a0000 0x0 0x10000>, /* system-counter-rd base */
		      <0x0 0x306b0000 0x0 0x10000>, /* system-counter-cmp base */
		      <0x0 0x306c0000 0x0 0x10000>; /* system-counter-ctrl base */
		clock-frequency = <8000000>;
		interrupts = <GIC_SPI 47 IRQ_TYPE_LEVEL_HIGH>,
			     <GIC_SPI 48 IRQ_TYPE_LEVEL_HIGH>;
	};
```

## Documentation/devicetree/bindings/timer/rockchip,rk-timer.txt
```
Rockchip rk timer

Required properties:
- compatible: shall be one of:
  "rockchip,rk3288-timer" - for rk3066, rk3036, rk3188, rk322x, rk3288, rk3368
  "rockchip,rk3399-timer" - for rk3399
- reg: base address of the timer register starting with TIMERS CONTROL register
- interrupts: should contain the interrupts for Timer0
- clocks : must contain an entry for each entry in clock-names
- clock-names : must include the following entries:
  "timer", "pclk"

Note:
If device tree contain only one timer, than the timer will be intialized
as clockevent provider. If device tree contain two timers, than first timer
will be initialized as clockevent provider and second one as clocksource.

If you want to bind specific timer as clockevent (i.e. one from alive subsystem)
and specific timer as clocksource, you can number the timers in "aliases" node.

If device tree contain only one timer and the timer is named as timer1 in
"aliases" node, then the timer will be initialized as clocksource.

Example (clockevent only):
	timer: timer@ff810000 {
		compatible = "rockchip,rk3288-timer";
		reg = <0xff810000 0x20>;
		interrupts = <GIC_SPI 72 IRQ_TYPE_LEVEL_HIGH>;
		clocks = <&xin24m>, <&cru PCLK_TIMER>;
		clock-names = "timer", "pclk";
	};

Example (clockevent and clocksource with explicit numbering):
	aliases {
		timer0 = &timer6;
		timer1 = &timer5;
	};

	timer5: timer@20038080 {
		compatible = "rockchip,rk3188-timer", "rockchip,rk3288-timer";
		reg = <0x20038080 0x20>;
		interrupts = <GIC_SPI 60 IRQ_TYPE_LEVEL_HIGH>;
		clocks = <&cru SCLK_TIMER5>, <&cru PCLK_TIMER0>;
		clock-names = "timer", "pclk";
	};

	timer6: timer@200380A0 {
		compatible = ""rockchip,rk3188-timer", rockchip,rk3288-timer";
		reg = <0x200380A0 0x20>;
		interrupts = <GIC_SPI 64 IRQ_TYPE_LEVEL_HIGH>;
		clocks = <&cru SCLK_TIMER6>, <&cru PCLK_TIMER0>;
		clock-names = "timer", "pclk";
	};
```

## Documentation/devicetree/bindings/timer/spreadtrum,sprd-timer.txt
```
Spreadtrum timers

The Spreadtrum SC9860 platform provides 3 general-purpose timers.
These timers can support 32bit or 64bit counter, as well as supporting
period mode or one-shot mode, and they are can be wakeup source
during deep sleep.

Required properties:
- compatible: should be "sprd,sc9860-timer" for SC9860 platform.
- reg: The register address of the timer device.
- interrupts: Should contain the interrupt for the timer device.
- clock-frequency: The frequency of the clock that drives the counter, in Hz.

Example:
	timer@40050000 {
		compatible = "sprd,sc9860-timer";
		reg = <0 0x40050000 0 0x20>;
		interrupts = <GIC_SPI 26 IRQ_TYPE_LEVEL_HIGH>;
		clock-frequency = <32768>;
	};
```

## Documentation/devicetree/bindings/timer/timer.txt
```
Specifying timer information for devices
========================================

The timer can be declared via the macro:

CLOCKSOURCE_OF_DECLARE(name, init) if it is a clocksource
CLOCKEVENT_OF_DECLARE(name, init) if it is a clockevent

The CLOCKSOURCE_OF_DECLARE() was introduced before the
CLOCKEVENT_OF_DECLARE() and that resulted in some abuse where the
clockevent and the clocksource are both initialized in the same init
routine.

With the introduction of the CLOCKEVENT_OF_DECLARE(), the driver can
now split the clocksource and the clockevent init code. However, the
device tree may specify a single node, so the same node will be passed
to the clockevent/clocksource's init function, with the same base
address. It is possible to specify an attribute to the timer's node to
specify if it is a clocksource or a clockevent and define two timers
node.

Example:

	timer: timer@98400000 {
		compatible = "moxa,moxart-timer";
		reg = <0x98400000 0x42>;
		interrupts = <19 1>;
		clocks = <&coreclk>;
		clockevent;
	};

	timer: timer@98400010 {
		compatible = "moxa,moxart-timer";
		reg = <0x98400010 0x42>;
		clocks = <&coreclk>;
		clocksource;
	};
```

## Documentation/devicetree/bindings/ufs/cdns,ufshc.txt
```
* Cadence Universal Flash Storage (UFS) Controller

UFS nodes are defined to describe on-chip UFS host controllers.
Each UFS controller instance should have its own node.

Required properties:
- compatible	: compatible list, contains the following controller:
			"cdns,ufshc"
		  complemented with the JEDEC version:
			"jedec,ufs-2.0"

- reg		: address and length of the UFS register set
- interrupts	: one interrupt mapping
- clocks	: List of phandle and clock specifier pairs.
- clock-names	: List of clock input name strings sorted in the same
		  order as the clocks property. "core" is mandatory.
- freq-table-hz	: Array of <min max> operating frequencies stored in the same
		  order as the clocks property. If this property is not
		  defined or a value in the array is "0" then it is assumed
		  that the frequency is set by the parent clock or a
		  fixed rate clock source.

Example:
	ufs@fd030000 {
		compatible = "cdns,ufshc", "jedec,ufs-2.0";
		reg = <0xfd030000 0x10000>;
		interrupts = <0 1 IRQ_TYPE_LEVEL_HIGH>;
		freq-table-hz = <0 0>, <0 0>;
		clocks = <&ufs_core_clk>, <&ufs_phy_clk>;
		clock-names = "core_clk", "phy_clk";
	};
```

## Documentation/devicetree/bindings/ufs/ufs-dwc.txt
```
* Universal Flash Storage (UFS) DesignWare Host Controller

DWC_UFSHC nodes are defined to describe on-chip UFS host controllers.
Each UFS controller instance should have its own node.

Required properties:
- compatible        : compatible list must contain "snps,ufshcd-dwc" and should
		      also contain the JEDEC version of the controller:
			"jedec,ufs-1.1"
			"jedec,ufs-2.0"
- reg               : <registers mapping>
- interrupts        : <interrupt mapping for UFS host controller IRQ>

Example:
	ufs@0xd0000000 {
		compatible = "jedec,ufs-2.0", "snps,dwc-ufshcd";
		reg = < 0xd0000000 0x10000 >;
		interrupts = < 24 >;
	};
```

## Documentation/devicetree/bindings/ufs/ufs-hisi.txt
```
* Hisilicon Universal Flash Storage (UFS) Host Controller

UFS nodes are defined to describe on-chip UFS hardware macro.
Each UFS Host Controller should have its own node.

Required properties:
- compatible        : compatible list, contains one of the following -
			"hisilicon,hi3660-ufs" for hisi ufs host controller
			 present on Hi3660 chipset.
- reg               : should contain UFS register address space & UFS SYS CTRL register address,
- interrupt-parent  : interrupt device
- interrupts        : interrupt number
- clocks	        : List of phandle and clock specifier pairs
- clock-names       : List of clock input name strings sorted in the same
		      order as the clocks property. "clk_ref", "clk_phy" is optional

Optional properties for board device:
- reset-gpio			: specifies to reset devices

Example:

	ufs: ufs@ff3b0000 {
		compatible = "jedec,ufs-1.1", "hisilicon,hi3660-ufs";
		/* 0: HCI standard */
		/* 1: UFS SYS CTRL */
		reg = <0x0 0xff3b0000 0x0 0x1000>,
			<0x0 0xff3b1000 0x0 0x1000>;
		interrupt-parent = <&gic>;
		interrupts = <GIC_SPI 278 IRQ_TYPE_LEVEL_HIGH>;
		clocks = <&crg_ctrl HI3660_CLK_GATE_UFSIO_REF>,
			<&crg_ctrl HI3660_CLK_GATE_UFSPHY_CFG>;
		clock-names = "clk_ref", "clk_phy";
		freq-table-hz = <0 0>, <0 0>;
		reset-gpio = <&gpio18 1 0>;
	}
```

## Documentation/devicetree/bindings/uio/uio-pdrv-genirq.txt
```
*Generic UIO platform driver with interrupts

Required properties:
- compatible: Should be a value set with the of_id module parameter.

Optional properties:
- interrupts: Should contain the interrupt to be associated with this device
  (only a single interrupt is supported per device).
- interrupt-parent: Specifies the phandle to the parent interrupt controller.
- reg: Should specify the physical address spaces used by this device.

Example:

/* Device with MM IO and interrupt assuming of_id="me,my-device" */
my-device@10000 {
	compatible = "me,my-device";
	reg = <0x10000 0x40>;
	interrupts = <4 IRQ_TYPE_EDGE_BOTH>;
	interrupt-parent = <&gic>;
};

/* Device with interrupt only assuming of_id="me,my-device" */
my-int {
	compatible = "me,my-device";
	interrupts = <6 IRQ_TYPE_EDGE_BOTH>;
	interrupt-parent = <&gic>;
};
```
