## Documentation/devicetree/bindings/sound/sun4i-codec.txt
```
* Allwinner A10 Codec

Required properties:
- compatible: must be one of the following compatibles:
		- "allwinner,sun4i-a10-codec"
		- "allwinner,sun6i-a31-codec"
		- "allwinner,sun7i-a20-codec"
- reg: must contain the registers location and length
- interrupts: must contain the codec interrupt
- dmas: DMA channels for tx and rx dma. See the DMA client binding,
	Documentation/devicetree/bindings/dma/dma.txt
- dma-names: should include "tx" and "rx".
- clocks: a list of phandle + clock-specifer pairs, one for each entry
  in clock-names.
- clock-names: should contain followings:
   - "apb": the parent APB clock for this controller
   - "codec": the parent module clock

Optional properties:
- allwinner,pa-gpios: gpio to enable external amplifier

Required properties for "allwinner,sun6i-a31-codec":
- allwinner,audio-routing: A list of the connections between audio components.
			   Each entry is a pair of strings, the first being the
			   connection's sink, the second being the connection's
			   source. Valid names include:

			   Audio pins on the SoC:
			   "HP"
			   "LINEIN"
			   "LINEOUT"
			   "MIC1"
			   "MIC2"
			   "MIC3"

			   Microphone biases from the SoC:
			   "HBIAS"
			   "MBIAS"

			   Board connectors:
			   "Headphone"
			   "Headset Mic"
			   "Line In"
			   "Line Out"
			   "Mic"
			   "Speaker"

Example:
codec: codec@01c22c00 {
	#sound-dai-cells = <0>;
	compatible = "allwinner,sun7i-a20-codec";
	reg = <0x01c22c00 0x40>;
	interrupts = <0 30 4>;
	clocks = <&apb0_gates 0>, <&codec_clk>;
	clock-names = "apb", "codec";
	dmas = <&dma 0 19>, <&dma 0 19>;
	dma-names = "rx", "tx";
	allwinner,pa-gpios = <&pio 7 22 GPIO_ACTIVE_HIGH>; /* PH22 */
	allwinner,audio-routing =
		"Headphone", "HP",
		"Speaker", "LINEOUT",
		"LINEIN", "Line In",
		"MIC1",	"MBIAS",
		"MIC1", "Mic",
		"MIC2", "HBIAS",
		"MIC2", "Headset Mic";
};
```

## Documentation/devicetree/bindings/sound/sun8i-audio.txt
```
* Allwinner A23/A33 audio card

This binding implements the A33 audio card.

Required properties:
- compatible: must be "allwinner,sun8i-audio"
- allwinner,audio-codec: must have the phandle of the audio codec
  ("sun8i-a33-codec", for example).
- allwinner,i2s-controller: must have the phandle of the DAI
  ("allwinner,sun4i-a10-i2s", for example)

Example:
sound {
	compatible = "allwinner,sun8i-audio";
	allwinner,audio-codec = <&codec>;
	allwinner,i2s-controller = <&dai>;
};
```

## Documentation/devicetree/bindings/sound/sun8i-codec-analog.txt
```
* Allwinner A23/A33 Analog Codec

This codec must be handled as a PRCM subnode.

Required properties:
- compatible: must be either "allwinner,sun8i-codec-analog"
- interrupts: must contain the codec interrupt
- clocks: a list of phandle + clock-specifer pairs, one for each entry
  in clock-names.
- clock-names: should contain followings:
   - "apb": the parent APB clock for this controller
   - "codec": the parent module clock

Example, in your prcm subnode:
codec_analog: codec_analog {
	compatible = "allwinner,sun8i-codec-analog";
	interrupts = <GIC_SPI 29 IRQ_TYPE_LEVEL_HIGH>;
	clocks = <&ccu CLK_BUS_CODEC>, <&ccu CLK_AC_DIG>;
	clock-names = "apb", "codec";
};
```

## Documentation/devicetree/bindings/sound/sun8i-codec.txt
```
* Allwinner A23/A33 Codec

Required properties:
- compatible: must be either "allwinner,sun4i-a23-codec" or
  "allwinner,sun7i-a33-codec"
- reg: must contain the registers location and length
- interrupts: must contain the codec interrupt
- clocks: a list of phandle + clock-specifer pairs, one for each entry
  in clock-names.
- clock-names: should contain followings:
   - "apb": the parent APB clock for this controller
   - "codec": the parent module clock

Example:
codec: codec@01c22e00 {
	#sound-dai-cells = <0>;
	compatible = "allwinner,sun8i-a33-codec";
	reg = <0x01c22e00 0x400>; /* SUNXI_AUDIO_PBASE + 0x200 */
	reg-names = "audio";
	interrupts = <GIC_SPI 29 IRQ_TYPE_LEVEL_HIGH>;
	clocks = <&ccu CLK_BUS_CODEC>, <&ccu CLK_AC_DIG>;
	clock-names = "apb", "codec";
	status = "disabled";
};
```

## Documentation/devicetree/bindings/sound/tas5720.txt
```
Texas Instruments TAS5720 Mono Audio amplifier

The TAS5720 serial control bus communicates through the I2C protocol only.

Required properties:

- compatible : "ti,tas5720"
- reg : I2C slave address

Optional properties:

- dvdd-supply : phandle to a 3.3-V supply for the digital circuitry
- pvdd-supply : phandle to a supply used for the Class-D amp and the analog
- interrupts  : reference to a GPIO pin connected to the TAS5720 FAULTZ pin for
                error reporting purposes

Note that in case of codec errors the driver relies on the TAS5720 datasheet-
proposed "Auto Recovery Circuit" (connection between the FAULTZ and SDZ device
pins) for continued operation. This connection should always be made independent
of whether the optional interrupt-based fault-reporting feature is used.

For more product information please see the links below:

http://www.ti.com/product/TAS5720L
http://www.ti.com/product/TAS5720M

Example:

tas5720: tas5720@6c {
	status = "okay";
	compatible = "ti,tas5720";
	reg = <0x6c>;

	pinctrl-names = "default";
	pinctrl-0 = <&tas572x_int_pin>;
	interrupts-extended = <&gpio1 28 IRQ_TYPE_EDGE_FALLING>;
};
```

## Documentation/devicetree/bindings/sound/tda7419.txt
```
TDA7419 audio processor

This device supports I2C only.

Required properties:

- compatible : "st,tda7419"
- reg : the I2C address of the device.

Example:

ap: tda7419@44 {
	compatible = "st,tda7419";
	reg = <0x44>;
};
```

## Documentation/devicetree/bindings/sound/ti,ads117x.txt
```
Texas Intstruments ADS117x ADC

Required properties:

  - compatible : "ti,ads117x"

Example:

ads1178 {
	compatible = "ti,ads117x";
};
```

## Documentation/devicetree/bindings/sound/ti,tas6424.txt
```
Texas Instruments TAS6424 Quad-Channel Audio amplifier

The TAS6424 serial control bus communicates through I2C protocols.

Required properties:
	- compatible - One of: "ti,tas6424" - TAS6424
	- reg - I2C slave address
	- sound-dai-cells: must be equal to 0

Optional properties:
	- pinctrl-names, pinctrl-0 - Please refer to pinctrl-bindings.txt
	- interrupts-extended - describe the interrupt line used to inform the
	  host. Please refer to interrupt-controller/interrupts.txt

Example:

tas6424: tas6424@6a {
	#sound-dai-cells = <0>;

	status = "okay";

	compatible = "ti,tas6424";
	reg = <0x6a>;

	pinctrl-names = "default";
	pinctrl-0 = <&tas6424_int_pin>;
	interrupts-extended = <&gpio1 28 IRQ_TYPE_EDGE_FALLING>;
};

For more product information please see the link below:
http://www.ti.com/product/TAS6424-Q1
```

## Documentation/devicetree/bindings/sound/wm9713.txt
```
WM9713 audio CODEC

This devices supports I2C.

Required properties:
  - compatible :
	"wlf,wm9713"

Example:
	wm9713: wm9713@0 {
		compatible = "wlf,wm9713";
		#sound-dai-cells = <1>;
		status = "okay";
	};
```

## Documentation/devicetree/bindings/spi/jcore,spi.txt
```
J-Core SPI master

Required properties:

- compatible: Must be "jcore,spi2".

- reg: Memory region for registers.

- #address-cells: Must be 1.

- #size-cells: Must be 0.

See spi-bus.txt for additional properties not specific to this device.

Example:

spi@40 {
	compatible = "jcore,spi2";
	#address-cells = <1>;
	#size-cells = <0>;
	reg = < 0x40 0x8 >;
	spi-max-frequency = <12500000>;
}
```

## Documentation/devicetree/bindings/spi/microchip,spi-pic32.txt
```
* Microchip PIC32 SPI device

Required properties:
- compatible: Should be "microchip,pic32mzda-spi".
- reg: Address and length of the register set for the device
- interrupts: Should contain all three spi interrupts in sequence
              of <fault-irq>, <receive-irq>, <transmit-irq>.
- interrupt-names: Should be "fault","rx","tx" in order.
- clocks: phandles of baud generation clocks. Maximum two possible clocks
	  can be provided (&PBCLK2, &REFCLKO1).
          See: Documentation/devicetree/bindings/clock/clock-bindings.txt
- clock-names: Should be "mck0","mck1".
               See: Documentation/devicetree/bindings/resource-names.txt
- pinctrl-names: A pinctrl state names "default" must be defined.
- pinctrl-0: Phandle referencing pin configuration of the SPI peripheral.
             See: Documentation/devicetree/bindings/pinctrl/pinctrl-binding.txt

Optional properties:
- cs-gpios: List of GPIO chip selects. See ../spi/spi-bus.txt
            See: Documentation/devicetree/bindings/spi/spi-bus.txt
- dmas: Two or more DMA channel specifiers following the convention outlined
        in Documentation/devicetree/bindings/dma/dma.txt
- dma-names: Names for the dma channels. There must be at least one channel
             named "spi-tx" for transmit and named "spi-rx" for receive.

Example:

	spi1:spi@0x1f821000 {
		#address-cells = <1>;
		#size-cells = <0>;
		compatible = "microchip,pic32mzda-spi";
		reg = <0x1f821000 0x200>;
		interrupts = <109 IRQ_TYPE_LEVEL_HIGH>,
			<110 IRQ_TYPE_LEVEL_HIGH>,
			<111 IRQ_TYPE_LEVEL_HIGH>;
		interrupt-names = "fault", "rx", "tx";
		clocks = <&PBCLK2>, <&REFCLKO1>;
		clock-names = "mck0", "mck1";
		dmas = <&dma 134>,
			<&dma 135>;
		dma-names = "spi-rx", "spi-tx";
		cs-gpios = <&gpio3 0 GPIO_ACTIVE_LOW>,
			<&gpio3 14 GPIO_ACTIVE_LOW>;
	};
```

## Documentation/devicetree/bindings/spi/spi-hisi-sfc.txt
```
HiSilicon SPI-NOR Flash Controller

Required properties:
- compatible : Should be one of
		"hisilicon,hisi-sfc"
		"hisilicon,hi3519-sfc"
- address-cells : number of cells required to define a chip select
        address on the SPI bus. Should be set to 1. See spi-bus.txt.
- size-cells : Should be 0.
- reg : Offset and length of the register set for the controller device.
- reg-names : Must include the following two entries: "control", "memory".
- clocks : handle to spi-nor flash controller clock.

Example:
spi-nor-controller@10000000 {
	compatible = "hisilicon,hisi-sfc";
	#address-cells = <1>;
	#size-cells = <0>;
	reg = <0x10000000 0x1000>, <0x14000000 0x1000000>;
	reg-names = "control", "memory";
	clocks = <&clock HI3519_FMC_CLK>;
	spi-nor@0 {
		compatible = "jedec,spi-nor";
		reg = <0>;
	};
};
```

## Documentation/devicetree/bindings/spi/spi-renesas-rpc.txt
```
Renesas R-Car Gen3 RPC-IF controller Device Tree Bindings
----------------------------------------------------------

Required properties:
- compatible: should be "renesas,r8a77995-rpc"
- #address-cells: should be 1
- #size-cells: should be 0
- reg: should contain 2 entries, one for the registers and one for the direct
       mapping area
- reg-names: should contain "regs" and "dirmap"
- clock-names: should contain "rpc"
- clocks: should contain 1 entries for the module's clock
- renesas,rpc-mode: should contain "spi" for rpc spi mode or
			   	   "hyperflash" for rpc hyperflash mode.

Example:

	rpc: rpc@ee200000 {
		compatible = "renesas,r8a77995-rpc";
		reg = <0 0xee200000 0 0x8100>, <0 0x08000000 0 0x4000000>;
		reg-names = "regs", "dirmap";
		clocks = <&cpg CPG_MOD 917>;
		power-domains = <&sysc R8A77995_PD_ALWAYS_ON>;
		resets = <&cpg 917>;
		clock-names = "rpc";
		renesas,rpc-mode = "spi";
		#address-cells = <1>;
		#size-cells = <0>;

		flash@0 {
			compatible = "jedec,spi-nor";
			reg = <0>;
			spi-max-frequency = <40000000>;
			spi-tx-bus-width = <1>;
			spi-rx-bus-width = <1>;
		};
	};
```

## Documentation/devicetree/bindings/spi/spi-slave-mt27xx.txt
```
Binding for MTK SPI Slave controller

Required properties:
- compatible: should be one of the following.
    - mediatek,mt2712-spi: for mt2712 platforms

- reg: Address and length of the register set for the device

- interrupts: Should contain spi interrupt

- clocks: phandles to input clocks.
  The first should be one of the following. It's PLL.
   -  <&topckgen CLK_TOP_UNIVPLL1_D2>: specify parent clock 312MHZ.
				      It's the default one.
   -  <&topckgen CLK_TOP_UNIVPLL1_D4>: specify parent clock 156MHZ.
   -  <&topckgen CLK_TOP_UNIVPLL2_D4>: specify parent clock 104MHZ.
   -  <&topckgen CLK_TOP_UNIVPLL1_D8>: specify parent clock 78MHZ.
  The second should be <&topckgen CLK_TOP_SPISLV_SEL>. It's clock mux.
  The third is <&infracfg CLK_INFRA_AO_SPI1>. It's clock gate.

- clock-names: shall be "parent-clk" for the parent clock, "sel-clk" for the
  muxes clock, and "spi-clk" for the clock gate.

- spi-slave: Empty property indicating the SPI controller is used in slave mode.

Example:

- SoC Specific Portion:
spis: spi@10013000 {
	compatible = "mediatek,mt2712-spi-slave";
	reg = <0 0x10013000 0 0x100>;
	interrupts = <GIC_SPI 283 IRQ_TYPE_LEVEL_LOW>;
	clocks = <&topckgen CLK_TOP_UNIVPLL1_D2>,
		<&topckgen CLK_TOP_SPISLV_SEL>,
		<&infracfg CLK_INFRA_AO_SPI1>;
	clock-names = "parent-clk", "sel-clk", "spi-clk";
	spi-slave;
	status = "disabled";
};
```

## Documentation/devicetree/bindings/spi/spi-sun4i.txt
```
Allwinner A10 SPI controller

Required properties:
- compatible: Should be "allwinner,sun4-a10-spi".
- reg: Should contain register location and length.
- interrupts: Should contain interrupt.
- clocks: phandle to the clocks feeding the SPI controller. Two are
          needed:
  - "ahb": the gated AHB parent clock
  - "mod": the parent module clock
- clock-names: Must contain the clock names described just above

Optional properties for slave devices:
- sun4i,spi-wdelay : delay between transmission of words, specified in number
  of SPI clock periods (actual delay is wdelay + 3 clock periods)

Example:

spi1: spi@01c06000 {
	compatible = "allwinner,sun4i-a10-spi";
	reg = <0x01c06000 0x1000>;
	interrupts = <11>;
	clocks = <&ahb_gates 21>, <&spi1_clk>;
	clock-names = "ahb", "mod";
	status = "disabled";
	#address-cells = <1>;
	#size-cells = <0>;

	spi1_0 {
		compatible = "example,dummy";
		reg = <0>;
		spi-max-frequency = <1000000>; /* 1Mhz = 1us clock period */
		sun4i,spi-wdelay = <2>; /* delay 5us (2 + 3 clock periods) */
	};
};
```

## Documentation/devicetree/bindings/spi/spi_atmel-qspi.txt
```
* Atmel Quad Serial Peripheral Interface (QSPI)

Required properties:
- compatible:     Should be "atmel,sama5d2-spi-qspi".
- reg:            Should contain the locations and lengths of the base registers
                  and the mapped memory.
- reg-names:      Should contain the resource reg names:
                  - qspi_base: configuration register address space
                  - qspi_mmap: memory mapped address space
- interrupts:     Should contain the interrupt for the device.
- clocks:         The phandle of the clock needed by the QSPI controller.
- #address-cells: Should be <1>.
- #size-cells:    Should be <0>.

Example:

qspi1: spi@f0024000 {
	compatible = "atmel,sama5d2-spi-qspi";
	reg = <0xf0024000 0x100>, <0xd8000000 0x08000000>;
	reg-names = "qspi_base", "qspi_mmap";
	interrupts = <53 IRQ_TYPE_LEVEL_HIGH 7>;
	clocks = <&qspi1_clk>;
	#address-cells = <1>;
	#size-cells = <0>;
	pinctrl-names = "default";
	pinctrl-0 = <&pinctrl_qspi1_default>;
	status = "okay";

	flash@0 {
		#address-cells = <1>;
		#size-cells = <1>;
		compatible = "winbond,w25m02gv", "spi-nand";
		reg = <0>;
		spi-max-frequency = <83000000>;
		spi-rx-bus-width = <4>;
		spi-tx-bus-width = <4>;

		...
	};
};
```
