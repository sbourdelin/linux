## Documentation/devicetree/bindings/sound/rt5616.txt
```
RT5616 audio CODEC

This device supports I2C only.

Required properties:

- compatible : "realtek,rt5616".

- reg : The I2C address of the device.

Optional properties:

Pins on the device (for linking into audio routes) for RT5616:

  * IN1P
  * IN2P
  * IN2N
  * LOUTL
  * LOUTR
  * CPN2
  * CPP2
  * CPN1
  * CPP1
  * HPO_R
  * HPO_L
  * ADCDAT1
  * DACDAT1
  * LRCK1
  * BCLK1
  * MCLK
  * GPIO1

Example:

rt5616 {
	compatible = "realtek,rt5616";
	reg = <0x1b>;
};
```

## Documentation/devicetree/bindings/sound/rt5663.txt
```
RT5663 audio CODEC

This device supports I2C only.

Required properties:

- compatible : "realtek,rt5663".

- reg : The I2C address of the device.

- interrupts : The CODEC's interrupt output.

Optional properties:

- "realtek,dc_offset_l_manual"
- "realtek,dc_offset_r_manual"
- "realtek,dc_offset_l_manual_mic"
- "realtek,dc_offset_r_manual_mic"
  Based on the different PCB layout, add the manual offset value to
  compensate the DC offset for each L and R channel, and they are different
  between headphone and headset.
- "realtek,impedance_sensing_num"
  The matrix row number of the impedance sensing table.
- "realtek,impedance_sensing_table"
  The matrix rows of the impedance sensing table are consisted by impedance
  minimum, impedance maximun, volume, DC offset w/o and w/ mic of each L and
  R channel accordingly.

Pins on the device (for linking into audio routes) for RT5663:

  * IN1P
  * IN1N
  * IN2P
  * IN2N
  * HPOL
  * HPOR

Example:

codec: rt5663@12 {
	compatible = "realtek,rt5663";
	reg = <0x12>;
	interrupts = <7 IRQ_TYPE_EDGE_FALLING>;
};
```

## Documentation/devicetree/bindings/sound/samsung,exynos5433-lpass.txt
```
Samsung Exynos SoC Low Power Audio Subsystem (LPASS)

Required properties:

 - compatible : "samsung,exynos5433-lpass"
 - reg : should contain the LPASS SFR region location and size
 - samsung,pmu-syscon : the phandle to the Power Management Unit node
```

## Documentation/devicetree/bindings/sound/samsung,tm2-wm5110.txt
```
Samsung Exynos5433 TM2(E) audio complex with WM5110 codec

Required properties:

 - compatible : "samsung,tm2-audio"
 - samsung,model : the user-visible name of this sound complex
 - clocks : must contain an entry for each entry in clock-names,
   see ../clocks/clock-bindings.txt for details
 - clock-names : must include the following entries:
   "mclk1", "mclk2"
 - samsung,i2s-controller : the phandle of the I2S controller
 - samsung,speaker-amplifier : the phandle of the MAX98504 amplifier
 - samsung,audio-routing : a list of the connections between audio
   components;  each entry is a pair of strings, the first being the
   connection's sink, the second being the connection's source;
   valid names for sources and sinks are the WM5110's and MAX98504's
   pins and the jacks on the board:
   HP, SPK, Main Mic, Sub Mic, Third Mic, Headset Mic.
 - mic-bias-gpios : GPIO pin that enables the Main Mic bias regulator

Example:

sound {
	compatible = "samsung,tm2-audio";
	clocks = <&pmu_system_controller 0>, <&s2mps13_osc 2>;
	clock-names = "mclk1", "mclk2";
	samsung,i2s-controller = <&i2s0>;
	samsung,speaker-amplifier = <&max98504>;
	samsung,model = "wm5110";
	mic-bias-gpios = <&gpr3 2 0>;
	samsung,audio-routing =
		"HP", "HPOUT1L",
		"HP", "HPOUT1R",
		"SPK", "SPKOUT",
		"SPKOUT", "HPOUT2L",
		"SPKOUT", "HPOUT2R",
		"Main Mic", "MICBIAS2",
		"IN1R", "Main Mic";
};
```

## Documentation/devicetree/bindings/sound/simple-graph-card.txt
```
Simple-Graph-Card:

Simple-Graph-Card specifies audio DAI connections of SoC <-> codec.
It is based on common bindings for device graphs.
see ${LINUX}/Documentation/devicetree/bindings/graph.txt

Basically, Simple-Graph-Card property is same as Simple-Card.
see ${LINUX}/Documentation/devicetree/bindings/sound/simple-card.txt

Below are same as Simple-Card.

- simple-audio-card,name
- simple-audio-card,format
- simple-audio-card,frame-master
- simple-audio-card,bitclock-master
- simple-audio-card,bitclock-inversion
- simple-audio-card,frame-inversion
- simple-audio-card,dai-tdm-slot-num
- simple-audio-card,dai-tdm-slot-width
- clocks / system-clock-frequency

These should be implemented
- simple-audio-card,widgets
- simple-audio-card,routing
- simple-audio-card,mclk-fs
- simple-audio-card,hp-det-gpio
- simple-audio-card,mic-det-gpio

Required properties:

- compatible				: "asoc-simple-graph-card";
- dais					: list of CPU DAI port{s}

Example: Single DAI case

	sound_card: sound {
		compatible = "asoc-simple-graph-card";

		dais = <&cpu_port>;
	};

	codec {
		...
		port {
			codec_endpoint: endpoint {
				remote-endpoint = <&cpu_endpoint>;
			};
		};
	};

	cpu {
		...
		cpu_port: port@0 {
			cpu_endpoint: endpoint {
				remote-endpoint = <&codec_endpoint>;

				simple-audio-card,format = "left_j";
				simple-audio-card,bitclock-master = <&cpu_endpoint>;
				simple-audio-card,frame-master = <&cpu_endpoint>;
				...
			};
		};
	};

Example: Multi DAI case

	sound_card: sound {
		compatible = "asoc-simple-graph-card";

		dais = <&cpu_port0
			&cpu_port1
			&cpu_port2>;
	};

	codec0 {
		...
		port {
			codec0_endpoint: endpoint {
				remote-endpoint = <&cpu_endpoint0>;
			};
		};
	};

	codec1 {
		...
		port {
			codec1_endpoint: endpoint {
				remote-endpoint = <&cpu_endpoint1>;
			};
		};
	};

	codec2 {
		...
		port {
			codec2_endpoint: endpoint {
				remote-endpoint = <&cpu_endpoint2>;
			};
		};
	};

	cpu {
		...
		ports {
			cpu_port0: port@0 {
				cpu_endpoint0: endpoint {
					remote-endpoint = <&codec0_endpoint>;

					simple-audio-card,format = "left_j";
					simple-audio-card,bitclock-master = <&cpu_endpoint0>;
					simple-audio-card,frame-master = <&cpu_endpoint0>;
					...
				};
			};
			cpu_port1: port@1 {
				cpu_endpoint1: endpoint {
					remote-endpoint = <&codec1_endpoint>;

					simple-audio-card,format = "i2s";
					simple-audio-card,bitclock-master = <&cpu_endpoint1>;
					simple-audio-card,frame-master = <&cpu_endpoint1>;
					...
				};
			};
			cpu_port2: port@2 {
				cpu_endpoint2: endpoint {
					remote-endpoint = <&codec2_endpoint>;

					simple-audio-card,format = "i2s";
					simple-audio-card,bitclock-master = <&cpu_endpoint2>;
					simple-audio-card,frame-master = <&cpu_endpoint2>;
					...
				};
			};
		};
	};
```

## Documentation/devicetree/bindings/sound/simple-graph-scu-card.txt
```
Simple-Graph-SCU-Card:

Simple-Graph-SCU-Card specifies audio DAI connections of SoC <-> codec.
It is based on common bindings for device graphs.
see ${LINUX}/Documentation/devicetree/bindings/graph.txt

Basically, Simple-Graph-SCU-Card property is same as Simple-Card / Simple-Graph-Card.
see ${LINUX}/Documentation/devicetree/bindings/sound/simple-card.txt
    ${LINUX}/Documentation/devicetree/bindings/sound/simple-graph-card.txt

Main difference between Simple-Graph-Card and Simple-Graph-SCU-Card is that
Simple-Graph-SCU-Card can use multi CPU.

Required properties:

- compatible				: "asoc-simple-graph-scu-card";
- type					: "sound";
- simple-audio-card,routing		: see simple-card.txt

Example

ak4643: codec@12 {
	compatible = "asahi-kasei,ak4643";
	...
	port {
		type = "sound";
		ak4643_fe: endpoint@0 {
			remote-endpoint = <&rsnd_fe>;
			...
		};
		ak4643_be: endpoint@1 {
			remote-endpoint = <&rsnd_be>;
			...
		};
	};
};

rcar_sound {
	...
	ports {
		compatible = "asoc-simple-graph-scu-card";

		simple-audio-card,name = "graph-sound";
		simple-audio-card,format = "left_j";
		simple-audio-card,bitclock-master = <&rsnd_fe>;
		simple-audio-card,frame-master = <&rsnd_fe>;
		simple-audio-card,convert-rate = <48000>;
		simple-audio-card,convert-channels = <2>;
		simple-audio-card,prefix = "ak4642";
		simple-audio-card,routing =
				"ak4642 Playback", "DAI0 Playback",
				"ak4642 Playback", "DAI1 Playback";

		port@0 {
			type = "sound";
			rsnd_fe: endpoint@0 {
				remote-endpoint = <&ak4643_fe>;
				...
			};
		};
		port@1 {
			type = "sound";
			rsnd_be: endpoint@1 {
				remote-endpoint = <&ak4643_be>;
				...
			};
		};
	};
};
```

## Documentation/devicetree/bindings/sound/st,sm32-adfsdm.txt
```
STMicroelectronics STM32 ADFSDM ASoC DAI device driver.

STM32 ADFSDM ASoC is a sigma delta audio interface for digital microphone.
It has to be declared in device-tree as a subnode of the DFSDM mfd node.

It offers possibility to record several mono microphones, with an option to
synchronize all microphones on a main one (that must be piped to filter 0)
Audio interface can be exposed through the generic ASoC simple card.

2 Dmics can be connected on one SPI interface instance n.
Convention is that the DMIC that strobes data on rising edge is connected to the
corresponding DFSDM channel n; while the Dmic that strobes data on falling edge
is connected to the channel n-1. Simple card property "bitclock-inversion = <1>"
is used to specify that microphone strobes data on falling edge.

SPI interface allows to be scheduled by an external SPI clock. To use it
simple card properties "bitclock-master = <&codec>" and "system-clock-frequency"
have to be defined in dai-link node.

Required properties:
- compatible: 	Must be "st,stm32-dfsdm-audio",
- reg:		Specifies the DFSDM filter instance.
- interrupts: 	DFSDM filter instance interrupt line.
- dma:		DMA controller phandle and DMA request line associated to the
		filter instance ( specified by the field "reg")
- dma-names: 	must be "rx"

- st,input-id:		Id of the SPI/Manchester interface used.
- st,dai-filter-order:  SinC filter order from 0 to 5.
			0: FastSinC
			[1-5]: order 1 to 5.
			For audio purpose it is recommended to use order 3 to 5.

Optional properties:
 - st,dai0-synchronized: Set to 1 to synchronize DAI with DFSDM instance 0.

Exemple of a card with 2 Dmics synchronized and connected on SPI interface 1.

	dfsdm: dfsdm@4400D000 {
		dai_dfsdm0: dfsdm-audio@0 {
			compatible = "st,stm32-dfsdm-audio";
			#sound-dai-cells = <0>;
			reg = <0>;
			dmas = <&dmamux1 101 0x400 0x00>;
			dma-names = "rx";
			st,input-id = <0>;
			st,dai-filter-order = <5>;
		};
		dai_dfsdm1: dfsdm-audio@1 {
			compatible = "st,stm32-dfsdm-audio";
			#sound-dai-cells = <0>;
			reg = <0>;
			dmas = <&dmamux1 102 0x400 0x00>;
			dma-names = "rx";
			st,input-id = <0>;
			st,dai0-synchronized = <1>;
			st,dai-filter-order = <5>;
		};
	};
	sound_dfsdm_pdm {
		compatible = "simple-audio-card";
		simple-audio-card,name = "dfsdm_pdm";
		status = "okay";

		dfsdm0_mic0: simple-audio-card,dai-link@0 {
			format = "pdm";
			cpu {
				sound-dai = <&dai_dfsdm0>;
			};
			dmic0_codec: codec {
				sound-dai = <&dmic0>;
			};
		};
		dfsdm0_mic1: simple-audio-card,dai-link@1 {
			format = "pdm";
			bitclock-inversion = <1>;
			cpu {
				sound-dai = <&dai_dfsdm1>;
			};
			codec {
				sound-dai = <&dmic1>;
			};
		};
	};
```

## Documentation/devicetree/bindings/sound/st,stm32-adfsdm.txt
```
STMicroelectronics audio DFSDM DT bindings

This driver supports audio PDM microphone capture through Digital Filter format
Sigma Delta modulators (DFSDM).

Required properties:
  - compatible: "st,stm32h7-adfsdm".

  - #sound-dai-cells : Must be equal to 0

  - io-channels : phandle to iio dfsdm instance node.


Example of a simple sound card using audio DFSDM node.

	dmic0: dmic_@0 {
		compatible = "dmic-codec";
		#sound-dai-cells = <0>;
	};

	asoc-pdm@0 {
		compatible = "st,stm32h7-adfsdm";
		#sound-dai-cells = <0>;
		io-channels = <&dfsdm_adc0 0>;
	};

	sound_dfsdm_pdm {
 		compatible = "simple-audio-card";
 		simple-audio-card,name = "dfsdm_pdm";

 		dfsdm0_mic0: simple-audio-card,dai-link@0 {
 			format = "pdm";
 			cpu {
 				sound-dai = <&asoc_pdm1>;
 			};
 			dmic0_codec: codec {
 				sound-dai = <&dmic0>;
 			};
 		};
	};
```

## Documentation/devicetree/bindings/sound/st,stm32-sai.txt
```
STMicroelectronics STM32 Serial Audio Interface (SAI).

The SAI interface (Serial Audio Interface) offers a wide set of audio protocols
as I2S standards, LSB or MSB-justified, PCM/DSP, TDM, and AC'97.
The SAI contains two independent audio sub-blocks. Each sub-block has
its own clock generator and I/O lines controller.

Required properties:
  - compatible: Should be "st,stm32f4-sai"
  - reg: Base address and size of SAI common register set.
  - clocks: Must contain phandle and clock specifier pairs for each entry
	in clock-names.
  - clock-names: Must contain "clk_x8k" and "clk_x11k"
	"clk_x8k": SAI parent clock for sampling rates multiple of 8kHz.
	"clk_x11k": SAI parent clock for sampling rates multiple of 11.025kHz.
  - interrupts: cpu DAI interrupt line shared by SAI sub-blocks

Note: Each SAI controller should have an alias correctly numbered
in "aliases" node, to provide explicit name to CPU DAI.

Optional properties:
  - resets: Reference to a reset controller asserting the SAI

SAI subnodes:
Two subnodes corresponding to SAI sub-block instances A et B can be defined.
Subnode can be omitted for unsused sub-block.

SAI subnodes required properties:
  - compatible: Should be "st,stm32-sai-sub-a" or "st,stm32-sai-sub-b"
	for SAI sub-block A or B respectively.
  - reg: Base address and size of SAI sub-block register set.
  - clocks: Must contain one phandle and clock specifier pair
	for sai_ck which feeds the internal clock generator.
  - clock-names: Must contain "sai_ck".
  - dmas: see Documentation/devicetree/bindings/dma/stm32-dma.txt
  - dma-names: identifier string for each DMA request line
	"tx": if sai sub-block is configured as playback DAI
	"rx": if sai sub-block is configured as capture DAI
  - pinctrl-names: should contain only value "default"
  - pinctrl-0: see Documentation/devicetree/bindings/pinctrl/pinctrl-stm32.txt

Example:
sai1: sai1@40015800 {
	compatible = "st,stm32f4-sai";
	reg = <0x40015800 0x400>;
	clocks = <&rcc 1 CLK_SAIQ_PDIV>, <&rcc 1 CLK_I2SQ_PDIV>;
	clock-names = "clk_x8k", "clk_x11k";
	interrupts = <87>;
	resets = <&rcc 310>;

	sai1b: sai@1 {
		#sound-dai-cells = <0>;
		compatible = "st,stm32-sai-sub-b";
		clocks = <&rcc 1 CLK_SAI2>;
		clock-names = "sai_ck";
		dmas = <&dma2 5 0 0x400 0x1>;
		dma-names = "tx";
	};
};

sound {
	compatible = "simple-audio-card";
	simple-audio-card,name = "STM32-Sound-Card";
	status = "okay";

	simple-audio-card,dai-link@0 {
		format = "i2s";
		cpu {
			sound-dai = <&sai1b>;
		};
		codec {
			sound-dai = <&codec>;
		};
	};
};

aliases {
	sai1 = &sai1;
};
```
