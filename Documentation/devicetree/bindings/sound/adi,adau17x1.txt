## Documentation/devicetree/bindings/sound/max98504.txt
```
Maxim MAX98504 class D mono speaker amplifier

Required properties:

 - compatible : "maxim,max98504"
 - reg : should contain the I2C slave device address

Optional properties:

 - maxim,rx-path : indicates speaker source interface:
    0 - PCM monomix output,
    1 - Analog input,
    2 - left PDM channel (CH0),
    3 - right PDM channel (CH1)

 - maxim,rx-channel-mask : a bitmask indicating active PCM Rx channels,
   bits b7...b0 correspond to channels CH7...CH0

 - maxim,tx-path : indicates the V/I sense (feedback) Tx data interface used:
    0 - PCM, 1 - TDM

 - maxim,tx-channel-mask : a bitmask indicating active PCM or PDM Tx channels,
   bits b7...b0 correspond to channels CH7...CH0, for PCM are meaningful
   channels CH7...CH0, for PDM only channels CH1, CH0

 - maxim,tx-channel-source : a bitmask indicating V/I sense source type for
   each PCM or PDM Tx channel; bits b7...b0 correspond to channels CH7...CH0,
   for PCM are meaningful channels CH7...CH0, for PDM only channels CH1, CH0:
    0 - selects voltage measurement data (V),
    1 - selects current measurement data (I)

If any of the above optional properties is missing its value defaults to 0.

Example:

 max98504: max98504@31 {
	compatible = "maxim,max98504";
	reg = <0x31>;
	maxim,rx-path = <1>;		// Analog input
	maxim,tx-path = <1>;		// V/I sense PDM Tx
	maxim,tx-channel-mask = <3>;	// channels CH1, CH0
	maxim,tx-channel-source = <2>;	// CH1 current, CH0 voltage
};
```

## Documentation/devicetree/bindings/sound/motorola,cpcap-audio-codec.txt
```
Motorola CPCAP audio CODEC
--------------------------

This module is part of the CPCAP. For more details about the whole
chip see Documentation/devicetree/bindings/mfd/motorola-cpcap.txt.

Required properties:

  - compatible : "motorola,cpcap-audio-codec"
  - vdd-supply : Phandle to audio regulator

Example:

&cpcap {
	audio-codec {
		compatible = "motorola,cpcap-audio-codec";
		vdd-supply = <&vaudio>;
	};
};
```

## Documentation/devicetree/bindings/sound/mt8173-rt5650.txt
```
MT8173 with RT5650 CODECS

Required properties:
- compatible : "mediatek,mt8173-rt5650"
- mediatek,audio-codec: the phandles of rt5650 codecs
- mediatek,platform: the phandle of MT8173 ASoC platform

Optional properties:
- mediatek,audio-codec-dai-capture: audio codec dai on capture path
  rt5645-aif1: Default setting. Connect rt5650 I2S1 for capture
  rt5645-aif2: Connect rt5650 I2S2 for capture

Example:

	sound {
		compatible = "mediatek,mt8173-rt5650";
		mediatek,audio-codec = <&rt5650>;
		mediatek,platform = <&afe>;
		mediatek,audio-codec-dai-capture = "rt5645-aif2";
	};
```

## Documentation/devicetree/bindings/sound/pcm1792a.txt
```
Texas Instruments pcm1792a DT bindings

This driver supports the SPI bus.

Required properties:

 - compatible: "ti,pcm1792a"

For required properties on SPI, please consult
Documentation/devicetree/bindings/spi/spi-bus.txt

Optional properties:
- ti,side: specifie the channel side
  insertion, removal.

Examples:

	codec_spi: 1792a@0 {
		compatible = "ti,pcm1792a";
		spi-max-frequency = <600000>;
		ti,side = <left>
	};
```

## Documentation/devicetree/bindings/sound/pcm9211.txt
```
PCM9211 audio CODEC

This device supports both I2C and SPI (configured with pin strapping
on the board). The driver is currently implementing i2c only.

Required properties:

  - compatible : "ti,pcm9211"

  - reg : the I2C address of the device for I2C, the chip select
          number for SPI.

  - VCCAD-supply, VCC-supply, VDDRX-supply and AVDD-supply :
    power supplies for the device, as covered in
    bindings/regulator/regulator.txt

Optional properties:

  - clocks : A clock specifier for the clock connected to XTI. While the
    device could work without it, this driver currently relies on it being
    available

  - clock-names : Must specify "xti" to match the requested clock.

  - reset-gpios : GPIO wired to the reset pin, if not supplied a soft-reset is
    used as fallback

  - int0-gpios : GPIO connected to interrupt0 output of the PCM9211. The
    line can be configured to any of MPO0,1 and MPIOA,B,C0-4 and error/int0.
    If this is specified it is used as an interrupt to notify alsa controls
    about changes of the incoming sampling rate on DIR (spdif) as well as NPCM
    status.

  - ti,group-function: An array with size 3 specifying function for pingroups
    A, B and C. Possible values are defined in dt-bindings/sound/pcm9211.h

  - ti,mpio-a-flags-gpio: An array with size 4 specifying flags out or gpio
    mode per pin, when function DIR_FLAGS_GPIO is selected for group a.
    Possible values are defined in dt-bindings/sound/pcm9211.h

  - ti,mpio-b-flags-gpio: An array with size 4 specifying flags out or gpio
    mode per pin, when function DIR_FLAGS_GPIO is selected for group b.
    Possible values are defined in dt-bindings/sound/pcm9211.h

  - ti,mpio-c-flags-gpio: An array with size 4 specifying flags out or gpio
    mode per pin, when function DIR_FLAGS_GPIO is selected for group c.
    Possible values are defined in dt-bindings/sound/pcm9211.h

  - ti,mpio-a-flag: An array with size 4 specifying flag assigned per pin,
    when function DIR_FLAGS_GPIO is selected for group a and pin is set to
    flags mode.
    Possible values are defined in dt-bindings/sound/pcm9211.h

  - ti,mpio-b-flag: An array with size 4 specifying flag assigned per pin,
    when function DIR_FLAGS_GPIO is selected for group b and pin is set to
    flags mode.
    Possible values are defined in dt-bindings/sound/pcm9211.h

  - ti,mpio-c-flag: An array with size 4 specifying flag assigned per pin,
    when function DIR_FLAGS_GPIO is selected for group c and pin is set to
    flags mode.
    Possible values are defined in dt-bindings/sound/pcm9211.h

  - ti,mpo-function: An array with size 2 specifying flag assigned per mpo
    pin.
    Possible values are defined in dt-bindings/sound/pcm9211.h

  - ti,int0-function: Selects error/int0 pin function.
    Possible values are defined in dt-bindings/sound/pcm9211.h

  - ti,int1-function: Selects error/int1 pin function.
    Possible values are defined in dt-bindings/sound/pcm9211.h

Examples:

	pcm9211: pcm9211@43 {
		compatible = "ti,pcm9211";
		reg = <0x43>;

		VCCAD-supply = <&reg_5v0_analog>;
		VCC-supply = <&reg_3v3_pll_analog>;
		VDDRX-supply = <&reg_3v3>;
		DVDD-supply = <&reg_3v3>;

		clocks = <&xti_clk>;
		clock-names = "xti";
	};


	pcm9211: pcm9211@43 {
		compatible = "ti,pcm9211";
		reg = <0x43>;

		VCCAD-supply = <&reg_5v0_analog>;
		VCC-supply = <&reg_3v3_pll_analog>;
		VDDRX-supply = <&reg_3v3>;
		DVDD-supply = <&reg_3v3>;

		clocks = <&xti_clk>;
		clock-names = "xti";

		reset-gpios = <&gpio1 0 GPIO_ACTIVE_HIGH>;
		int-gpios = <&gpio1 0 GPIO_ACTIVE_HIGH>;

		ti,group-function = /bits/ 8
			<PCM9211_MPIO_A_GROUP_BIPHASE_INPUT,
			PCM9211_MPIO_B_GROUP_DIR_FLAGS_GPIO,
			PCM9211_MPIO_C_GROUP_AUXIN1>;
		ti,mpio-b-flags-gpio = /bits/ 8
			<PCM9211_MPIO_DIR_FLAGS,
			PCM9211_MPIO_DIR_FLAGS,
			PCM9211_MPIO_DIR_FLAGS,
			PCM9211_MPIO_DIR_FLAGS>;
		ti,mpio-b-flag = /bits/ 8
			<PCM9211_MPIO_FLAG_INT0,
			PCM9211_MPIO_FLAG_CLKST,
			PCM9211_MPIO_FLAG_CLKST,
			PCM9211_MPIO_FLAG_CLKST>;
	};
```

## Documentation/devicetree/bindings/sound/qcom,sdm845.txt
```
* Qualcomm Technologies Inc. SDM845 ASoC sound card driver

This binding describes the SDM845 sound card, which uses qdsp for audio.

- compatible:
	Usage: required
	Value type: <stringlist>
	Definition: must be "qcom,sdm845-sndcard"

- qcom,audio-routing:
	Usage: Optional
	Value type: <stringlist>
	Definition:  A list of the connections between audio components.
		  Each entry is a pair of strings, the first being the
		  connection's sink, the second being the connection's
		  source. Valid names could be power supplies, MicBias
		  of codec and the jacks on the board.

- cdc-vdd-supply:
	Usage: Optional
	Value type: <phandle>
	Definition: phandle of regulator supply required for codec vdd.

= dailinks
Each subnode of sndcard represents either a dailink, and subnodes of each
dailinks would be cpu/codec/platform dais.

- link-name:
	Usage: required
	Value type: <string>
	Definition: User friendly name for dai link

= CPU, PLATFORM, CODEC dais subnodes
- cpu:
	Usage: required
	Value type: <subnode>
	Definition: cpu dai sub-node

- codec:
	Usage: required
	Value type: <subnode>
	Definition: codec dai sub-node

- platform:
	Usage: opional
	Value type: <subnode>
	Definition: platform dai sub-node

- sound-dai:
	Usage: required
	Value type: <phandle>
	Definition: dai phandle/s and port of CPU/CODEC/PLATFORM node.

Example:

audio {
	compatible = "qcom,sdm845-sndcard";
	qcom,model = "sdm845-snd-card";
	pinctrl-names = "pri_active", "pri_sleep";
	pinctrl-0 = <&pri_mi2s_active &pri_mi2s_ws_active>;
	pinctrl-1 = <&pri_mi2s_sleep &pri_mi2s_ws_sleep>;

	qcom,audio-routing = "PRI_MI2S_RX Audio Mixer", "Pri-mi2s-gpio";

	cdc-vdd-supply = <&pm8998_l14>;

	fe@1 {
		link-name = "MultiMedia1";
		cpu {
			sound-dai = <&q6asmdai MSM_FRONTEND_DAI_MULTIMEDIA1>;
		};
		platform {
			sound-dai = <&q6asmdai>;
		};
	};

	be@1 {
		link-name = "PRI MI2S Playback";
		cpu {
			sound-dai = <&q6afedai PRIMARY_MI2S_RX>;
		};

		platform {
			sound-dai = <&q6routing>;
		};
	};
};
```

## Documentation/devicetree/bindings/sound/rockchip,rk3399-max98357a-rt5514-da7219.txt
```
ROCKCHIP with MAX98357A/RT5514/DA7219 codecs

Required properties:
- compatible: "rockchip,rk3399-max98357a-rt5514-da7219"
- rockchip,cpu: The phandle of the Rockchip I2S controller that's
  connected to the codecs
- rockchip,codec: The phandle of the MAX98357A/RT5514/DA7219 codecs

Example:

sound {
	compatible = "rockchip,rk3399-max98357a-rt5514-da7219";
	rockchip,cpu = <&i2s0 &i2s0 &i2s1>;
	rockchip,codec = <&max98357a &headsetcodec &codec>;
};
```

## Documentation/devicetree/bindings/sound/rockchip-max98357a-rt5514-da7219.txt
```
ROCKCHIP with MAX98357A/RT5514/DA7219 codecs

Required properties:
- compatible: "rockchip,rockchip-sound"
- rockchip,cpu: The phandle of the Rockchip I2S controller that's
  connected to the codecs
- rockchip,codec: The phandle of the MAX98357A/RT5514/DA7219 codecs

Example:

sound {
	compatible = "rockchip,rockchip-sound";
	rockchip,cpu = <&i2s0 &i2s0 &i2s1>;
	rockchip,codec = <&max98357a &headsetcodec &codec>;
};
```

## Documentation/devicetree/bindings/sound/rt5514-spi.txt
```
RT5514 SPI audio CODEC

This device supports SPI only.

Required properties:

- compatible : "realtek,rt5514".

- reg : The SPI address of the device.

Optional properties:

- interrupt-parent: Should be the phandle for the interrupt controller
- interrupts: The interrupt number to the cpu. The interrupt specifier format
	      depends on the interrupt controller.

Example:

codec: rt5514-spi@0 {
	compatible = "realtek,rt5514", "realtek,rt5514-spi";
	reg = <0>;

        /* May run faster once verified. */
        spi-max-frequency = <10000000>;

        pinctrl-names = "default";
        pinctrl-0 = <&mic_int>;

        interrupt-parent = <&gpio1>;
        interrupts = <13 IRQ_TYPE_LEVEL_HIGH>;
        wakeup-source;
};
```
