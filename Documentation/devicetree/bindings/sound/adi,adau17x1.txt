## Documentation/devicetree/bindings/sound/img,pistachio-audio.txt
```
Imagination Technologies Pistachio Audio Card Driver

Required properties:

  - compatible : Compatible list, must contain "img,pistachio-audio"

  - clocks : Contains an entry for each entry in clock-names

  - clock-names : Includes the following entries:
        "audio_pll"  The audio PLL
        "i2s_mclk"   The i2s reference clock
                     Also connected to i2s_out_0_mclk output
        "dac_mclk"   Dac reference clock. Connected to i2s_dac_clk output

  - img,cr-periph : phandle of the peripheral control syscon
                    node which contains the i2s loopback control registers

Optional properties:

  - img,widgets : Please refer to widgets.txt

  - img,routing : A list of the connections between audio components

  - img,mute-gpio : phandle of the mute gpio

  - img,hp-det-gpio : phandle of the headphone detect gpio

  - img,i2s-clk-loopback : When present, the frame and bit clock signals for
			   the i2s out and i2s in controllers will be connected
			   internally

Optional subnodes:

  - spdif-out : Contains spdif out information

  - spdif-in : Contains spdif in information

  - parallel-out : Contains parallel out information

  - i2s-out : Contains i2s out information

  - i2s-in : Contains i2s in information

Required spdif-out, spdif-in subnode properties:

  - cpu-dai : phandle of spdif cpu dai

Required parallel-out subnode properties:

  - cpu-dai : phandle of parallel out cpu dai

  - sound-dai : phandle of internal dac

Required i2s-out, i2s-in subnode properties:

  - cpu-dai : phandle of i2s cpu dai

  - format : i2s format. "i2s" and "left_j" are supported by
	     the Pistachio iteration of the i2s controllers

Optional i2s-out, i2s-in subnode properties:

  - bitclock-inversion : i2s bit clock inversion

  - frame-inversion : i2s frame clock inversion

  - continuous-clock : i2s bit and frame clock always active

Optional i2s-out, i2s-in subnodes:

  - <codec-name> : Contains codec information. <codec-name> will be used as
		   the prefix for the codec. This name must be unique for
		   each individual codec (unique codec device node), and
		   cannot be equal to "internal-dac", "i2s-out" or "i2s-in".
		   The name should be short to avoid control name truncation

Optional <codec-name> subnode properties:

  - mclk : Contains the mclk (master clock) used by the DAC/ADC. If no mclk
	   is required, or the mclk is provided externally, with no software
	   intervention required to compenstate for differing sample rates,
	   this can be omitted.
	   Valid identifiers (dt-bindings/sound/pistachio-audio.h):

	       PISTACHIO_MCLK_I2S       mclk is provided by the i2s_out_0_mclk
					output from Pistachio SoC. This clock
					is shared with the internal i2s out
					controller

	       PISTACHIO_MCLK_DAC	mclk is provided by the i2s_dac_clk
					output from Pistachio SoC

  - sound-dai : phandle of the codec. If the codec does not accept/require
		software configuration, this can be omitted

  - mclk-index : Index of the mclk, used for snd_soc_dai_set_sysclk call.
		 0 is used if this property is omitted

  - frame-master : Indicates this codec is the frame clock master

  - bitclock-master : Indicates this codec is the bit clock master

  frame-master and bitclock-master cannot exist in more than one of the codec
  subnodes

  frame-master and bitclock-master cannot be used within i2s out codec subnodes
  as the Pistachio iteration of the i2s out controller accepts master mode
  only

  frame-master and bitclock-master can be omitted if img,i2s-clk-loopback is
  used, or if frame/bit clock generation does not require software intervention
  (eg a codec operating in hardware-mode)

Required <codec-name> subnode properties if mclk property is present:

  - mclk-fs : Contains the set of fs ratios the DAC/ADC accepts (Nfs for
	      sample rate r specifies the master clock input to the DAC is
	      N times r). It is assumed this set of ratios is applicable to
	      any given sample rate where this does not lead to a violation
	      of the minimum/maximum frequencies specified by mclk-min-fs-freq
	      and mclk-max-fs-freq respectively

  - mclk-min-fs-freq : Contains the minimum frequency the DAC/ADC accepts for
		       the mclk-fs list above

  - mclk-max-fs-freq : Contains the maximum frequency the DAC/ADC accepts for
		       the mclk-fs list above

  - mclk-max-freq : Contains the maximum frequency for the DAC/ADC. Must be
		    greater than or equal to mclk-max-fs-freq


Example 1:

All audio components present on board. 2x pcm3168a codecs provide 3 i2s in
and out channels each. dac_mclk provides the single master clock to both
codecs. The Pistachio i2s out controller is the frame + bit clock master for
the DAC path. The second pcm3168a codec is the frame + bit clock master for
the ADC path. GPIO 1 in bank 5 is used as a mute control (active low). GPIO 3
in bank 5 is used for headphone detect control (active high)

pistachio_audio_card {
	compatible = "img,pistachio-audio";

	clocks = <&clk_core CLK_AUDIO_PLL>,
		 <&clk_core CLK_I2S>,
		 <&clk_core CLK_AUDIO>;
	clock-names = "audio_pll", "i2s_mclk", "dac_mclk";

	img,cr-periph = <&cr_periph>;

	img,mute-gpio = <&gpio5 1 GPIO_ACTIVE_LOW>;
	img,hp-det-gpio = <&gpio5 3 GPIO_ACTIVE_HIGH>;

	img,widgets = "Headphone", "Headphones",
		      "Speaker", "Speakers";

	img,routing = "Headphones", "internal-dac AOUTL",
		      "Headphones", "internal-dac AOUTR",
		      "Speakers", "internal-dac AOUTL",
		      "Speakers", "internal-dac AOUTR";

	spdif-out {
		cpu-dai = <&spdif_out>;
	};

	spdif-in {
		cpu-dai = <&spdif_in>;
	};

	parallel-out {
		cpu-dai = <&parallel_out>;
		sound-dai = <&internal_dac>;
	};

	i2s-out {
		cpu-dai = <&i2s_out>;
		format = "i2s";

		pcm3168a-1 {
			mclk = <PISTACHIO_MCLK_DAC>;
			mclk-fs = <128 192 256 384 512 768>;
			mclk-min-fs-freq = <2048000>;
			mclk-max-fs-freq = <36864000>;
			mclk-max-freq = <36864000>;
			sound-dai = <&pcm3168a_1 0>;
		};

		pcm3168a-2 {
			mclk = <PISTACHIO_MCLK_DAC>;
			mclk-fs = <128 192 256 384 512 768>;
			mclk-min-fs-freq = <2048000>;
			mclk-max-fs-freq = <36864000>;
			mclk-max-freq = <36864000>;
			sound-dai = <&pcm3168a_2 0>;
		};
	};

	i2s-in {
		cpu-dai = <&i2s_in>;
		format = "i2s";

		pcm3168a-1 {
			mclk = <PISTACHIO_MCLK_DAC>;
			mclk-fs = <256 384 512 768>;
			mclk-min-fs-freq = <2048000>;
			mclk-max-fs-freq = <36864000>;
			mclk-max-freq = <36864000>;
			sound-dai = <&pcm3168a_1 1>;
		};

		pcm3168a-2 {
			mclk = <PISTACHIO_MCLK_DAC>;
			mclk-fs = <256 384 512 768>;
			mclk-min-fs-freq = <2048000>;
			mclk-max-fs-freq = <36864000>;
			mclk-max-freq = <36864000>;
			sound-dai = <&pcm3168a_2 1>;
			frame-master;
			bitclock-master;
		};
	};
};

Example 2:

i2s out, i2s in present on board. pcm5101 codec provides 1 i2s out channel.
pcm1802 codec provides 1 i2s in channel. dac_mclk provides master clock to
pcm1802. i2s_mclk provides master clock to pcm5101. Both codecs set to operate
in hardware mode. The Pistachio i2s out controller is the frame + bit clock
master for the DAC path. The pcm1802 codec is the frame + bit clock master for
the ADC path

pistachio_audio_card {
	compatible = "img,pistachio-audio";

	clocks = <&clk_core CLK_AUDIO_PLL>,
		 <&clk_core CLK_I2S>,
		 <&clk_core CLK_AUDIO>;
	clock-names = "audio_pll", "i2s_mclk", "dac_mclk";

	img,cr-periph = <&cr_periph>;

	pinctrl-names = "default";
	pinctrl-0 = <&dac_clk_pin>, <&i2s_mclk_pin>;

	i2s-out {
		cpu-dai = <&i2s_out>;
		format = "i2s";

		pcm5101 {
			mclk = <PISTACHIO_MCLK_I2S>;
			mclk-fs = <128 192 256 384 512 768 1024 1152 1536 2048 3072>;
			mclk-min-fs-freq = <1024000>;
			mclk-max-fs-freq = <49152000>;
			mclk-max-freq = <49152000>;
		};
	};

	i2s-in {
		cpu-dai = <&i2s_in>;
		format = "i2s";

		pcm1802 {
			mclk = <PISTACHIO_MCLK_DAC>;
			mclk-fs = <256>;
			mclk-min-fs-freq = <8192000>;
			mclk-max-fs-freq = <49152000>;
			mclk-max-freq = <49152000>;
		};
	};
};

Example 3:

i2s out, i2s in present on board. dac provides 1 i2s out channel.
microphone array provides 6 i2s in channels. No master clocks are required.
The Pistachio i2s out controller is the frame + bit clock master
for the DAC and microphone array paths.

pistachio_audio_card {
	compatible = "img,pistachio-audio";

	clocks = <&clk_core CLK_AUDIO_PLL>,
		 <&clk_core CLK_I2S>,
		 <&clk_core CLK_AUDIO>;
	clock-names = "audio_pll", "i2s_mclk", "dac_mclk";

	img,cr-periph = <&cr_periph>;

	img,i2s-clk-loopback;

	i2s-out {
		cpu-dai = <&i2s_out>;
		format = "i2s";
		bitclock-inversion;

		dac {
			sound-dai = <&simple-dac>;
		};
	};

	i2s-in {
		cpu-dai = <&i2s_in>;
		format = "left_j";
		frame-inversion;
	};
};
```

## Documentation/devicetree/bindings/sound/imx-audio-cs427x.txt
```
Freescale i.MX audio complex with CS4271 or CS4272 codec

Required properties:

  - compatible		: "fsl,imx-audio-cs427x"

  - model		: The user-visible name of this sound complex

  - ssi-controller	: The phandle of the i.MX SSI controller

  - audio-codec	: The phandle of the CS4271 audio codec

  - audio-routing	: A list of the connections between audio components.
			  Each entry is a pair of strings, the first being the
			  connection's sink, the second being the connection's
			  source. Valid names could be power supplies, CS427x
			  pins, and the jacks on the board:

			  Board connectors:
			   * Mic Jack
			   * Headphone Jack

  - mux-int-port	: The internal port of the i.MX audio muxer (AUDMUX)

  - mux-ext-port	: The external port of the i.MX audio muxer

Note: The AUDMUX port numbering should start at 1, which is consistent with
hardware manual.

Example:

sound {
	compatible = "fsl,imx6-rex-cs427x",
		"fsl,imx-audio-cs427x";
	model = "audio-cs427x";
	ssi-controller = <&ssi1>;
	audio-codec = <&cs4271>;
	audio-routing =
		"Mic Jack", "AINA",
		"Mic Jack", "AINB",
		"Headphone Jack", "AOUTA+",
		"Headphone Jack", "AOUTA-",
		"Headphone Jack", "AOUTB+",
		"Headphone Jack", "AOUTB-";
	mux-int-port = <1>;
	mux-ext-port = <3>;
};
```

## Documentation/devicetree/bindings/sound/imx-audio-wm8958.txt
```
Freescale i.MX audio complex with WM8958 codec

Required properties:

  - compatible		   : "fsl,imx-audio-wm8958"

  - model		   : The user-visible name of this sound complex

  - audio-codec            : The phandle of the WM8958 audio codec

  - audio-routing	   : A list of the connections between audio components.
			     Each entry is a pair of strings, the first being
			     the connection's sink, the second being the
			     connection's source. Valid names could be power
			     supplies, WM8958 pins, and the jacks on the board:

			     Power supplies:
			      * MICBIAS1
			      * MICBIAS2

			     Board connectors:
			      * Headphone Jack
			      * Ext Spk

Optional properties:

 - cpu-dai1		   : The phandle of CPU DAI1 controller, which is for
			     aif1 of wm8958. At least one cpu dai is required.

 - cpu-dai2                : The phandle of CPU DAI2 controller, which is for
			     aif2 of wm8958. At least one cpu dai is required.

 - cpu-dai3                : The phandle of CPU DAI3 controller, which is for
			     aif3 of wm8958. At least one cpu dai is required.

 - dai-link1-name	   : If present, set the dai link1 name and stream name
			     to the specific strings. Otherwise, set the dai
			     link1 name and stream name to "AIF1-DAI".

 - dai-link2-name	   : If present, set the dai link2 name and stream name
			     to the specific strings. Otherwise, set the dai
			     link2 name and stream name to "AIF2-DAI".

 - dai-link3-name          : If present, set the dai link3 name and stream name
			     to the specific strings. Otherwise, set the dai
			     link3 name and stream name to "AIF3-DAI".

 - fsl,cpu-dai1-master   : If present, cpu dai1 works as master, and will
			   provide bit clock and frame clock. Otherwise,
			   cpu dai1 works as slave.

Example:

sound {
		compatible = "fsl,imx6ul-ddr3-arm2-wm8958",
			   "fsl,imx-audio-wm8958";
		model = "wm8958-audio";
		cpu-dai1 = <&sai1>;
		dai-link1-name = "Hifi";
		audio-codec = <&codec>;
		audio-routing =
			"Headphone Jack", "HPOUT1L",
			"Headphone Jack", "HPOUT1R",
			"Ext Spk", "SPKOUTLP",
			"Ext Spk", "SPKOUTLN",
			"Ext Spk", "SPKOUTRP",
			"Ext Spk", "SPKOUTRN",
			"IN1LN", "MICBIAS2";
};
```

## Documentation/devicetree/bindings/sound/marvell,pxa2xx-ac97.txt
```
Marvell PXA2xx audio complex

This descriptions matches the AC97 controller found in pxa2xx and pxa3xx series.

Required properties:
  - compatible: "marvell,pxa2xx-ac97"
  - reg: device MMIO address space
  - interrupts: single interrupt generated by AC97 IP
  - clocks: input clock of the AC97 IP, refer to clock-bindings.txt

Optional properties:
  - pinctrl-names, pinctrl-0: refer to pinctrl-bindings.txt
  - reset-gpio: gpio used for AC97 reset, refer to gpio.txt

Example:
	ac97: sound@40500000 {
	      	compatible = "marvell,pxa2xx-ac97";
		reg = < 0x40500000 0x1000 >;
		interrupts = <14>;
		reset-gpio = <&gpio 113 GPIO_ACTIVE_HIGH>;
		#sound-dai-cells = <1>;
		pinctrl-names = "default";
		pinctrl-0 = < &pmux_ac97_default >;
		status = "okay";
	};
```

## Documentation/devicetree/bindings/sound/max98373.txt
```
Maxim Integrated MAX98373 Speaker Amplifier

This device supports I2C.

Required properties:

  - compatible : should be one of the following
    - "maxim,max98373"

  - reg : the I2C address of the device.

Optional properties:

  - maxim,vmon-slot-no : slot number used to send voltage information
                   or in inteleave mode this will be used as
                   interleave slot.
                   slot range : 0 ~ 15,  Default : 0

  - maxim,imon-slot-no : slot number used to send current information
                   slot range : 0 ~ 15,  Default : 0

  - maxim,spkfb-slot-no : slot number used to send speaker feedback information
                   slot range : 0 ~ 15,  Default : 0

  - maxim,interleave-mode : When using two MAX98373 in a system it is
                   possible to create ADC data that that will
                   overflow the frame size. Digital Audio Interleave
                   mode provides a means to output VMON and IMON data
                   from two devices on a single DOUT line when running
                   smaller frames sizes such as 32 BCLKS per LRCLK or
                   48 BCLKS per LRCLK.
                   Range : 0 (off), 1 (on),  Default : 0

Example:

codec: max98373@31 {
   compatible = "maxim,max98373";
   reg = <0x31>;
   maxim,vmon-slot-no = <0>;
   maxim,imon-slot-no = <1>;
   maxim,spkfb-slot-no = <2>;
   maxim,interleave-mode = <0>;
};
```
