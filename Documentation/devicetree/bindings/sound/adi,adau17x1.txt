## Documentation/devicetree/bindings/sound/adi,adau17x1.txt
```
Analog Devices ADAU1361/ADAU1461/ADAU1761/ADAU1961/ADAU1381/ADAU1781

Required properties:

 - compatible:		Should contain one of the following:
			"adi,adau1361"
			"adi,adau1461"
			"adi,adau1761"
			"adi,adau1961"
			"adi,adau1381"
			"adi,adau1781"
 - reg:			The i2c address. Value depends on the state of ADDR0
			and ADDR1, as wired in hardware.

Optional properties:

 - input-differential	bool to set if the input is differential
 - digital-microphone	bool to set if there is a digital microphone connected
			to the digmic/jackdet pin.
 - micbias-vg		Microphone bias voltage
	MICBIAS_0_90_AVDD - 0.9 * AVDD
	MICBIAS_0_65_AVDD - 0.65 * AVDD

Optional properties (ADAU1361/ADAU1461/ADAU1761/ADAU1961 only)

 - jack-detection	If present, configures codec to use the digmic/jackdet
			pin for jack detection. must provide one of
			JACKDETECT_ACTIVE_LO or JACKDETECT_ACTIVE_HI followed
			by debounce time in ms, which must be 5, 10, 20, or 40.

 - lineout-mode		Set output mode of the lineout pins.
 - headphone-mode	Set output mode of the headphone pins.

The output mode must be one of:
	OUTPUT_MODE_HEADPHONE           - Headphone output
	OUTPUT_MODE_HEADPHONE_CAPLESS   - Capless headphone output
	OUTPUT_MODE_LINE                - Line output



Example:
#include <dt-bindings/sound/adau17x1.h>

	i2c_bus {
		adau1361@38 {
			compatible = "adi,adau1361";
			reg = <0x38>;
			input-differential;
			jack-detection = <JACKDETECT_ACTIVE_LO 40>;
			lineout-mode = <OUTPUT_MODE_LINE>;
			headphone-mode = <OUTPUT_MODE_HEADPHONE>;
			micbias-vg = <MICBIAS_0_90_AVDD>;
		};
	};
```

## Documentation/devicetree/bindings/sound/adi,ssm2602.txt
```
Analog Devices SSM2602, SSM2603 and SSM2604 I2S audio CODEC devices

SSM2602 support both I2C and SPI as the configuration interface,
the selection is made by the MODE strap-in pin.
SSM2603 and SSM2604 only support I2C as the configuration interface.

Required properties:

  - compatible : One of "adi,ssm2602", "adi,ssm2603" or "adi,ssm2604"

  - reg : the I2C address of the device for I2C, the chip select
          number for SPI.

Optional properties:

  - startup-delay-us : delay between powering on and activating the digital
                       core, determined by the decoupling capacitor C on the
		       VMID pin: delay [µs] = C [µF] * 25000 / 3.5

 Example:

	ssm2602: ssm2602@1a {
		compatible = "adi,ssm2602";
		reg = <0x1a>;
		startup-delay-us = <34000>; /* 4.7 µF * 25000 / 3.5 -> ~34 ms */
	};
```

## Documentation/devicetree/bindings/sound/ak4613.txt
```
AK4613 I2C transmitter

This device supports I2C mode only.

Required properties:

- compatible : "asahi-kasei,ak4613"
- reg : The chip select number on the I2C bus

Optional properties:
- in1-single-end	: Boolean. Indicate input / output pins are single-ended.
- in2-single-end	  rather than differential.
- out1-single-end
- out2-single-end
- out3-single-end
- out4-single-end
- out5-single-end
- out6-single-end

Example:

&i2c {
	ak4613: ak4613@0x10 {
		compatible = "asahi-kasei,ak4613";
		reg = <0x10>;
	};
};
```

## Documentation/devicetree/bindings/sound/cs35l33.txt
```
CS35L33 Speaker Amplifier

Required properties:

  - compatible : "cirrus,cs35l33"

  - reg : the I2C address of the device for I2C

  - VA-supply, VP-supply : power supplies for the device,
    as covered in
    Documentation/devicetree/bindings/regulator/regulator.txt.

Optional properties:

  - reset-gpios : gpio used to reset the amplifier

  - interrupt-parent : Specifies the phandle of the interrupt controller to
    which the IRQs from CS35L33 are delivered to.
 -  interrupts : IRQ line info CS35L33.
    (See Documentation/devicetree/bindings/interrupt-controller/interrupts.txt
    for further information relating to interrupt properties)

  - boost-ctl : Booster voltage use to supply the amp. If the value is
    0, then VBST = VP. If greater than 0, the boost voltage will be 3300mV with
    a value of 1 and will increase at a step size of 100mV until a maximum of
    8000mV.

  - ramp-rate : On power up, it affects the time from when the power
    up sequence begins to the time the audio reaches a full-scale output.
    On power down, it affects the time from when the power-down sequence
    begins to when the amplifier disables the PWM outputs. If this property
    is not set then soft ramping will be disabled and ramp time would be
    20ms. If this property is set to 0,1,2,3 then ramp times would be 40ms,
    60ms,100ms,175ms respectively for 48KHz sample rate.

  - boost-ipk : The maximum current allowed for the boost converter.
    The range starts at 1850mA (0xF0) and goes to a maximum of 3600mA (0xE0)
    with a step size of 15.625mA. The default is 2500mA (0x90).

  - hg-algo : Parameters for internal Class H/G algorithm that
    controls the amplifier supplies.

  - mem-depth : Memory depth for the Class H/G algorithm measured in LRCLK
    cycles. If this property is set to 0, 1, 2, or 3 then the memory depths
    will be 1, 4, 8, 16 LRCLK cycles.  The default is 16 LRCLK cycles.

    release-rate : The number of consecutive LRCLK periods before allowing
    release condition tracking updates. The number of LRCLK periods start
    at 3 to a maximum of 255.

  - ldo-thld : Configures the signal threshold at which the PWM output stage
    enters LDO operation. Starts as a default value of 50mV for a value of 1
    and increases with a step size of 50mV to a maximum of 750mV (value of
    0xF).

  - ldo-path-disable : This is a boolean property. If present, the H/G
    algorithm uses the max detection path.  If not present, the LDO
    detection path is used.

  - ldo-entry-delay : The LDO entry delay in milliseconds before the H/G
    algorithm switches to the LDO voltage.  This property can be set to values
    from 0 to 7 for delays of 5ms, 10ms, 50ms, 100ms, 200ms, 500ms, 1000ms.
    The default is 100ms.

  - vp-hg-auto : This is a boolean property.  When set, class H/G VPhg
    automatic updating is enabled.

  - vp-hg :  Class H/G algorithm VPhg.  Controls the H/G algorithm's
    reference to the VP voltage for when to start generating a boosted VBST.
    The reference voltage starts at 3000mV with a value of 0x3 and is increased
    by 100mV per step to a maximum of 5500mV.

  - vp-hg-rate : The rate (number of LRCLK periods) at which the VPhg is
    allowed to increase to a higher voltage when using VPhg automatic
    tracking. This property can be set to values from 0 to 3 with rates of 128
    periods, 2048 periods, 32768 periods, and 524288 periods.
    The default is 32768 periods.

  - vp-hg-va : VA calculation reference for automatic VPhg tracking using VPMON.
    This property can be set to values from 0 to 6 starting at 1800mV with a
    step size of 50mV up to a maximum value of 1750mV.  Default is 1800mV.


Example:

cs35l33: cs35l33@40 {
	compatible = "cirrus,cs35l33";
	reg = <0x40>;

	VA-supply = <&ldo5_reg>;
	VP-supply = <&ldo5_reg>;

	interrupt-parent = <&gpio8>;
	interrupts = <3 IRQ_TYPE_LEVEL_LOW>;

	reset-gpios = <&cs47l91 34 0>;

	ramp-rate = <0x0>;
	boost-ctl = <0x30>;  /* VBST = 8000mV */
	boost-ipk = <0xE0>; /* 3600mA */

	hg-algo {
		mem-depth = <0x3>;
		release-rate = <0x3>;
		hd-rm = <0xA>;
		ldo-thld = <0x1>;
		ldo-path-disable = <0x0>;
		ldo-entry-delay=<0x4>;
		vp-hg-auto;
		vp-hg=<0xF>;
		vp-hg-rate=<0x2>;
		vp-hg-va=<0x0>;
	};
};
```

## Documentation/devicetree/bindings/sound/cs4341.txt
```
Cirrus Logic CS4341 DT bindings

Required properties:
 - compatible: "cirrus,cs4341a"

For required properties on SPI, please consult
Documentation/devicetree/bindings/spi/spi-bus.txt

Example:
	codec: cs4341@0 {
		#sound-dai-cells = <0>;
		compatible = "cirrus,cs4341a";
		reg = <0>;
		spi-max-frequency = <6000000>;
	};
```

## Documentation/devicetree/bindings/sound/cs53l30.txt
```
CS53L30 audio CODEC

Required properties:

  - compatible : "cirrus,cs53l30"

  - reg : the I2C address of the device

Optional properties:

  - reset-gpios : a GPIO spec for the reset pin.


Example:

codec: cs53l30@48 {
        compatible = "cirrus,cs53l30";
        reg = <0x48>;
        reset-gpios = <&gpio 54 0>;
};
```

## Documentation/devicetree/bindings/sound/davinci-mcbsp-audio.txt
```
Texas Instruments DaVinci McBSP module
~~~~~~~~~~~~~~~~~~~~~~~~~~~~~~~~~~~~~~

This binding describes the "Multi-channel Buffered Serial Port" (McBSP)
audio interface found in some TI DaVinci processors like e.g. the DA850,
DM6446, DA355.


Required properties:
~~~~~~~~~~~~~~~~~~~~
- compatible : "ti,da850-mcbsp-audio"

- reg : physical base address and length of the controller memory mapped
        region(s).
- reg-names : Should contain:
         * "mpu" for the main registers (required). For compatibility with
           existing software, it is recommended this is the first entry.
         * "dat" for the data FIFO (optional).

- dmas: two element list of DMA controller phandles and DMA request line
        ordered pairs.
- dma-names: identifier string for each DMA request line in the dmas property.
	     These strings correspond 1:1 with the ordered pairs in dmas. The dma
	     identifiers must be "rx" and "tx".

Optional properties:
~~~~~~~~~~~~~~~~~~~~
- interrupts : Interrupt numbers for McBSP
- interrupt-names : Known interrupt names are "rx" and "tx"

- pinctrl-0: Should specify pin control group used for this controller.
- pinctrl-names: Should contain only one value - "default", for more details
  		 please refer to pinctrl-bindings.txt

- channel-combine : boolean. If present L and R channels are combined into one
		DMA transfer, however the labelling of the channels is swapped.
		Therefore this option should be used only if the channels can
		be swapped back at the codec side again.

Example (AM1808):
~~~~~~~~~~~~~~~~~

mcbsp0: mcbsp@1d10000 {
	compatible = "ti,davinci-mcbsp-audio";
	pinctrl-names = "default";
	pinctrl-0 = <&mcbsp0_pins>;

	reg = 	<0x00110000 0x1000>,
		<0x00310000 0x1000>;
	reg-names = "mpu", "dat";
	interrupts = <97 98>;
	interrupts-names = "rx", "tx";
	dmas = <&edma0 3
		&edma0 2>;
	dma-names = "tx", "rx";
	status = "okay";
};
```

## Documentation/devicetree/bindings/sound/designware-i2s.txt
```
DesignWare I2S controller

Required properties:
 - compatible : Must be "snps,designware-i2s"
 - reg : Must contain the I2S core's registers location and length
 - interrupts: <IRQ> where IRQ is the interrupt number.
 - clocks : Pairs of phandle and specifier referencing the controller's
   clocks. The controller expects one clock: the clock used as the sampling
   rate reference clock sample.
 - clock-names : "i2sclk" for the sample rate reference clock.

Optional properties:
 - dmas: Pairs of phandle and specifier for the DMA channels that are used by
   the core. The core expects one or two dma channels: one for transmit and
   one for receive. Set this parameter if the I2S DMA block is enabled.
 - dma-names : "tx" for the transmit channel, "rx" for the receive channel. Set
   this parameter if the I2S DMA block is enabled.

For more details on the 'dma', 'dma-names', 'clock' and 'clock-names'
properties please check:
	* resource-names.txt
	* clock/clock-bindings.txt
	* dma/dma.txt

Example:

	soc_i2s: i2s@7ff90000 {
		compatible = "snps,designware-i2s";
		reg = <0x0 0x7ff90000 0x0 0x1000>;
		interrupts = <15>;
		clocks = <&scpi_i2sclk 0>;
		clock-names = "i2sclk";
		#sound-dai-cells = <0>;
		dmas = <&dma0 5>;
		dma-names = "tx";
	};
```

## Documentation/devicetree/bindings/sound/dmic.txt
```
Device-Tree bindings for dmic codec

Required properties:
	- compatible: should be "dmic-codec".

Example node:

	dmic_audio: dmic_audio@0 {
		compatible = "dmic-codec";
		status = "okay";
	};
```

## Documentation/devicetree/bindings/sound/everest,es7134.txt
```
ES7134 i2s DA converter

Required properties:
- compatible : "everest,es7134" or
               "everest,es7144" or
	       "everest,es7154"

Optional properties:
- VDD-supply: regulator phandle for the VDD supply
- AVDD-supply: regulator phandle for the AVDD supply

Example:

i2s_codec: external-codec {
	compatible = "everest,es7134";
};
```

## Documentation/devicetree/bindings/sound/everest,es7241.txt
```
ES7134 i2s DA converter

Required properties:
- compatible : "everest,es7241"

Optional properties:
- VDDP-supply: regulator phandle for the VDDA supply
- VDDA-supply: regulator phandle for the VDDP supply
- VDDD-supply: regulator phandle for the VDDD supply
- reset-gpios: gpio connected to the reset pin
- m0-gpios   : gpio connected to the m0 pin
- m1-gpios   : gpio connected to the m1 pin

Example:

linein: audio-codec@2 {
	#sound-dai-cells = <0>;
	compatible = "everest,es7241";
	VDDA-supply = <&vcc_3v3>;
	VDDP-supply = <&vcc_3v3>;
	VDDD-supply = <&vcc_3v3>;
	reset-gpios = <&gpio GPIOH_42>;
};
```
