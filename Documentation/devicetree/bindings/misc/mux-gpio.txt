## Documentation/devicetree/bindings/mtd/gpio-addr-flash.txt
```
Memory Mapped flash with some address lines addressed using GPIOs

Handle the case where a flash device is mostly addressed using physical
line and supplemented by GPIOs.  This way you can hook up say a 8MiB flash
to a 2MiB memory range and use the GPIOs to select a particular range.

 - compatible : "cfi-gpio-addr-flash"
 - reg : Address range of the mtd chip that is memory mapped, this is,
   on the previous example 2MiB.
 - bank-width : Width (in bytes) of the bank.  Equal to the
   device width times the number of interleaved chips.
 - probe-type : (optional) "cfi_probe", "jedec_probe". How the mtd chip
   is going to be probed. If omitted, assumed to be equal to "cfi_probe".
 - #address-cells, #size-cells : Must be present if the device has
   sub-nodes representing partitions (see below).  In this case
   both #address-cells and #size-cells must be equal to 1.

The device tree may optionally contain sub-nodes describing partitions of the
address space. See partition.txt for more detail.

Example:

	cfi_flash_0: cfi_flash {
		#address-cells = <1>;
		#size-cells = <1>;
		compatible = "cfi-gpio-addr-flash";
		bank-width = <2>;
		reg = < 0x00300000 0x00200000 >;
		gpios = <&gpio_0 3 0>, <&gpio_0 4 0>;
		partition@0 {
			reg = < 0x0 0x200000 >;
			label = "Golden Bitstream";
		};
		partition@200000 {
			reg = < 0x200000 0x200000 >;
			label = "User Bitstream";
		};
		partition@400000 {
			reg = < 0x400000 0x200000 >;
			label = "V4L Controls";
		};
		partition@600000 {
			reg = < 0x600000 0x200000 >;
			label = "Production Data";
		};
	} ;
```

## Documentation/devicetree/bindings/mtd/gpmi-nand.txt
```
* Freescale General-Purpose Media Interface (GPMI)

The GPMI nand controller provides an interface to control the
NAND flash chips.

Required properties:
  - compatible : should be "fsl,<chip>-gpmi-nand", the chip should be imx23,
    imx28, imx6q, imx6qp, imx6sx, imx6ul or imx7d.
  - reg : should contain registers location and length for gpmi and bch.
  - reg-names: Should contain the reg names "gpmi-nand" and "bch"
  - interrupts : BCH interrupt number.
  - interrupt-names : Should be "bch".
  - dmas: DMA specifier, consisting of a phandle to DMA controller node
    and GPMI DMA channel ID.
    Refer to dma.txt and fsl-mxs-dma.txt for details.
  - dma-names: Must be "rx-tx".
  - clocks : The clocks needed by the gpmi controller. This field varies
    depends on the SoC design, "gpmi-io" is mandatory but some platforms may
    need several extra clocks, such as i.MX6Q, it requires "gpmi_apb,
    gpmi_bch, gpmi_bch_apb and per1_bch" for all submodules. Please refer to
    the HW design manual.
  - clock-names : the name of the clocks, please refer to the HW design
    manual.

Optional properties:
  - nand-on-flash-bbt: boolean to enable on flash bbt option if not
                       present false
  - fsl,use-minimum-ecc: Protect this NAND flash with the minimum ECC
                       strength required. The required ECC strength is
                       automatically discoverable for some flash
                       (e.g., according to the ONFI standard).
                       However, note that if this strength is not
                       discoverable or this property is not enabled,
                       the software may chooses an implementation-defined
                       ECC scheme.
  - fsl,no-blockmark-swap: Don't swap the bad block marker from the OOB
                       area with the byte in the data area but rely on the
                       flash based BBT for identifying bad blocks.
                       NOTE: this is only valid in conjunction with
                             'nand-on-flash-bbt'.
                       WARNING: on i.MX28 blockmark swapping cannot be
                       disabled for the BootROM in the FCB. Thus,
                       partitions written from Linux with this feature
                       turned on may not be accessible by the BootROM
                       code.

The device tree may optionally contain sub-nodes describing partitions of the
address space. See partition.txt for more detail.

Examples:

gpmi-nand@8000c000 {
	compatible = "fsl,imx28-gpmi-nand";
	#address-cells = <1>;
	#size-cells = <1>;
	reg = <0x8000c000 2000>, <0x8000a000 2000>;
	reg-names = "gpmi-nand", "bch";
	interrupts = <41>;
	interrupt-names = "bch";
	dmas = <&dma_apbh 4>;
	dma-names = "rx-tx";
	clocks = <&clks 50>,;
	clock-names = "gpmi_io";

	partition@0 {
	...
	};
};
```

## Documentation/devicetree/bindings/mtd/icpdas-lp8841-sram.txt
```
512kB battery backed up SRAM on ICP DAS LP-8841 industrial computers

LP-8441, LP-8141, and LP-8041 differ from LP-8841 only in expansion
slot count.

Required properties:
- compatible : should be "icpdas,lp8841-sram"

- reg: physical base addresses and region lengths of
       * IO memory range
       * SRAM page selector

SRAM chip is connected via FPGA and is not accessible without a driver,
unlike flash memory which is wired to CPU MMU. Driver is essentially
an address translation routine.

Example:

	sram@a000 {
		compatible = "icpdas,lp8841-sram";
		reg = <0xa000 0x1000
		       0x901e 0x1>;
	};
```

## Documentation/devicetree/bindings/mtd/mtk-quadspi.txt
```
* MTD SPI nor driver for MTK MT81xx (and similar) serial flash controller

Required properties:
- compatible: 	  should be "mediatek,mt8173-nor";
- reg: 		  physical base address and length of the controller's register
- clocks: 	  the phandle of the clock needed by the nor controller
- clock-names: 	  the name of the clocks
		  the clocks needed "spi" and "sf". "spi" is used for spi bus,
		  and "sf" is used for controller, these are the clocks witch
		  hardware needs to enabling nor flash and nor flash controller.
		  See Documentation/devicetree/bindings/clock/clock-bindings.txt for details.
- #address-cells: should be <1>
- #size-cells:	  should be <0>

Example:

nor_flash: spi@1100d000 {
	compatible = "mediatek,mt8173-nor";
	reg = <0 0x1100d000 0 0xe0>;
	clocks = <&pericfg CLK_PERI_SPI>,
		 <&topckgen CLK_TOP_SPINFI_IFR_SEL>;
	clock-names = "spi", "sf";
	#address-cells = <1>;
	#size-cells = <0>;

	flash@0 {
		....
	};
};
```

## Documentation/devicetree/bindings/mtd/ngpmb-nvram.txt
```
Non Volatile RAM device on a Juniper NG PMB FPGA

These devices are found in the PTX series of Juniper routers.

Required properties:
- compatible : must be "jnx,ngpmb-nvram"

Optional properties:
- reg : memory address for the RAM, note that this is not
required since usually the device is a subdevice of the SAM MFD
driver which fills in the register fields.

For the rest of the properties, see mtd-physmap.txt.

The device tree may optionally contain sub-nodes describing partitions of the
address space. See partition.txt for more detail.

Example:

ngpmb_nvram {
	compatible = "jnx,ngpmb-nvram";
};
```

## Documentation/devicetree/bindings/mtd/nvidia,tegra20-nand.txt
```
NVIDIA Tegra NAND Flash controller

Required properties:
- compatible: Must be one of:
  - "nvidia,tegra20-nand"
- reg: MMIO address range
- interrupts: interrupt output of the NFC controller
- clocks: Must contain an entry for each entry in clock-names.
  See ../clocks/clock-bindings.txt for details.
- clock-names: Must include the following entries:
  - nand
- resets: Must contain an entry for each entry in reset-names.
  See ../reset/reset.txt for details.
- reset-names: Must include the following entries:
  - nand

Optional children nodes:
Individual NAND chips are children of the NAND controller node. Currently
only one NAND chip supported.

Required children node properties:
- reg: An integer ranging from 1 to 6 representing the CS line to use.

Optional children node properties:
- nand-ecc-mode: String, operation mode of the NAND ecc mode. "hw" by default
- nand-ecc-algo: string, algorithm of NAND ECC.
		 Supported values are: "rs", "bch".
- nand-bus-width : 8 or 16 bus width if not present 8
- nand-on-flash-bbt: boolean to enable on flash bbt option if not present false
- nand-ecc-strength: integer representing the number of bits to correct
		     per ECC step. Supported strength using HW ECC modes are:
		     - RS: 4, 6, 8
		     - BCH: 4, 8, 14, 16
- nand-ecc-step-size: integer representing the number of data bytes
		      that are covered by a single ECC step. Must be 512.
- wp-gpios: GPIO specifier for the write protect pin.

Optional child node of NAND chip nodes:
Partitions: see partition.txt

  Example:
	nand@70008000 {
		compatible = "nvidia,tegra20-nand";
		reg = <0x70008000 0x100>;
		interrupts = <GIC_SPI 24 IRQ_TYPE_LEVEL_HIGH>;
		clocks = <&tegra_car TEGRA20_CLK_NDFLASH>;
		clock-names = "nand";
		resets = <&tegra_car 13>;
		reset-names = "nand";

		nand-chip@0 {
			reg = <0>;
			#address-cells = <1>;
			#size-cells = <1>;
			nand-bus-width = <8>;
			nand-on-flash-bbt;
			nand-ecc-algo = "bch";
			nand-ecc-step-size = <512>;
			nand-ecc-strength = <8>;
			wp-gpios = <&gpio TEGRA_GPIO(S, 0) GPIO_ACTIVE_LOW>;
		};
	};
```

## Documentation/devicetree/bindings/mtd/otp-nvmem.txt
```
Representing OTP regions in devicetree

OTP regions can be represented by sub-nodes of an mtd device.

The partition table should be a subnode of the mtd node and should be names
'otp-partitions'. This node should have the following property:

- compatible: (required) must be 'fixed-partitions'

OTP regions are then defined in subnodes of the partitions node.

Required properties for OTP regions:
- reg: The region's offset and size within the mtd device

Optional properties:
- label: The label / name for this region. If ommited, the label is taken
  from the node name (excluding the unit address).

Example:

flash@0 {
	partitions {
		compatible = "fixed-partitions";
		#address-cells = <1>;
		#size-cells = <1>;

		partition@0 {
			label = "uboot-spl";
			reg = <0x0 0xe0000>;
		};
		partition@1 {
			label = "uboot-env";
			reg = <0xe0000 0x20000>;
		};
		partition@2 {
			label = "uboot";
			reg = <0x100000 0x100000>;
		};
	};

	otp-partitions {
		compatible = "fixed-partitions";
		#address-cells = <1>;
		#size-cells = <1>;

		region@0 {
			label = "factory-data";
			reg = <0x0 0x40>;

			#address-cells = <0x1>;
			#size-cells = <0x1>;

			product: nvmem@0 {
				reg = <0x0 0x2>;
			};

			revision: nvmem@3 {
				reg = <0x3 0x2>;
			};
		};
	};
}
```

## Documentation/devicetree/bindings/mtd/oxnas-nand.txt
```
* Oxford Semiconductor OXNAS NAND Controller

Please refer to nand.txt for generic information regarding MTD NAND bindings.

Required properties:
 - compatible: "oxsemi,ox820-nand"
 - reg: Base address and length for NAND mapped memory.

Optional Properties:
 - clocks: phandle to the NAND gate clock if needed.
 - resets: phandle to the NAND reset control if needed.

Example:

nand: nand@41000000 {
	compatible = "oxsemi,ox820-nand";
	reg = <0x41000000 0x100000>;
	nand-ecc-mode = "soft";
	clocks = <&stdclk CLK_820_NAND>;
	resets = <&reset RESET_NAND>;
	#address-cells = <1>;
	#size-cells = <1>;
	status = "disabled";
};
```

## Documentation/devicetree/bindings/mtd/samsung-s3c2410.txt
```
* Samsung S3C2410 and compatible NAND flash controller

Required properties:
- compatible : The possible values are:
	"samsung,s3c2410-nand"
	"samsung,s3c2412-nand"
	"samsung,s3c2440-nand"
	"samsung,s3c6400-nand"
- reg : register's location and length.
- #address-cells, #size-cells : see nand.txt
- clocks : phandle to the nand controller clock
- clock-names : must contain "nand"

Optional properties:
- samsung,tacls : time for active CLE/ALE to nWE/nOE
- samsung,twrph0 : active time for nWE/nOE
- samsung,twrph1 : time for release CLE/ALE from nWE/nOE inactive
- samsung,ignore_unset_ecc : boolean to ignore error when we have
                             0xff,0xff,0xff read ECC, on the
                             assumption that it is an un-eccd page

Optional children nodes:
Children nodes representing the available nand chips.

Optional children properties:
- nand-ecc-mode : see nand.txt
- nand-on-flash-bbt : see nand.txt

Each children device node may optionally contain a 'partitions' sub-node,
which further contains sub-nodes describing the flash partition mapping.
See partition.txt for more detail.

Example:

nand@4e000000 {
	compatible = "samsung,s3c2440-nand";
	reg = <0x4e000000 0x40>;

	#address-cells = <1>;
        #size-cells = <0>;

	clocks = <&clocks HCLK_NAND>;
	clock-names = "nand";

	samsung,tacls = <0>;
	samsung,twrph0 = <25>;
	samsung,twrph1 = <15>;
	samsung,ignore_unset_ecc;

	nand@0 {
		nand-ecc-mode = "soft";
		nand-on-flash-bbt;

		partitions {
			compatible = "fixed-partitions";
			#address-cells = <1>;
			#size-cells = <1>;

			partition@0 {
				label = "u-boot";
				reg = <0 0x040000>;
			};

			partition@40000 {
				label = "kernel";
				reg = <0x040000 0x500000>;
			};
		};
	};
};
```

## Documentation/devicetree/bindings/mtd/sram-lp8x4x.txt
```
512kB battery backed up SRAM on LP-8x4x industrial computers

Required properties:
- compatible : should be "icpdas,sram-lp8x4x"

- reg: physical base addresses and region lengths of
       * IO memory range
       * SRAM page selector

SRAM chip is connected via FPGA and is not accessible without a driver,
unlike flash memory which is wired to CPU MMU. Driver is essentially
an address translation routine.

Example:

	sram@a000 {
		compatible = "icpdas,sram-lp8x4x";
		reg = <0xa000 0x1000
		       0x901e 0x1>;
	};
```
