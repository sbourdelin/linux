## Documentation/devicetree/bindings/mmc/octeon-mmc.txt
```
* OCTEON SD/MMC Host Controller

This controller is present on some members of the Cavium OCTEON SoC
family, provide an interface for eMMC, MMC and SD devices.  There is a
single controller that may have several "slots" connected.  These
slots appear as children of the main controller node.
The DMA engine is an integral part of the controller block.

1) MMC node

Required properties:
- compatible : Should be "cavium,octeon-6130-mmc" or "cavium,octeon-7890-mmc"
- reg : Two entries:
	1) The base address of the MMC controller register bank.
	2) The base address of the MMC DMA engine register bank.
- interrupts :
	For "cavium,octeon-6130-mmc": two entries:
	1) The MMC controller interrupt line.
	2) The MMC DMA engine interrupt line.
	For "cavium,octeon-7890-mmc": nine entries:
	1) The next block transfer of a multiblock transfer has completed (BUF_DONE)
	2) Operation completed successfully (CMD_DONE).
	3) DMA transfer completed successfully (DMA_DONE).
	4) Operation encountered an error (CMD_ERR).
	5) DMA transfer encountered an error (DMA_ERR).
	6) Switch operation completed successfully (SWITCH_DONE).
	7) Switch operation encountered an error (SWITCH_ERR).
	8) Internal DMA engine request completion interrupt (DONE).
	9) Internal DMA FIFO underflow (FIFO).
- #address-cells : Must be <1>
- #size-cells : Must be <0>

The node contains child nodes for each slot that the platform uses.

Example:
mmc@1180000002000 {
	compatible = "cavium,octeon-6130-mmc";
	reg = <0x11800 0x00002000 0x0 0x100>,
		<0x11800 0x00000168 0x0 0x20>;
	#address-cells = <1>;
	#size-cells = <0>;
	/* EMM irq, DMA irq */
	interrupts = <1 19>, <0 63>;

	[ child node definitions...]
};


2) Slot nodes
Properties in mmc.txt apply to each slot node that the platform uses.

Required properties:
- reg : The slot number.

Optional properties:
- cavium,cmd-clk-skew : the amount of delay (in pS) past the clock edge
	to sample the command pin.
- cavium,dat-clk-skew : the amount of delay (in pS) past the clock edge
	to sample the data pin.

Example:
	mmc@1180000002000 {
		compatible = "cavium,octeon-6130-mmc";
		reg = <0x11800 0x00002000 0x0 0x100>,
		      <0x11800 0x00000168 0x0 0x20>;
		#address-cells = <1>;
		#size-cells = <0>;
		/* EMM irq, DMA irq */
		interrupts = <1 19>, <0 63>;

		mmc-slot@0 {
			reg = <0>;
			max-frequency = <20000000>;
			bus-width = <8>;
			vmmc-supply = <&reg_vmmc3>;
			cd-gpios = <&gpio 9 0>;
			wp-gpios = <&gpio 10 0>;
		};
	};
```

## Documentation/devicetree/bindings/mmc/samsung,s3cmci.txt
```
* Samsung's S3C24XX MMC/SD/SDIO controller device tree bindings

Samsung's S3C24XX MMC/SD/SDIO controller is used as a connectivity interface
with external MMC, SD and SDIO storage mediums.

This file documents differences between the core mmc properties described by
mmc.txt and the properties used by the Samsung S3C24XX MMC/SD/SDIO controller
implementation.

Required SoC Specific Properties:
- compatible: should be one of the following
  - "samsung,s3c2410-sdi": for controllers compatible with s3c2410
  - "samsung,s3c2412-sdi": for controllers compatible with s3c2412
  - "samsung,s3c2440-sdi": for controllers compatible with s3c2440
- clocks: Should reference the controller clock
- clock-names: Should contain "sdi"

Example:
	mmc0: mmc@5a000000 {
		compatible = "samsung,s3c2440-sdi";
		pinctrl-names = "default";
		pinctrl-0 = <&sdi_pins>;
		reg = <0x5a000000 0x100000>;
		interrupts = <0 0 21 3>;
		clocks = <&clocks PCLK_SDI>;
		clock-names = "sdi";
		bus-width = <4>;
		cd-gpios = <&gpg 8 GPIO_ACTIVE_LOW>;
		wp-gpios = <&gph 8 GPIO_ACTIVE_LOW>;
	};

	Note: This example shows both SoC specific and board specific properties
	in a single device node. The properties can be actually be separated
	into SoC specific node and board specific node.
```

## Documentation/devicetree/bindings/mmc/sdhci-brcmstb.txt
```
* BROADCOM BRCMSTB/BMIPS SDHCI Controller

This file documents differences between the core properties in mmc.txt
and the properties used by the sdhci-brcmstb driver.

Required properties:
- compatible: "brcm,sdhci-brcmstb"

Optional properties:
- broken-sdr50: The Host Controller's SDR50 mode is broken.

Example:

	sdhci@f03e0100 {
		compatible = "brcm,sdhci-brcmstb";
		reg = <0xf03e0000 0x100>;
		interrupts = <0x0 0x26 0x0>;
		interrupt-names = "sdio0_0";
		sdhci,auto-cmd12;
		clocks = <0x13>;
		clock-names = "sw_sdio";
		broken-sdr50;
	};

	sdhci@f03e0300 {
		no-1-8-v;
		non-removable;
		bus-width = <0x8>;
		compatible = "brcm,sdhci-brcmstb";
		reg = <0xf03e0200 0x100>;
		interrupts = <0x0 0x27 0x0>;
		interrupt-names = "sdio1_0";
		sdhci,auto-cmd12;
		clocks = <0x13>;
		clock-names = "sw_sdio";
	};
```

## Documentation/devicetree/bindings/mmc/sdhci-cadence.txt
```
* Cadence SD/SDIO/eMMC Host Controller

Required properties:
- compatible: should be one of the following:
    "cdns,sd4hc"               - default of the IP
    "socionext,uniphier-sd4hc" - for Socionext UniPhier SoCs
- reg: offset and length of the register set for the device.
- interrupts: a single interrupt specifier.
- clocks: phandle to the input clock.

Optional properties:
For eMMC configuration, supported speed modes are not indicated by the SDHCI
Capabilities Register.  Instead, the following properties should be specified
if supported.  See mmc.txt for details.
- mmc-ddr-1_8v
- mmc-ddr-1_2v
- mmc-hs200-1_8v
- mmc-hs200-1_2v
- mmc-hs400-1_8v
- mmc-hs400-1_2v

- phy-input-delay-sd-hs:
  Value of the delay in the input path for High Speed work mode.
  Valid range = [0:0x1F].
  Delay configuration stay unchanged if this property is not provided.
- phy-input-delay-sd-default:
  Value of the delay in the input path for Default Speed work mode.
  Valid range = [0:0x1F].
  Delay configuration stay unchanged if this property is not provided.
- phy-input-delay-sd-sdr12:
  Value of the delay in the input path for SDR12 work mode.
  Valid range = [0:0x1F].
  Delay configuration stay unchanged if this property is not provided.
- phy-input-delay-sd-sdr25:
  Value of the delay in the input path for SDR25 work mode.
  Valid range = [0:0x1F].
  Delay configuration stay unchanged if this property is not provided.
- phy-input-delay-sd-sdr50:
  Value of the delay in the input path for SDR50 work mode.
  Valid range = [0:0x1F].
  Delay configuration stay unchanged if this property is not provided.
- phy-input-delay-sd-ddr50:
  Value of the delay in the input path for DDR50 work mode.
  Valid range = [0:0x1F].
  Delay configuration stay unchanged if this property is not provided.
- phy-input-delay-emmc-legacy:
  Value of the delay in the input path for eMMC legacy work mode.
  Valid range = [0:0x1F].
  Delay configuration stay unchanged if this property is not provided.
- phy-input-delay-emmc-sdr:
  Value of the delay in the input path for eMMC SDR work mode.
  Valid range = [0:0x1F].
  Delay configuration stay unchanged if this property is not provided.
- phy-input-delay-emmc-ddr:
  Value of the delay in the input path for eMMC DDR work mode.
  Valid range = [0:0x1F].
  Delay configuration stay unchanged if this property is not provided.
- phy-dll-delay-sdclk:
  Value of the delay introduced on the sdclk output
  for all modes except HS200, HS400 and HS400_ES.
  Valid range = [0:0x7F].
  Delay configuration stay unchanged if this property is not provided.
- phy-dll-delay-sdclk-hsmmc:
  Value of the delay introduced on the sdclk output
  for HS200, HS400 and HS400_ES speed modes.
  Valid range = [0:0x7F].
  Delay configuration stay unchanged if this property is not provided.
- phy-dll-delay-strobe:
  Value of the delay introduced on the dat_strobe input
  used in HS400 / HS400_ES speed modes.
  Valid range = [0:0x7F].
  Delay configuration stay unchanged if this property is not provided.


Example:
	emmc: sdhci@5a000000 {
		compatible = "socionext,uniphier-sd4hc", "cdns,sd4hc";
		reg = <0x5a000000 0x400>;
		interrupts = <0 78 4>;
		clocks = <&clk 4>;
		bus-width = <8>;
		mmc-ddr-1_8v;
		mmc-hs200-1_8v;
		mmc-hs400-1_8v;
		phy-input-delay-sd-hs = <0>;
	};
```

## Documentation/devicetree/bindings/mmc/sdhci-xenon.txt
```
* Marvell sdhci-xenon controller

This file documents differences between the core properties in mmc.txt
and the properties used by the sdhci-xenon drivers.

Required properties:
- compatible: Should be "marvell,xenon-sdhci".
- reg:
  one register area for the SDHCI registers.
- interrupts-extended: interrupt number and attributes
- clocks: array of clocks required for SDHCI.
- bus-width: max bus width in unit of bit, normally should be 1 bit, 4 bits or 8 bits

Optional properties:
- non-removable: whether card is non-removable.
- auto-cmd12: whether cmd12 is sent automatically.
Example:

sdhci0: sdhci@D8000 {
	compatible = "marvell,xenon-sdhci";
	reg = <0xD8000 0x300>;
	interrupts-extended = <&gic GIC_SPI 26 IRQ_TYPE_LEVEL_HIGH>;
	non-removable;
	bus-width = <8>;
	auto-cmd12;
	status = "disabled";
};
```

## Documentation/devicetree/bindings/mtd/altera-asmip2.txt
```
* Altera ASMI Parallel II IP Core

Required properties:
- compatible : Should be "altr,asmi_parallel2".
- reg : A tuple consisting of a physical address and length.

Optional subnodes:
Subnodes of the Altera ASMI Paralllel II IP Core are spi slave nodes.
- reg : chip select value
- label : optional user friendly label

Example:

qspi: spi@a0001000 {
	compatible = "altr,asmi_parallel2";
	reg = <0xa0001000 0x10>;

	flash@0 {
		reg = <0>;
		label = "FPGA Image";
	};
};
```

## Documentation/devicetree/bindings/mtd/altera-quadspi-v2.txt
```
* Altera Quad SPI Controller Version 2

Required properties:
- compatible : Should be "altr,quadspi-v2".
- reg : Contains at least two entries, and possibly three entries, each of
	which is a tuple consisting of a physical address and length.
- reg-names : Should contain the names "avl_csr" and "avl_mem" corresponding
	      to the control and status registers and qspi memory, respectively.


The Altera Quad SPI Controller Version 2 can be paired with a windowed bridge
in order to reduce the footprint of the memory interface.  When a windowed
bridge is used, reads and writes of data must be 32 bits wide.

Optional properties:
- reg-names : Should contain the name "avl_window", if the windowed bridge
	      is used.  This name corresponds to the register space that
	      controls the window.
- window-size : The size of the window which must be an even power of 2.
- read-bit-reverse : A boolean indicating the data read from the flash should
		     be bit reversed on a byte by byte basis before being
		     delivered to the MTD layer.
- write-bit-reverse : A boolean indicating the data written to the flash should
		      be bit reversed on a byte by byte basis.

Example:

qspi: spi@a0001000 {
	compatible = "altr,quadspi-v2";
	reg = <0xa0001000 0x40>, <0xb0000000 0x4000000>;
	reg-names = "avl_csr", "avl_mem";

	flash@0 {
		reg = <0>;
		label = "FPGA Image";
	};
};
```

## Documentation/devicetree/bindings/mtd/amlogic,meson-nand.txt
```
Amlogic NAND Flash Controller (NFC) for GXBB/GXL/AXG family SoCs

This file documents the properties in addition to those available in
the MTD NAND bindings.

Required properties:
- compatible : contains one of:
  - "amlogic,meson-gxl-nfc"
  - "amlogic,meson-axg-nfc"
- clocks     :
	A list of phandle + clock-specifier pairs for the clocks listed
	in clock-names.

- clock-names: Should contain the following:
	"core" - NFC module gate clock
	"clkin0" - Parent clock of internal mux
	"clkin1" - Other parent clock of internal mux

- pins     : Select pins which NFC need.
- nand_pins: Detail NAND pins information.
		nand_pins: nand {
			mux {
				groups = "emmc_nand_d0",
					"emmc_nand_d1",
					"emmc_nand_d2",
					"emmc_nand_d3",
					"emmc_nand_d4",
					"emmc_nand_d5",
					"emmc_nand_d6",
					"emmc_nand_d7",
					"nand_ce0",
					"nand_rb0",
					"nand_ale",
					"nand_cle",
					"nand_wen_clk",
					"nand_ren_wr";
				function = "nand";
			};
		};

- amlogic,mmc-syscon	: Required for NAND clocks, it's shared with SD/eMMC
				controller port C

Optional children nodes:
Children nodes represent the available nand chips.

Optional properties:
- meson-nand-user-mode :
	only set 2 or 16 which mean the way of reading OOB bytes by NFC.
- meson-nand-ran-mode :
	setting 0 or 1, means disable/enable scrambler which keeps the balence
	of 0 and 1

Other properties:
see Documentation/devicetree/bindings/mtd/nand.txt for generic bindings.

Example demonstrate on AXG SoC:

	sd_emmc_c: mmc@7000 {
		compatible = "simple-bus", "syscon";
		reg = <0x0 0x7000 0x0 0x800>;
		status = "okay";
	};

	nand: nfc@7800 {
		compatible = "amlogic,meson-axg-nfc";
		reg = <0x0 0x7800 0x0 0x100>;
		#address-cells = <1>;
		#size-cells = <0>;
		interrupts = <GIC_SPI 34 IRQ_TYPE_EDGE_RISING>;
		status = "disabled";
		clocks = <&clkc CLKID_SD_EMMC_C>,
				<&clkc CLKID_SD_EMMC_C_CLK0>,
				<&clkc CLKID_FCLK_DIV2>;
		clock-names = "core", "clkin0", "clkin1";
		amlogic,mmc-syscon = <&sd_mmc_c>;

		status = "okay";

		pinctrl-names = "default";
		pinctrl-0 = <&nand_pins>;

		nand@0 {
			reg = <0>;
			#address-cells = <1>;
			#size-cells = <1>;

			nand-on-flash-bbt;
			nand-ecc-mode = "hw";
			nand-ecc-strength = <8>;
			nand-ecc-step-size = <1024>;

			meson-nand-user-mode = <2>;
			meson-nand-ran-mode = <1>;

			partition@0 {
				label = "boot";
				reg = <0x00000000 0x00200000>;
				read-only;
			};
			partition@200000 {
				label = "env";
				reg = <0x00200000 0x00400000>;
			};
			partition@600000 {
				label = "system";
				reg = <0x00600000 0x00a00000>;
			};
			partition@1000000 {
				label = "rootfs";
				reg = <0x01000000 0x03000000>;
			};
			partition@4000000 {
				label = "media";
				reg = <0x04000000 0x8000000>;
			};
		};
	};
```

## Documentation/devicetree/bindings/mtd/anarion-quadspi.txt
```
* Adaptrum Anarion Quad SPI controller

Required properties:
- compatible : Should be "adaptrum,anarion-qspi".
- reg : Contains two entries, each of which is a tuple consisting of a
	physical address and length. The first entry is the address and
	length of the controller register set. The second entry is the
	address and length of the memory-mapped flash. This second region is
	the region where the controller responds to XIP requests, and may be
	larger than the size of the attached flash.

Example:

	qspi: qspi@f200f000 {
		compatible = "adaptrum,anarion-qspi";
		reg = 	<0xf200f000 0x1000>,
			<0x20000000 0x08000000>;

		flash0: w25q128fvn@0 {
			...
		}
	};
```
