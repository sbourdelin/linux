## Documentation/devicetree/bindings/misc/mux-gpio.txt
```
GPIO-based multiplexer controller bindings

Define what GPIO pins are used to control a multiplexer. Or several
multiplexers, if the same pins control more than one multiplexer.

Required properties:
- compatible : "mux-gpio"
- mux-gpios : list of gpios used to control the multiplexer, least
	      significant bit first.
* Standard mux-controller bindings as decribed in mux-controller.txt

Optional properties:
- idle-state : if present, the state the mux will have when idle.

The multiplexer state is defined as the number represented by the
multiplexer GPIO pins, where the first pin is the least significant
bit. And active pin is a binary 1, an inactive pin is a binary 0.

Example:
	mux {
		compatible = "mux-gpio";

		mux-gpios = <&pioA 0 GPIO_ACTIVE_HIGH>,
			    <&pioA 1 GPIO_ACTIVE_HIGH>;

		adc {
			compatible = "iio-mux";
			io-channels = <&adc 0>;
			io-channel-names = "parent";

			#address-cells = <1>;
			#size-cells = <0>;

			sync-1@0 {
				reg = <0>;
			};

			in@1 {
				reg = <1>;
			};

			out@2 {
				reg = <2>;
			};

			sync-2@3 {
				reg = <3>;
			};
		};

		i2c-mux {
			compatible = "i2c-mux-simple,mux-locked";
			i2c-parent = <&i2c1>;

			#address-cells = <1>;
			#size-cells = <0>;

			i2c@0 {
				reg = <0>;
				#address-cells = <1>;
				#size-cells = <0>;

				ssd1307: oled@3c {
					/* ... */
				};
			};

			i2c@3 {
				reg = <3>;
				#address-cells = <1>;
				#size-cells = <0>;

				pca9555: pca9555@20 {
					/* ... */
				};
			};
		};
	};
```

## Documentation/devicetree/bindings/misc/reboot-mode.txt
```
Generic reboot mode communication driver

This driver get reboot mode arguments from userspace
and stores it in special register or ram . Then the
bootloader will read it and take different action
according the argument stored.

Required properties:
        - compatible = "reboot-mode" or other vendor compatible string;

Each mode is represented as a sub-node of reboot_mode:

Subnode required properties:
        - linux,mode: reboot mode command,such as "loader","recovery", "fastboot".
        - linux,magic: magic number for the mode, this is vendor specific.

example:
	reboot_mode {
		compatible = "rockchip,reboot-mode";
		rockchip,regmap = <&pmu>;
		offset = <0x40>;
		loader {
			linux,mode = "loader";
			linux,magic = <0x5242C301>;
		};

		maskrom {
			linux,mode = "maskrom";
			linux,magic = <0x5242C302>;
		};

		recovery {
			linux,mode = "recovery";
			linux,magic = <0x5242C303>;
		};

		fastboot {
			linux,mode = "fastboot";
			linux,magic = <0x5242C309>;
		};
        };
```

## Documentation/devicetree/bindings/mmc/marvell,sdhci-xenon.txt
```
Marvell's Xenon SDHCI Controller device tree bindings
This file documents differences between the core mmc properties
described by mmc.txt and the properties used by the Xenon implementation.

A single Xenon IP can support multiple slots.
Each slot acts as an independent SDHC. It owns independent resources, such
as register sets clock and PHY.
Each slot should have an independent device tree node.

Required Properties:
- compatible: should be "marvell,sdhci-xenon" or "marvell,armada-3700-sdhci".

- Input Clock Name
  Some SOCs require additional clock for AXI bus.
  The input clock for Xenon IP core should be named as "core".
  The optional AXI clock should be named as "axi".
  - clocks = <&core_clk>, <&axi_clock>;
  - clock-names = "core", "axi";

- Register Set Size
  Different Xenon SDHC release has different register set size.
  The specific size should also refer to the SOC implementation.

Optional Properties:
- Slot Index
  A single Xenon IP can support multiple slots.
  During initialization, each slot should set corresponding setting bit in
  some Xenon-specific registers. The corresponding bit is determined by
  this property.
  - xenon,slotno = <slot_index>;
  If this property is not provided, Xenon IP should contain only one slot
  and the slot index will be 0x0 by default.

- PHY Type
  Xenon support mutilple types of PHYs.
  To select eMMC 5.1 PHY, set:
  - xenon,phy-type = "emmc 5.1 phy"
  eMMC 5.1 PHY is the default choice if this property is not provided.
  To select eMMC 5.0 PHY, set:
  - xenon,phy-type = "emmc 5.0 phy"
  To select SDH PHY, set:
  - xenon,phy-type = "sdh phy"
  Please note that eMMC PHY is a general PHY for eMMC/SD/SDIO, other than for
  eMMC only.

- Customized eMMC PHY Parameters
  Some boards require different values of some specific eMMC PHY parameters.
  Some SOCs also require specific workaround to set eMMC PHY.
  These properties enable diverse boards to customize the eMMC PHY.
  The supported eMMC PHY parameters are listed in below. All those properties
  are only available for eMMC PHY 5.1 and eMMC PHY 5.0.
  ZNR
  valid range = [0:0x1F].
  ZNR is set as 0xF by default if this property is not provided.
  - xenon,phy-znr = <value>;

  ZPR
  valid range = [0:0x1F].
  ZPR is set as 0xF by default if this property is not provided.
  - xenon,phy-zpr = <value>;

  Number of successful tuning times
  Set the number of required consecutive successful sampling points used to
  identify a valid sampling window, in tuning process.
  Valid range = [1:7]. Set as 0x4 by default if this property is not provided.
  - xenon,phy-nr-tun-times = <nr_times>;

  Divider for TUN_STEP
  Set the divider for calculating TUN_STEP.
  Set as 64 by default if this property is not provided.
  - xenon,phy-tun-step-divider = <divider>;

  Force PHY into slow mode.
  Only available when bus frequency lower than 50MHz in SDR mde.
  Disabled by default. Please do not enable it unless it is necessary.
  - xenon,phy-slow-mode;

- Mask Conflict Error Report
  Disable Conflict Error alert on some SOC. Disabled by default.
  xenon,mask-conflict-err;

- Re-tuning Counter
  Xenon SDHC SOC usually doesn't provide re-tuning counter in
  Capabilities Register 3 Bit[11:8].
  This property provides the re-tuning counter.
  xenon,tuning-count = <count>;
  If this property is not set, default re-tuning counter will
  be set as 0x9 in driver.

- SOC PHY PAD Voltage Control register
  Some SOCs have SOC PHY PAD Voltage Control register outside Xenon IP.
  This register sets SOC PHY PAD Voltage to keep aligh with Vccq.
  Two properties provide information of this control register.
  These two properties are only valid when "marvell,armada-3700-sdhci"
  is selected. Both of them must be provided when "marvell,armada-3700-sdhci"
  is selected.
  - xenon,pad-type
    Two types: "sd" and "fixed-1-8v".
    If "sd" is slected, SOC PHY PAD is set as 3.3V at the beginning and is
    switched to 1.8V when SD in UHS-I.
    If "fixed-1-8v" is slected, SOC PHY PAD is fixed 1.8V, such as for eMMC.
  - reg
    Physical address and size of SOC PHY PAD register.
    Append after Xenon SDHC register space, as a second register field.

  Please follow the examples with compatible "marvell,armada-3700-sdhci"
  in below.

Example:
- For eMMC slot:

	sdhci@aa0000 {
		compatible = "marvell,sdhci-xenon";
		reg = <0xaa0000 0x1000>;
		interrupts = <GIC_SPI 13 IRQ_TYPE_LEVEL_HIGH>
		clocks = <&emmcclk>;
		clock-names = "core";
		xenon,slotno = <0>;
		xenon,phy-type = "emmc 5.1 phy";
		bus-width = <8>;
		tuning-count = <11>;
	};

- For SD/SDIO slot:

	sdhci@ab0000 {
		compatible = "marvell,sdhci-xenon";
		reg = <0xab0000 0x1000>;
		interrupts = <GIC_SPI 55 IRQ_TYPE_LEVEL_HIGH>
		vqmmc-supply = <&sd_regulator>;
		clocks = <&sdclk>;
		clock-names = "core";
		bus-width = <4>;
		tuning-count = <9>;
	};

- For eMMC slot with compatible "marvell,armada-3700-sdhci":

	sdhci@aa0000 {
		compatible = "marvell,armada-3700-sdhci";
		reg = <0xaa0000 0x1000>,
		      <phy_addr 0x4>;
		interrupts = <GIC_SPI 13 IRQ_TYPE_LEVEL_HIGH>
		clocks = <&emmcclk>;
		clock-names = "core";
		bus-width = <8>;

		xenon,pad-type = "fixed-1-8v";
	};

- For SD/SDIO slot with compatible "marvell,armada-3700-sdhci":

	sdhci@ab0000 {
		compatible = "marvell,armada-3700-sdhci";
		reg = <0xab0000 0x1000>,
		      <phy_addr 0x4>;
		interrupts = <GIC_SPI 55 IRQ_TYPE_LEVEL_HIGH>
		vqmmc-supply = <&sd_regulator>;
		clocks = <&sdclk>;
		clock-names = "core";
		bus-width = <4>;

		xenon,pad-type = "sd";
	};
```

## Documentation/devicetree/bindings/mmc/marvell,xenon-sdhci.txt
```
Marvell's Xenon SDHCI Controller device tree bindings
This file documents differences between the core mmc properties
described by mmc.txt and the properties used by the Xenon implementation.

A single Xenon IP can support multiple slots.
Each slot acts as an independent SDHC. It owns independent resources, such
as register sets clock and PHY.
Each slot should have an independent device tree node.

Required Properties:
- compatible: should be one of the following
  - "marvell,armada-3700-sdhci": For controllers on Armada-3700 SOC.
  Must provide a second register area and marvell,pad-type.
  - "marvell,xenon-sdhci": For controllers on all the SOCs, other than
  Armada-3700.

- clocks:
  Array of clocks required for SDHCI.
  Requires at least one for Xenon IP core.
  Some SOCs require additional clock for AXI bus.

- clock-names:
  Array of names corresponding to clocks property.
  The input clock for Xenon IP core should be named as "core".
  The optional AXI clock should be named as "axi".

- reg:
  * For "marvell,xenon-sdhci", one register area for Xenon IP.

  * For "marvell,armada-3700-sdhci", two register areas.
    The first one for Xenon IP register. The second one for the Armada 3700 SOC
    PHY PAD Voltage Control register.
    Please follow the examples with compatible "marvell,armada-3700-sdhci"
    in below.
    Please also check property marvell,pad-type in below.

Optional Properties:
- marvell,xenon-slotno:
  Indicate the corresponding bit index of current Xenon SDHC slot in
  SDHC System Operation Control Register Bit[7:0].
  Set/clear the corresponding bit to enable/disable current Xenon SDHC
  slot.
  If this property is not provided, Xenon IP should contain only one
  slot.

- marvell,xenon-phy-type:
  Xenon support mutilple types of PHYs.
  To select eMMC 5.1 PHY, set:
  marvell,xenon-phy-type = "emmc 5.1 phy"
  eMMC 5.1 PHY is the default choice if this property is not provided.
  To select eMMC 5.0 PHY, set:
  marvell,xenon-phy-type = "emmc 5.0 phy"
  To select SDH PHY, set:
  marvell,xenon-phy-type = "sdh phy"
  Please note that eMMC PHY is a general PHY for eMMC/SD/SDIO, other than for
  eMMC only.

- marvell,xenon-phy-znr:
  Set PHY ZNR value.
  Only available for eMMC PHY 5.1 and eMMC PHY 5.0.
  valid range = [0:0x1F].
  ZNR is set as 0xF by default if this property is not provided.

- marvell,xenon-phy-zpr:
  Set PHY ZPR value.
  Only available for eMMC PHY 5.1 and eMMC PHY 5.0.
  valid range = [0:0x1F].
  ZPR is set as 0xF by default if this property is not provided.

- marvell,xenon-phy-nr-success-tun:
  Set the number of required consecutive successful sampling points used to
  identify a valid sampling window, in tuning process.
  Valid range = [1:7]. Set as 0x4 by default if this property is not provided.

- marvell,xenon-phy-tun-step-divider:
  Set the divider for calculating TUN_STEP.
  Set as 64 by default if this property is not provided.

- marvell,xenon-phy-slow-mode:
  Force PHY into slow mode.
  Only available when bus frequency lower than 50MHz in SDR mde.
  Disabled by default. Please do not enable it unless it is necessary.

- marvell,xenon-mask-conflict-err:
  Mask Conflict Error alert on some SOC. Disabled by default.

- marvell,xenon-tun-count:
  Xenon SDHC SOC usually doesn't provide re-tuning counter in
  Capabilities Register 3 Bit[11:8].
  This property provides the re-tuning counter.
  If this property is not set, default re-tuning counter will
  be set as 0x9 in driver.

- marvell,pad-type:
  Type of Armada 3700 SOC PHY PAD Voltiage Controller register.
  Only valid when "marvell,armada-3700-sdhci" is selected.
  Two types: "sd" and "fixed-1-8v".
  If "sd" is slected, SOC PHY PAD is set as 3.3V at the beginning and is
  switched to 1.8V when SD in UHS-I.
  If "fixed-1-8v" is slected, SOC PHY PAD is fixed 1.8V, such as for eMMC.
  Please follow the examples with compatible "marvell,armada-3700-sdhci"
  in below.

Example:
- For eMMC slot:

	sdhci@aa0000 {
		compatible = "marvell,xenon-sdhci";
		reg = <0xaa0000 0x1000>;
		interrupts = <GIC_SPI 13 IRQ_TYPE_LEVEL_HIGH>
		clocks = <&emmc_clk>, <&axi_clock>;
		clock-names = "core", "axi";
		bus-width = <8>;
		marvell,xenon-emmc;
		marvell,xenon-slotno = <0>;
		marvell,xenon-phy-type = "emmc 5.1 phy";
		marvell,xenon-tun-count = <11>;
	};

- For SD/SDIO slot:

	sdhci@ab0000 {
		compatible = "marvell,xenon-sdhci";
		reg = <0xab0000 0x1000>;
		interrupts = <GIC_SPI 55 IRQ_TYPE_LEVEL_HIGH>
		vqmmc-supply = <&sd_regulator>;
		clocks = <&sdclk>;
		clock-names = "core";
		bus-width = <4>;
		marvell,xenon-tun-count = <9>;
	};

- For eMMC slot with compatible "marvell,armada-3700-sdhci":

	sdhci@aa0000 {
		compatible = "marvell,armada-3700-sdhci";
		reg = <0xaa0000 0x1000>,
		      <phy_addr 0x4>;
		interrupts = <GIC_SPI 13 IRQ_TYPE_LEVEL_HIGH>
		clocks = <&emmcclk>;
		clock-names = "core";
		bus-width = <8>;
		marvell,xenon-emmc;

		marvell,pad-type = "fixed-1-8v";
	};

- For SD/SDIO slot with compatible "marvell,armada-3700-sdhci":

	sdhci@ab0000 {
		compatible = "marvell,armada-3700-sdhci";
		reg = <0xab0000 0x1000>,
		      <phy_addr 0x4>;
		interrupts = <GIC_SPI 55 IRQ_TYPE_LEVEL_HIGH>
		vqmmc-supply = <&sd_regulator>;
		clocks = <&sdclk>;
		clock-names = "core";
		bus-width = <4>;

		marvell,pad-type = "sd";
	};
```

## Documentation/devicetree/bindings/mmc/mmc-pwrseq-sd8787.txt
```
* Marvell SD8787 power sequence provider

Required properties:
- compatible: must be "mmc-pwrseq-sd8787".
- powerdown-gpio: contains a power down GPIO specifier with active state
- reset-gpio: contains a reset GPIO specifier with active state

Example:

	wifi_pwrseq: wifi_pwrseq {
		compatible = "mmc-pwrseq-sd8787";
		powerdown-gpio = <&twl_gpio 0 GPIO_ACTIVE_LOW>;
		reset-gpio = <&twl_gpio 1 GPIO_ACTIVE_LOW>;
	}
```

## Documentation/devicetree/bindings/mmc/mmc-pwrseq-simple.txt
```
* The simple MMC power sequence provider

The purpose of the simple MMC power sequence provider is to supports a set of
common properties between various SOC designs. It thus enables us to use the
same provider for several SOC designs.

Required properties:
- compatible : contains "mmc-pwrseq-simple".

Optional properties:
- reset-gpios : contains a list of GPIO specifiers. The reset GPIOs are asserted
	at initialization and prior we start the power up procedure of the card.
	They will be de-asserted right after the power has been provided to the
	card.
- ext-vcc-supply : Regulator to drive (independent) card VCC.
- clocks : Must contain an entry for the entry in clock-names.
  See ../clocks/clock-bindings.txt for details.
- clock-names : Must include the following entry:
  "ext_clock" (External clock provided to the card).

Example:

	wifi_regulator: wifi-regulator {
		compatible = "regulator-fixed";
		enable-active-high;
		gpio = <&gpio0 26 GPIO_ACTIVE_HIGH>;
		regulator-name = "wifi_regulator";
	};

	sdhci0_pwrseq {
		compatible = "mmc-pwrseq-simple";
		reset-gpios = <&gpio1 12 GPIO_ACTIVE_LOW>;
		ext-vcc-supply = <&wifi_regulator>;
		clocks = <&clk_32768_ck>;
		clock-names = "ext_clock";
	}
```
