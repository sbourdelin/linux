## Documentation/devicetree/bindings/pinctrl/renesas,rzn1-pinctrl.txt
```
Renesas RZ/N1 SoC Pinctrl node description.

Pin controller node
-------------------
Required properties:
- compatible: SoC-specific compatible string "renesas,<soc-specific>-pinctrl"
  followed by "renesas,rzn1-pinctrl" as fallback. The SoC-specific compatible
  strings must be one of:
	"renesas,r9a06g032-pinctrl" for RZ/N1D
	"renesas,r9a06g033-pinctrl" for RZ/N1S
- reg: Address base and length of the memory area where the pin controller
  hardware is mapped to.
- clocks: phandles for the clock, see the description of clock-names below.
- clock-names: Contains the name of the clock:
    "bus", the bus clock, sometimes described as pclk, for register accesses.

Example:
	pinctrl: pin-controller@40067000 {
	    compatible = "renesas,r9a06g032-pinctrl", "renesas,rzn1-pinctrl";
	    reg = <0x40067000 0x1000>, <0x51000000 0x480>;
	    clocks = <&sysctrl R9A06G032_HCLK_PINCONFIG>;
	    clock-names = "bus";
	};

Sub-nodes
---------
  The child nodes of the pin controller node describe a pin multiplexing
  group that can be used by device nodes.

  A pin multiplexing sub-node describes how to configure a set of pins, or a
  single pin, in some desired alternate function mode.
  A single sub-node may define several pin configurations.

  The allowed generic formats for a pin multiplexing sub-node are the
  following ones:

  Client sub-nodes shall refer to pin multiplexing sub-nodes using the phandle
  of the most external one. See the generic pinctrl-bindings.txt for details.

  Required properties:
    - renesas,rzn1-pinctrl:
      Array of integers representing each 'pin' and it's configuration.

      A 'pin number' does not correspond 1:1 to the hardware manual notion of
      PL_GPIO directly. Numbers 0...169 are PL_GPIOs, however there is also two
      extra 170 and 171 that corresponds to the MDIO0 and MDIO1 bus config.

      A 'function' also does not correspond 1:1 to the hardware manual. There
      are 2 levels of pin muxing, Level 1, level 2 -- to this are added the
      MDIO configurations.

      Helper macros to ease assembling the pin index and function identifier
      are provided by the pin controller header file at:
      <include/dt-bindings/pinctrl/rzn1-pinctrl.h>

Example #1:
  A simple case configuring only the function for a given 'pin' works as follow:
	#include <include/dt-bindings/pinctrl/rzn1-pinctrl.h>
	&pinctrl {
		pinsuart0: pinsuart0 {
			renesas,rzn1-pinmux-ids = <
				RZN1_MUX(103, UART0_I)	/* UART0_TXD */
				RZN1_MUX(104, UART0_I)	/* UART0_RXD */
			>;
		};
	};

  Note that in this case the other attributes of the pins, pull up/down/none and
  drive strength, are not changed.

Example #2:
  Here we also set the pullups on the RXD pin:
	&pinctrl {
		pinsuart0: pinsuart0 {
			renesas,rzn1-pinmux-ids = <
				RZN1_MUX(103, UART0_I)	/* UART0_TXD */
				RZN1_MUX_PUP(104, UART0_I)	/* UART0_RXD */
			>;
		};
	};
  There are many alternative macros to set the pull up/down/none and the drive
  strength in the rzn1-pinctrl.h header file.

Example #3:
  The SoC has two configurable MDIO muxes, these can also be configured
  with this interface using the 'special' MDIO constants:

	&pinctrl {
		mdio_mux: mdiomux {
			renesas,rzn1-pinmux-ids = <
				RZN1_MUX(RZN1_MDIO_BUS0, RZN1_FUNC_MDIO_MUX_MAC0)
				RZN1_MUX(RZN1_MDIO_BUS1, RZN1_FUNC_MDIO_MUX_SWITCH)
			>;
		};
	};
  Clearly the pull up/down/none and drive constants will be ignored, even if
  specified.
```

## Documentation/devicetree/bindings/pinctrl/sprd,pinctrl.txt
```
* Spreadtrum Pin Controller

The Spreadtrum pin controller are organized in 3 blocks (types).

The first block comprises some global control registers, and each
register contains several bit fields with one bit or several bits
to configure for some global common configuration, such as domain
pad driving level, system control select and so on. We recognise
every fields comprising one bit or several bits in one global control
register as one pin, thus we should record every pin's bit offset,
bit width and register offset to configure this field (pin). Since
this type pins' configuration are very tricky and different for each
register, we introduce "sprd,ctrl" property to set the various global
control configuration.

The second block comprises some common registers which have unified
register definition, and each register described one pin is used
to configure the pin sleep mode and function select. Now we have 4
systems on SC9860 SoC: AP system, PUBCP system, TGLDSP system and
AGDSP system. In some situation we have some pin-sleep related
configuration need to set when one of system goes into deep sleep
mode. For example, if we set the pin sleep mode as AP_SLEEP, which
means when AP system goes into deep sleep mode, this pin's sleep
related properties (input/output or pullup/down) will be set
automatically. Thus we intoduce "sprd,sleep_mode" to set pin sleep
mode.

The last block comprises some misc registers which also have unified
register definition, and each register described one pin is used to
configure drive strength, pull up/down and so on. Especially for pull
up, we introduce "sprd,pullup" property for two kind configuration:
PULLUP_20K or PULLUP_4_7K, which means the pullup resistor is 20K or
4.7K.

Required properties for Spreadtrum pin controller:
- compatible: "sprd,<soc>-pinctrl"
  Please refer to each sprd,<soc>-pinctrl.txt binding doc for supported SoCs.
- reg: The register address of pin controller device.
- pins : An array of pin names.

Optional properties:
- function: Specified the function name.
- drive-strength: Drive strength in mA.
- input-schmitt-disable: Enable schmitt-trigger mode.
- input-schmitt-enable: Disable schmitt-trigger mode.
- bias-disable: Disable pin bias.
- bias-pull-down: Pull down on pin.
- sprd,ctrl: Control values referring to databook for global control pins.
- sprd,sleep_mode: Sleep mode selection.
- sprd,pullup: Pull up on pin.
- sprd,input-sleep: Input enable when system goes into deep sleep mode.
- sprd,output-sleep: Output enable when system goes into deep sleep mode.
- sprd,pullup_sleep: Pull up enable when system goes into deep sleep mode.
- sprd,pulldown_sleep: Pull down enable when system goes into deep sleep mode.

Please refer to each sprd,<soc>-pinctrl.txt binding doc for supported values.
```

## Documentation/devicetree/bindings/pinctrl/sprd,sc9860-pinctrl.txt
```
* Spreadtrum SC9860 Pin Controller

Please refer to sprd,pinctrl.txt in this directory for common binding part
and usage.

Required properties:
- compatible: Must be "sprd,sc9860-pinctrl".
- reg: The register address of pin controller device.
- pins : An array of strings, each string containing the name of a pin.

Optional properties:
- function: A string containing the name of the function, values must be
  one of: "func1", "func2", "func3" and "func4".
- drive-strength: Drive strength in mA. Supported values: 2, 4, 6, 8, 10,
  12, 14, 16, 20, 21, 24, 25, 27, 29, 31 and 33.
- input-schmitt-disable: Enable schmitt-trigger mode.
- input-schmitt-enable: Disable schmitt-trigger mode.
- bias-disable: Disable pin bias.
- bias-pull-down: Pull down on pin.
- bias-pull-up: Pull up on pin. Supported values: 20000 for pull-up resistor
  is 20K and 4700 for pull-up resistor is 4.7K.
- sleep-input-enable: Input enable when the system specified by sleep mode
  goes into deep sleep mode.
- sleep-input-disable: Input disable when the system specified by sleep mode
  goes into deep sleep mode.
- sleep-output-high: Output high enable when the system specified by sleep
  mode goes into deep sleep mode.
- sleep-output-low: Output low enable when the system specified by sleep mode
  goes into deep sleep mode.
- sleep-bias-pull-up: Pull up enable when the system specified by sleep mode
  goes into deep sleep mode.
- sleep-bias-pull-down: Pull down enable when the system specified by sleep
  mode goes into deep sleep mode.
- sprd,control: Control values referring to databook for global control pins.
- sprd,sleep-mode: Choose the pin sleep mode, and supported values are:
  AP_SLEEP, PUBCP_SLEEP, TGLDSP_SLEEP and AGDSP_SLEEP.

Pin sleep mode definition:
enum pin_sleep_mode {
	AP_SLEEP = BIT(0),
	PUBCP_SLEEP = BIT(1),
	TGLDSP_SLEEP = BIT(2),
	AGDSP_SLEEP = BIT(3),
};

Example:
pin_controller: pinctrl@402a0000 {
	compatible = "sprd,sc9860-pinctrl";
	reg = <0x402a0000 0x10000>;

	grp1: sd0 {
		pins = "SC9860_VIO_SD2_IRTE", "SC9860_VIO_SD0_IRTE";
		sprd,control = <0x1>;
	};

	grp2: rfctl_33 {
		pins = "SC9860_RFCTL33";
		function = "func2";
		sprd,sleep-mode = <AP_SLEEP | PUBCP_SLEEP>;
		sleep-output-low;
	};

	grp3: rfctl_misc_20 {
		pins = "SC9860_RFCTL20_MISC";
		drive-strength = <10>;
		bias-pull-up = <4700>;
		sleep-bias-pull-up;
	};
};
```

## Documentation/devicetree/bindings/pinctrl/ti,ds90ux9xx-pinctrl.txt
```
TI DS90Ux9xx de-/serializer pinmux and GPIO subcontroller

Required properties:
- compatible: Must contain a generic "ti,ds90ux9xx-pinctrl" value and
	may contain one more specific value from the list:
	"ti,ds90ux925-pinctrl",
	"ti,ds90ux926-pinctrl",
	"ti,ds90ux927-pinctrl",
	"ti,ds90ux928-pinctrl",
	"ti,ds90ux940-pinctrl".

- gpio-controller: Marks the device node as a GPIO controller.

- #gpio-cells: Must be set to 2,
	- the first cell is the GPIO offset number within the controller,
	- the second cell is used to specify the GPIO line polarity.

- gpio-ranges: Mapping to pin controller pins (as described in
	Documentation/devicetree/bindings/gpio/gpio.txt)

Optional properties:
- ti,video-depth-18bit: Sets video bridge pins to RGB 18-bit mode.

Available pins, groups and functions (reference to device datasheets):

function: "gpio" ("gpio4" is on DS90Ux925 and DS90Ux926 only,
		  "gpio9" is on DS90Ux940 only)
 - pins: "gpio0", "gpio1", "gpio2", "gpio3", "gpio4", "gpio5", "gpio6",
	 "gpio7", "gpio8", "gpio9"

function: "gpio-remote"
 - pins: "gpio0", "gpio1", "gpio2", "gpio3"

function: "pass" (DS90Ux940 specific only)
 - pins: "gpio0", "gpio3"

function: "i2s-1"
 - group: "i2s-1"

function: "i2s-2"
 - group: "i2s-2"

function: "i2s-3" (DS90Ux927, DS90Ux928 and DS90Ux940 specific only)
 - group: "i2s-3"

function: "i2s-4" (DS90Ux927, DS90Ux928 and DS90Ux940 specific only)
 - group: "i2s-4"

function: "i2s-m" (DS90Ux928 and DS90Ux940 specific only)
 - group: "i2s-m"

function: "parallel" (DS90Ux925 and DS90Ux926 specific only)
 - group: "parallel"

Example (deserializer with pins GPIO[3:0] set to bridged output
	 function and pin GPIO4 in standard hogged GPIO function):

deserializer {
	compatible = "ti,ds90ub928q", "ti,ds90ux9xx";

	ds90ux928_pctrl: pin-controller {
		compatible = "ti,ds90ux928-pinctrl", "ti,ds90ux9xx-pinctrl";
		gpio-controller;
		#gpio-cells = <2>;
		gpio-ranges = <&ds90ux928_pctrl 0 0 8>;

		pinctrl-names = "default";
		pinctrl-0 = <&ds90ux928_pins>;

		ds90ux928_pins: pinmux {
			gpio-remote {
				pins = "gpio0", "gpio1", "gpio2", "gpio3";
				function = "gpio-remote";
			};
		};

		rst {
			gpio-hog;
			gpios = <4 GPIO_ACTIVE_HIGH>;
			output-high;
		};
	};
};
```

## Documentation/devicetree/bindings/power/act8945a-charger.txt
```
Device-Tree bindings for charger of Active-semi ACT8945A Multi-Function Device

Required properties:
 - compatible: "active-semi,act8945a-charger"
 - active-semi,chglev-gpio = Specifies a gpio that uses to select
   the charge current level.

Optional properties:
 - active-semi,battery_temperature: Indicates if it is allowed to check
   the battery temperature. If it is missing, assume the battery temperature
   is not allowed to check.
 - active-semi,input_voltage_threshold: unit: mV;
   Specifies the charger's input over-voltage threshold value;
   The value can be: 6600, 7000, 7500, 8000; default: 6600
 - active-semi,precondition_timeout: unit: minutes;
   Specifies the charger's PRECONDITION safety timer setting value;
   The value can be: 40, 60, 80, 0; If 0, it means to disable this timer;
   default: 40.
 - active-semi,total_timeout: unit: hours;
   Specifies the charger's total safety timer setting value;
   The value can be: 3, 4, 5, 0; If 0, it means to disable this timer;
   default: 3.

Example:

	charger {
		compatible = "active-semi,act8945a-charger";
		pinctrl-names = "default";
		pinctrl-0 = <&pinctrl_charger_chglev>;
		active-semi,chglev-gpio = <&pioA 12 GPIO_ACTIVE_HIGH>;
		active-semi,input_voltage_threshold = <6600>;
		active-semi,precondition_timeout = <40>;
		active-semi,total_timeout = <3>;
	};
```

## Documentation/devicetree/bindings/power/bq27425.txt
```
* TI BQ27425 Fuel Gauge

http://www.ti.com/lit/ds/symlink/bq27425-g2a.pdf

Please note that if any of the optional properties are defined
then all settings must be.

Required properties:
- compatible: Should be "ti,bq27425"
- reg: integer, I2C address of the device

Optional properties:
- ti,design-microamp-hours: integer of mAh of the battery
- ti,design-microvolt-hours: integer of the mWh of the battery
- ti,terminate-microvolt: integer of mV of the dead voltage of
		the battery

bq27425 {
	compatible = "ti,bq27425";
	reg = <0x55>;

	ti,design-microamp-hours = <1360>;
	ti,design-microwatt-hours = <4970>;
	ti,terminate-microvolt = <3200>;
};
```
