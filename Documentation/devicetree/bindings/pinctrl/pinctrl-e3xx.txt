## Documentation/devicetree/bindings/pinctrl/pinctrl-e3xx.txt
```
USRP E3xx Pincontrol bindings

The pins of the NI Ettus Research USRP E3xx idle image can be configured for different
daughterboard configurations. This pinmux is implemented in an FPGA as soft core.

Required properties:
- compatible: Must be one of the following:
  - "ettus,pinctrl-e3xx-1.0"
- clocks: The clock driving the pinmux

Example:

	e3xx_pinctrl: e3xx-pinctrl@40200a00 {
		compatible = "ettus,e3xx-pinctrl-1.0";
		reg = <0x40200a00 0x1000>;
		clocks = <&clkc 15>;

		foo_state: pinconf {
			conf {
				pins = E31X_LED_RX1_RX;
				output-low;
			};
		};
	};

Note: Constants that facilitate creation of devicetree files are available in
      include/dt-bindings/pinctrl/pinctrl-e3xx.h
```

## Documentation/devicetree/bindings/pinctrl/pinctrl-max77620.txt
```
Pincontrol driver for MAX77620 Power management IC from Maxim Semiconductor.

Device has 8 GPIO pins which can be configured as GPIO as well as the
special IO functions.

Please refer file <devicetree/bindings/pinctrl/pinctrl-bindings.txt>
for details of the common pinctrl bindings used by client devices,
including the meaning of the phrase "pin configuration node".

Optional Pinmux properties:
--------------------------
Following properties are require if pin control setting is required at boot.
- pinctrl-names: A pinctrl state named per <pinctrl-binding.txt>.
- pinctrl[0...n]: Properties to contain the phandle for pinctrl states per
		<pinctrl-binding.txt>.

The pin configurations are defined as child of the pinctrl states node. Each
sub-node have following properties:

Required properties:
- pins: List of pins. Valid values of pins properties are:
		      gpio0, gpio1, gpio2, gpio3, gpio4, gpio5, gpio6, gpio7.

Optional properties:
Following are optional properties defined as pinmux DT binding document
<pinctrl-bindings.txt>. Absence of properties will leave the configuration
on default.
	function,
	drive-push-pull,
	drive-open-drain,
	bias-pull-up,
	bias-pull-down.

Valid values for function properties are:
	gpio, lpm-control-in, fps-out, 32k-out, sd0-dvs-in, sd1-dvs-in,
	reference-out

Theres is also customised properties for the GPIO1, GPIO2 and GPIO3.
The properties are required to configure these resource FPS parameters
when system is in "active" state or in "suspend" state.
Here "active" state means system is UP and working normally.
"suspend" state means system enters into the suspend state.

- maxim,active-fps-source:	     FPS source for the gpios in active state
				     of the GPIO. Valid values are FPS_SRC_0,
				     FPS_SRC_1, FPS_SRC_2 and FPS_SRC_NONE.
				     Absence of this property will leave the pin
				     on default.
- maxim,active-fps-power-up-slot:    Power up slot on given FPS for active state.
				     Valid values are 0 to 7.
- maxim,active-fps-power-down-slot:  Power down slot on given FPS for active
				     state. Valid values are 0 to 7.
- maxim,suspend-fps-source:	     Suspend state FPS source. Valid values are
				     same as maxim,active-fps-source.
- maxim,suspend-fps-power-down-slot: Suspend state power down slot. Valid
				     values are 0 to 7.
- maxim,suspend-fps-power-up-slot: Suspend state power up slot. Valid values
				     are 0 to 7.

Example:
--------
#include <dt-bindings/mfd/max77620.h>
...
max77620@3c {

	pinctrl-names = "default";
	pinctrl-0 = <&spmic_default>;

	spmic_default: pinmux@0 {
		pin_gpio0 {
			pins = "gpio0";
			function = "gpio";
		};

		pin_gpio1 {
			pins = "gpio1";
			function = "fps-out";
			maxim,fps-source = <FPS_SRC_0>;
		};

		pin_gpio2 {
			pins = "gpio2";
			function = "fps-out";
			maxim,fps-source = <FPS_SRC_1>;
		};
	};
};
```

## Documentation/devicetree/bindings/pinctrl/pinctrl-mt6797.txt
```
* Mediatek MT6797 Pin Controller

The Mediatek's MT6797 Pin controller is used to control SoC pins.

Required properties:
- compatible: Value should be one of the following.
              "mediatek,mt6797-pinctrl", compatible with mt6797 pinctrl.
- reg:        Should contain address and size for gpio, iocfgl, iocfgb,
              iocfgr and iocfgt register bases.
- reg-names:  An array of strings describing the "reg" entries. Must
              contain "gpio", "iocfgl", "iocfgb", "iocfgr", "iocfgt".
- gpio-controller: Marks the device node as a gpio controller.
- #gpio-cells: Should be two. The first cell is the gpio pin number
               and the second cell is used for optional parameters.

Optional properties:
- interrupt-controller: Marks the device node as an interrupt controller.
- #interrupt-cells: Should be two.
- interrupts : The interrupt outputs from the controller.

Please refer to pinctrl-bindings.txt in this directory for details of the
common pinctrl bindings used by client devices.

Subnode format
A pinctrl node should contain at least one subnodes representing the
pinctrl groups available on the machine. Each subnode will list the
pins it needs, and how they should be configured, with regard to muxer
configuration, pullups, drive strength, input enable/disable and input schmitt.

    node {
        pinmux = <PIN_NUMBER_PINMUX>;
        GENERIC_PINCONFIG;
    };

Required properties:
- pinmux: Integer array, represents gpio pin number and mux setting.
          Supported pin number and mux varies for different SoCs, and are
          defined as macros in dt-bindings/pinctrl/<soc>-pinfunc.h directly.

Optional properties:
- GENERIC_PINCONFIG: is the generic pinconfig options to use, bias-disable,
    bias-pull-down, bias-pull-up, input-enable, input-disable, output-low, output-high,
    input-schmitt-enable, input-schmitt-disable and drive-strength are valid.

    Some special pins have extra pull up strength, there are R0 and R1 pull-up
    resistors available, but for user, it's only need to set R1R0 as 00, 01, 10 or 11.
    So when config bias-pull-up, it support arguments for those special pins.
    Some macros have been defined for this usage, such as MTK_PUPD_SET_R1R0_00.
    See dt-bindings/pinctrl/mt65xx.h.

    When config drive-strength, it can support some arguments, such as
    MTK_DRIVE_4mA, MTK_DRIVE_6mA, etc. See dt-bindings/pinctrl/mt65xx.h.

Examples:

        pio: pinctrl@10005000 {
                compatible = "mediatek,mt6797-pinctrl";
                reg = <0 0x10005000 0 0x1000>,
                      <0 0x10002000 0 0x400>,
                      <0 0x10002400 0 0x400>,
                      <0 0x10002800 0 0x400>,
                      <0 0x10002C00 0 0x400>;
                reg-names = "gpio", "iocfgl", "iocfgb",
                            "iocfgr", "iocfgt";
                gpio-controller;
                #gpio-cells = <2>;

                uart1_pins_a: uart1 {
                        pins1 {
                                pinmux = <MT6797_GPIO232__FUNC_URXD1>,
                                         <MT6797_GPIO233__FUNC_UTXD1>;
                        };
                };
        };
```

## Documentation/devicetree/bindings/pinctrl/pinctrl-mt8183.txt
```
* Mediatek MT8183 Pin Controller

The Mediatek's Pin controller is used to control SoC pins.

Required properties:
- compatible: value should be one of the following.
	"mediatek,mt8183-pinctrl", compatible with mt8183 pinctrl.
- gpio-controller : Marks the device node as a gpio controller.
- #gpio-cells: number of cells in GPIO specifier. Since the generic GPIO
  binding is used, the amount of cells must be specified as 2. See the below
  mentioned gpio binding representation for description of particular cells.
- gpio-ranges : gpio valid number range.

	Eg: <&pio 6 0>
	<[phandle of the gpio controller node]
	[line number within the gpio controller]
	[flags]>

	Values for gpio specifier:
	- Line number: is a value between 0 to 202.
	- Flags:  bit field of flags, as defined in <dt-bindings/gpio/gpio.h>.
            Only the following flags are supported:
            0 - GPIO_ACTIVE_HIGH
            1 - GPIO_ACTIVE_LOW

Optional properties:
- reg: physicall address base for gpio base registers.
- reg-names: gpio base registers name.
- interrupt-controller: Marks the device node as an interrupt controller
- #interrupt-cells: Should be two.
- interrupts : The interrupt outputs from the controller.

Please refer to pinctrl-bindings.txt in this directory for details of the
common pinctrl bindings used by client devices.

Subnode format
A pinctrl node should contain at least one subnodes representing the
pinctrl groups available on the machine. Each subnode will list the
pins it needs, and how they should be configured, with regard to muxer
configuration, pullups, drive strength, input enable/disable and input schmitt.

    node {
	pinmux = <PIN_NUMBER_PINMUX>;
	GENERIC_PINCONFIG;
    };

Required properties:
- pinmux: integer array, represents gpio pin number and mux setting.
    Supported pin number and mux varies for different SoCs, and are defined
    as macros in boot/dts/<soc>-pinfunc.h directly.

Optional properties:
- GENERIC_PINCONFIG: is the generic pinconfig options to use, bias-disable,
    bias-pull-down, bias-pull-up, input-enable, input-disable, output-low, output-high,
    input-schmitt-enable, input-schmitt-disable and drive-strength are valid.

    Some special pins have extra pull up strength, there are R0 and R1 pull-up
    resistors available, but for user, it's only need to set R1R0 as 00, 01, 10 or 11.
    So when config mediatek,pull-up-adv or mediatek,pull-down-adv,
    it support arguments for those special pins.

    When config drive-strength, it can support some arguments, such as
    MTK_DRIVE_4mA, MTK_DRIVE_6mA, etc. See dt-bindings/pinctrl/mt65xx.h.

Examples:

#include "mt8183-pinfunc.h"

...
{
	pio: pinctrl@10005000 {
		compatible = "mediatek,mt8183-pinctrl";
		reg = <0 0x10005000 0 0x1000>,
		      <0 0x11F20000 0 0x1000>,
		      <0 0x11E80000 0 0x1000>,
		      <0 0x11E70000 0 0x1000>,
		      <0 0x11E90000 0 0x1000>,
		      <0 0x11D30000 0 0x1000>,
		      <0 0x11D20000 0 0x1000>,
		      <0 0x11C50000 0 0x1000>,
		      <0 0x11F30000 0 0x1000>;
		reg-names = "iocfg0", "iocfg1", "iocfg2",
			    "iocfg3", "iocfg4", "iocfg5",
			    "iocfg6", "iocfg7", "iocfg8";
		gpio-controller;
		#gpio-cells = <2>;
		gpio-ranges = <&pio 0 0 192>;
		interrupt-controller;
		interrupts = <GIC_SPI 153 IRQ_TYPE_LEVEL_HIGH>;
		interrupt-parent = <&gic>;
		#interrupt-cells = <2>;

		i2c0_pins_a: i2c0@0 {
			pins1 {
				pinmux = <PINMUX_GPIO48__FUNC_SCL5>,
					 <PINMUX_GPIO49__FUNC_SDA5>;
				mediatek,pull-up-adv = <11>;
			};
		};

		i2c1_pins_a: i2c1@0 {
			pins {
				pinmux = <PINMUX_GPIO50__FUNC_SCL3>,
					 <PINMUX_GPIO51__FUNC_SDA3>;
				mediatek,pull-down-adv = <10>;
			};
		};
		...
	};
};
```
