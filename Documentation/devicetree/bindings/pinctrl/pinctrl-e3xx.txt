## Documentation/devicetree/bindings/power/device-idle-states.txt
```
Device idle states
========================

A device are often capable of entering a low power state(s) when it becomes
idle, hence the terminology of device idle states. Entering an idle state for a
device helps it to avoid wasting power and reduces the leakage of current.

However, entering an idle state for a device may unfortunate often also come
with a cost, as it could introduce a wakeup latency when a new request needs to
be served using the device.

Devices may support more than one idle state, where each state could have its
own specific characteristic on how it impacts power saving, wakeup latency etc.

These DT bindings can be used to describe these device idle states, but also to
assign the supported idle states to devices.


== Device idle states container node ==

The device idle states are defined within a device-idle-states node, which
provides a container where the device idle states must be listed as device tree
nodes.


== Device idle states nodes ==

To be able to distinguish between different types of device idle states, a
compatible string is assigned to each type. Currently one type is described,
but this can be extended to more types if needed.

Each device idle state node represents a device idle state description and must
be defined as a child of the device idle states container node.


== The simple device idle state type ==

For most of the simple devices this type of device idle state, is sufficient to
be able to describe the device's idle states. The supported properties can be
extended if needed, although a more complex idle state is probably better
described by using another type/compatible.

Required properties:
- compatible:		Must contain "simple-dev, idle-state".
- entry-latency-ns:	An u32 value in nano-seconds representing the worst case
			latency required for the device to enter the idle state.
- exit-latency-ns:	An u32 value in nano-seconds representing the worst case
			wakeup latency of the device, after entry-latency-ns has
			passed.

Optional properties:
- idle-state-name: A string used as a descriptive name for the idle state.


== Assigning idle states to devices ==

Required properties:
 - dev-idle-states:	A list of phandles pointing to the supported
			device idle states nodes. The list must be ordered as
			the shallower state - the earlier in the list.


== Examples ==

	device-idle-states {
		RETENTION_0: dev-retention-0 {
			compatible = "simple-dev,idle-state";
			entry-latency-ns = <300>;
			exit-latency-ns = <1000>;
		};

		SLEEP_0: dev-sleep-0 {
			compatible = "simple-dev,idle-state";
			entry-latency-us = <3000>;
			exit-latency-us = <10000>;
		};

		SLEEP_1: dev-sleep-1 {
			compatible = "simple-dev,idle-state";
			entry-latency-us = <50000>;
			exit-latency-us = <100000>;
		};
	};

	leaky-device@12340000 {
		compatible = "foo,i-leak-current";
		reg = <0x12340000 0x1000>;
		dev-idle-states = <&SLEEP_0>;
	};

	leaky-device@23450000 {
		compatible = "foo,i-leak-current";
		reg = <0x23450000 0x1000>;
		dev-idle-states = <&RETENTION_0>, <&SLEEP_0>;
	};

	leaky-device@34560000 {
		compatible = "foo,i-leak-current";
		reg = <0x34560000 0x1000>;
		dev-idle-states = <&SLEEP_1>;
	};
```

## Documentation/devicetree/bindings/power/gpio-power-switch.txt
```
GPIO Power Switch
-----------------

This is the device tree binding for simple, GPIO-driven power load switches
that do not have any control signals.

Required properties:

- compatible:           must be "gpio-power-switch"
- power-gpios:          phandle for the GPIO driving the power load switch

Optional properties:

- power-switch-name:    the name of the power switch
- power-switch-on:      the power switch GPIO is driven high by default

Example
-------

acme_probe0_power_switch: gpio_power_switch@0 {
	compatible = "gpio-power-switch";
	power-switch-name = "acme_probe0_switch";
	power-gpios = <&pca9535 1 GPIO_ACTIVE_HIGH>;
	power-switch-on;
};
```

## Documentation/devicetree/bindings/power/max8903-charger.txt
```
Maxim Semiconductor MAX8903 Battery Charger bindings

Required properties:
- compatible: "maxim,max8903-charger" for MAX8903 Battery Charger
- dc_valid: Specifies that the DC portion of the MAX8903 has been connected up
		and that dok-gpios should be specified
	- dok-gpios: Valid DC power has been detected
- usb_valid: Specifies that the USB portion of the MAX8903 has been connected up
		and that uok-gpios should be specified
	- uok-gpios: Valid USB power has been detected

Optional properties:
- cen-gpios: Charge enable pin
- chg-gpios: Charger status pin
- flt-gpios: Fault pin
- dcm-gpios: Current limit mode setting (DC or USB)
- usus-gpios: USB suspend pin


Example:

	max8903-charger {
		compatible = "maxim,max8903-charger";
		dok-gpios = <&gpio2 3 GPIO_ACTIVE_LOW>;
		flt-gpios = <&gpio2 2 GPIO_ACTIVE_LOW>;
		chg-gpios = <&gpio3 15 GPIO_ACTIVE_LOW>;
		cen-gpios = <&gpio2 5 GPIO_ACTIVE_LOW>;
		dc_valid;
		status = "okay";
	};
```

## Documentation/devicetree/bindings/power/power_domain.txt
```
* Generic PM domains

System on chip designs are often divided into multiple PM domains that can be
used for power gating of selected IP blocks for power saving by reduced leakage
current.

This device tree binding can be used to bind PM domain consumer devices with
their PM domains provided by PM domain providers. A PM domain provider can be
represented by any node in the device tree and can provide one or more PM
domains. A consumer node can refer to the provider by a phandle and a set of
phandle arguments (so called PM domain specifiers) of length specified by the
#power-domain-cells property in the PM domain provider node.

==PM domain providers==

Required properties:
 - #power-domain-cells : Number of cells in a PM domain specifier;
   Typically 0 for nodes representing a single PM domain and 1 for nodes
   providing multiple PM domains (e.g. power controllers), but can be any value
   as specified by device tree binding documentation of particular provider.

Optional properties:
 - power-domains : A phandle and PM domain specifier as defined by bindings of
                   the power controller specified by phandle.
   Some power domains might be powered from another power domain (or have
   other hardware specific dependencies). For representing such dependency
   a standard PM domain consumer binding is used. When provided, all domains
   created by the given provider should be subdomains of the domain
   specified by this binding. More details about power domain specifier are
   available in the next section.

- domain-idle-states : A phandle of an idle-state that shall be soaked into a
                generic domain power state. The idle state definitions are
                compatible with arm,idle-state specified in [1].

Example:

	power: power-controller@12340000 {
		compatible = "foo,power-controller";
		reg = <0x12340000 0x1000>;
		#power-domain-cells = <1>;
	};

The node above defines a power controller that is a PM domain provider and
expects one cell as its phandle argument.

Example 2:

	parent: power-controller@12340000 {
		compatible = "foo,power-controller";
		reg = <0x12340000 0x1000>;
		#power-domain-cells = <1>;
	};

	child: power-controller@12341000 {
		compatible = "foo,power-controller";
		reg = <0x12341000 0x1000>;
		power-domains = <&parent 0>;
		#power-domain-cells = <1>;
	};

The nodes above define two power controllers: 'parent' and 'child'.
Domains created by the 'child' power controller are subdomains of '0' power
domain provided by the 'parent' power controller.

Example 3: ARM v7 style CPU PM domains (Linux domain controller)

	cpus {
		#address-cells = <1>;
		#size-cells = <0>;

		CPU0: cpu@0 {
			device_type = "cpu";
			compatible = "arm,cortex-a7", "arm,armv7";
			reg = <0x0>;
			power-domains = <&a7_pd>;
		};

		CPU1: cpu@1 {
			device_type = "cpu";
			compatible = "arm,cortex-a15", "arm,armv7";
			reg = <0x0>;
			power-domains = <&a15_pd>;
		};
	};

	pm-domains {
		a15_pd: a15_pd {
			/* will have A15 platform ARM_PD_METHOD_OF_DECLARE*/
			compatible = "arm,cortex-a15";
			#power-domain-cells = <0>;
			domain-idle-states = <&CLUSTER_SLEEP_0>;
		};

		a7_pd: a7_pd {
			/* will have a A7 platform ARM_PD_METHOD_OF_DECLARE*/
			compatible = "arm,cortex-a7";
			#power-domain-cells = <0>;
			domain-idle-states = <&CLUSTER_SLEEP_0>, <&CLUSTER_SLEEP_1>;
		};

		CLUSTER_SLEEP_0: state0 {
			compatible = "arm,idle-state";
			entry-latency-us = <1000>;
			exit-latency-us = <2000>;
			min-residency-us = <10000>;
		};

		CLUSTER_SLEEP_1: state1 {
			compatible = "arm,idle-state";
			entry-latency-us = <5000>;
			exit-latency-us = <5000>;
			min-residency-us = <100000>;
		};
	};

==PM domain consumers==

Required properties:
 - power-domains : A phandle and PM domain specifier as defined by bindings of
                   the power controller specified by phandle.

Example:

	leaky-device@12350000 {
		compatible = "foo,i-leak-current";
		reg = <0x12350000 0x1000>;
		power-domains = <&power 0>;
	};

The node above defines a typical PM domain consumer device, which is located
inside a PM domain with index 0 of a power controller represented by a node
with the label "power".

[1]. Documentation/devicetree/bindings/arm/idle-states.txt
```

## Documentation/devicetree/bindings/power/qcom,rpmhpd.txt
```
Qualcomm RPMh Power domains

For RPMh Power domains, we communicate a performance state to RPMh
which then translates it into a corresponding voltage on a rail

Required Properties:
 - compatible: Should be one of the following
	* qcom,sdm845-rpmhpd: RPMh Power domain for the sdm845 family of SoC
 - power-domain-cells: number of cells in power domain specifier
	must be 1
 - operating-points-v2: Phandle to the OPP table for the power-domain.
	Refer to Documentation/devicetree/bindings/power/power_domain.txt
	and Documentation/devicetree/bindings/opp/qcom-opp.txt for more details

Example:

	rpmhpd: power-controller {
		compatible = "qcom,sdm845-rpmhpd";
		#power-domain-cells = <1>;
		operating-points-v2 = <&rpmhpd_opp_table>;
	};

	rpmhpd_opp_table: opp-table {
		compatible = "operating-points-v2-qcom-level";

		rpmhpd_opp_ret: opp1 {
			qcom-level = <16>;
		};

		rpmhpd_opp_min_svs: opp2 {
			qcom-level = <48>;
		};

		rpmhpd_opp_low_svs: opp3 {
			qcom-level = <64>;
		};

		rpmhpd_opp_svs: opp4 {
			qcom-level = <128>;
		};

		rpmhpd_opp_svs_l1: opp5 {
			qcom-level = <192>;
		};

		rpmhpd_opp_nom: opp6 {
			qcom-level = <256>;
		};

		rpmhpd_opp_nom_l1: opp7 {
			qcom-level = <320>;
		};

		rpmhpd_opp_nom_l2: opp8 {
			qcom-level = <336>;
		};

		rpmhpd_opp_turbo: opp9 {
			qcom-level = <384>;
		};

		rpmhpd_opp_turbo_l1: opp10 {
			qcom-level = <416>;
		};
	};
```

## Documentation/devicetree/bindings/power/qcom,rpmpd.txt
```
Qualcomm RPM Power domains

For RPM Power domains, we communicate a performance state to RPM
which then translates it into a corresponding voltage on a rail

Required Properties:
 - compatible: Should be one of the following
	* qcom,msm8996-rpmpd: RPM Power domain for the msm8996 family of SoC
 - power-domain-cells: number of cells in Power domain specifier
	must be 1.
 - operating-points-v2: Phandle to the OPP table for the Power domain.
	Refer to Documentation/devicetree/bindings/power/power_domain.txt
	and Documentation/devicetree/bindings/opp/qcom-opp.txt for more details

Example:

	rpmpd: power-controller {
		compatible = "qcom,msm8996-rpmpd";
		#power-domain-cells = <1>;
		operating-points-v2 = <&rpmpd_opp_table>;
	};

	rpmpd_opp_table: opp-table {
		compatible = "operating-points-v2-qcom-level";

		rpmpd_opp1: opp1 {
			qcom,level = <1>;
		};

		rpmpd_opp2: opp2 {
			qcom,level = <2>;
		};

		rpmpd_opp3: opp3 {
			qcom,level = <3>;
		};

		rpmpd_opp4: opp4 {
			qcom,level = <4>;
		};

		rpmpd_opp5: opp5 {
			qcom,level = <5>;
		};

		rpmpd_opp6: opp6 {
			qcom,level = <6>;
		};
	};
```

## Documentation/devicetree/bindings/power/reset/linkstation-reset.txt
```
* Buffalo Linkstation Reset Driver

Power of some Buffalo Linkstation or KuroBox Pro is managed by
micro-controller, which connects to UART1. After being fed from UART1
by a few magic numbers, the so-called power-off command,
the micro-controller will turn power off the device.

This is very similar to QNAP or Synology NAS devices, which is
described in qnap-poweroff.txt, however the command is much simpler,
only 1-byte long and without checksums.

This driver adds a handler to pm_power_off which is called to turn the
power off.

Required Properties:
- compatible: Should be "linkstation,power-off"
- reg: Address and length of the register set for UART1
- clocks: tclk clock

Example:

	reset {
		compatible = "linkstation,power-off";
		reg = <0x12100 0x100>;
		clocks = <&core_clk 0>;
	};
```

## Documentation/devicetree/bindings/power/reset/ocelot-reset.txt
```
Microsemi Ocelot reset driver

The DEVCPU_GCB:CHIP_REGS have a SOFT_RST register that can be used to reset the
SoC MIPS core.

Required Properties:
 - compatible: "mscc,ocelot-chip-reset"
 - mscc,cpucontrol: phandle to the CPU system control syscon block

Example:
		cpu_ctrl: syscon@70000000 {
			compatible = "syscon";
			reg = <0x70000000 0x2c>;
		};

		syscon@71070000 {
			compatible = "simple-mfd", "syscon";
			reg = <0x71070000 0x1c>;

			reset {
				compatible = "mscc,ocelot-chip-reset";
				mscc,cpucontrol = <&cpu_ctrl>;
			};
		};
```

## Documentation/devicetree/bindings/power/reset/reboot-mode.txt
```
Generic reboot mode core map driver

This driver get reboot mode arguments and call the write
interface to stores the magic value in special register
or ram . Then the bootloader can read it and take different
action according the argument stored.

All mode properties are vendor specific, it is a indication to tell
the bootloder what to do when the system reboot, and should be named
as mode-xxx = <magic> (xxx is mode name).

- mode-normal: Normal reboot mode, system reboot with command "reboot".
- mode-recovery: Android Recovery mode, it is a mode to format the device or update a new image.
- mode-fastboot: Android fastboot mode, it's a mode to  re-flash partitions on the device.
- mode-loader: A bootloader mode, it's a mode used to download image on Rockchip platform,
	       usually used in development.
- mode-maskrom: It's a mode to download bootloader on Rockchip platform.

Example:
	reboot-mode {
		mode-normal = <BOOT_NORMAL>;
		mode-recovery = <BOOT_RECOVERY>;
		mode-fastboot = <BOOT_FASTBOOT>;
		mode-loader = <BOOT_LOADER>;
		mode-maskrom = <BOOT_MASKROM>;
	}
```

## Documentation/devicetree/bindings/power/reset/renesas-reset.txt
```
Device-Tree bindings for Renesas WDT reset functionality

Required properties:
  - compatible: must be one or more of the following:
    - "renesas,r7s72100-reset" for the r7s72100 SoC
    - "renesas,wdt-reset"
                This is a fallback for the above renesas,*-reset entries

  - reg: base address and length of the WDT register block

Example node:
	wdt: timer@fcfe0000 {
		compatible = "renesas,r7s72100-reset", "renesas,wdt-reset";
		reg = <0xfcfe0000 0x6>;
	};
```
