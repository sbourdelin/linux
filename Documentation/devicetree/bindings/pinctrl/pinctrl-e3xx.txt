## Documentation/devicetree/bindings/power/reset/sram-reboot-mode.txt
```
SRAM reboot mode driver

This driver get reboot mode magic value form reboot-mode driver
and stores it in a SRAM address. Then the bootloader
can read it and take different action according to the magic
value stored.

This DT node should be represented as a sub-node of a "mmio-sram" node.

Required properties:
- compatible: should be "sram-reboot-mode"
- reg: offset from the sram range where to store the magic value(in bytes)

The rest of the properties should follow the generic reboot-mode discription
found in reboot-mode.txt

Example:

	sram@5f01000 {
		compatible = "mmio-sram";
		reg = <0x0 0x05f01000 0x0 0x00001000>;
		ranges = <0x0 0x0 0x05f01000 0x00001000>;

		#address-cells = <1>;
		#size-cells = <1>;

		reboot-mode@0 {
			compatible = "sram-reboot-mode";
			reg = <0x0 0x4>;

			mode-normal     = <0x77665501>;
			mode-bootloader = <0x77665500>;
			mode-recovery   = <0x77665502>;
		};
	};
```

## Documentation/devicetree/bindings/power/rockchip-cpu-avs.txt
```
Rockchip cpu avs device tree bindings
-------------------------------------

Under the same frequency, the operating voltage tends to decrease with
increasing leakage. so it is necessary to adjust opp's voltage according
to leakage for power.


Required properties:
- compatible: Should be one of the following.
  - "rockchip,rk3399-cpu-avs" - for RK3399 SoCs.
- leakage-volt-<name>: Named leakage-volt property. At runtime, the
  platform can find a cpu's cluster_id according to it's cpu_id and match
  leakage-volt-<name> property. The property is an array of 3-tuples
  items, and each item consists of leakage and voltage like
  <min-leakage-mA max-leakage-mA vol-uV>.
	min-leakage: minimum leakage in mA.
	max-leakage: maximum leakage in mA.
	vol: voltage in microvolt.

Example:

	cpu_avs: cpu-avs {
		compatible = "rockchip,rk3399-cpu-avs";
		leakage-volt-cluster0 = <
		/*  mA        mA         uV*/
		    0         100        0
		    101       200        (-25000)
		    201       300        (-50000)
		>;
		leakage-volt-cluster1 = <
		/*  mA        mA         uV*/
		    0         100        0
		    101       200        (-25000)
		    201       300        (-50000)
		>;
	};
```

## Documentation/devicetree/bindings/power/sbs,sbs-manager.txt
```
Binding for sbs-manager

Required properties:
- compatible: should be "lltc,ltc1760" or use "sbs,sbs-manager" as fallback.
- reg: integer, i2c address of the device. Should be <0xa>.

From OS view the device is basically an i2c-mux used to communicate with up to
four smart battery devices at address 0xb. The driver actually implements this
behaviour. So standard i2c-mux nodes can be used to register up to four slave
batteries. See Documentation/devicetree/bindings/i2c/i2c-mux.txt for more
information on i2c-mux nodes. Channels will be numerated starting from 1 to 4.

Example:

batman@0a {
    compatible = "lltc,ltc1760";
    reg = <0x0a>;
    #address-cells = <1>;
    #size-cells = <0>;

    i2c@1 {
        #address-cells = <1>;
        #size-cells = <0>;
        reg = <1>;

        battery@0b {
            compatible = "ti,bq2060", "sbs,sbs-battery";
            reg = <0x0b>;
        };
    };

    i2c@2 {
        #address-cells = <1>;
        #size-cells = <0>;
        reg = <2>;

        battery@0b {
            compatible = "ti,bq2060", "sbs,sbs-battery";
            reg = <0x0b>;
        };
    };

    i2c@3 {
        #address-cells = <1>;
        #size-cells = <0>;
        reg = <3>;

        battery@0b {
            compatible = "ti,bq2060", "sbs,sbs-battery";
            reg = <0x0b>;
        };
    };
};
```
