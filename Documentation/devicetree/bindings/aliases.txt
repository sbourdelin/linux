## Documentation/devicetree/bindings/aliases.txt
```
The aliases node
----------------

The aliases node contains properties that represent aliases to device tree
nodes. The name of the property is the alias name, the value is the path of
a the device tree node that corresponds to the alias. The path may be
specified as a string or a phandle.

Alias names are often suffixed with a numeric ID, especially when there may
be multiple instances of the same type. The ID typically corresponds to the
hardware layout, it may also be used by drivers for a stable mapping of
device names and hardware entities.

Alias names
-----------

The devicetree specification doesn't require the use of specific alias
names to refer to hardware entities of a given type, however the Linux
kernel aims for a certain level of consistency.

The following standardized alias names shall be used for their
corresponding hardware components:

  bluetoothN		Bluetooth controller
  ethernetN		Ethernet interface
  gpioN			GPIO controller
  i2cN			i2c bus
  mmcN			MMC bus
  rtcN			Real time clock
  serialN		UART port
  spiN			SPI bus
  wifiN			Wireless network interface

The above list is not exhaustive and will be extended over time. Please
send patches to devicetree@vger.kernel.org if you think a hardware
component and its alias name should be on the list.

Example
-------

aliases {
	bluetooth0 = "/soc/serial@fdf01000/bluetooth";
	rtc0 = &rtc0;
	wifi0 = &wlcore;
};

(based on arch/arm64/boot/dts/hisilicon/hi3660-hikey960.dts)
```

## Documentation/devicetree/bindings/arm/acts.txt
```
Actions Semi platforms device tree bindings
-------------------------------------------


S500 SoC
========

Required root node properties:

 - compatible :  "acts,s500"


Modules:

 - LeMaker Guitar: "lemaker,guitar"

Boards:

 - LeMaker Guitar Base Board rev. B: "lemaker,guitar-bb-rev-b", "lemaker,guitar"


S900 SoC
========

Required root node properties:

- compatible :  "acts,s900"


Boards:

 - uCRobotics Bubblegum-96: "ucrobotics,bubblegum-96"
```

## Documentation/devicetree/bindings/arm/atmel-pmc.txt
```
* Power Management Controller (PMC)

Required properties:
- compatible: Should be "atmel,<chip>-pmc".
	<chip> can be: at91rm9200, at91sam9260, at91sam9g45, at91sam9n12,
	at91sam9x5, sama5d3

- reg: Should contain PMC registers location and length

Examples:
	pmc: pmc@fffffc00 {
		compatible = "atmel,at91rm9200-pmc";
		reg = <0xfffffc00 0x100>;
	};

PMC Fast Startup Signals

The PMC Fast Start Signals are used as the wake up source to trigger the PMC
to wake up the system from the ULP1 mode.

required properties:
- compatible: Should be "atmel,sama5d2-pmc-fast-startup".

optional properties:
- atmel,wkup-trigger: boolean, WKUP input can trigger a fast restart signal.
- atmel,secumod-trigger: boolean, SECUMOD can trigger a fast restart signal.
- atmel,piobu0-trigger: boolean, PIOBU0 input can trigger a fast restart signal.
- atmel,piobu1-trigger: boolean, PIOBU1 input can trigger a fast restart signal.
- atmel,piobu2-trigger: boolean, PIOBU2 input can trigger a fast restart signal.
- atmel,piobu3-trigger: boolean, PIOBU3 input can trigger a fast restart signal.
- atmel,piobu4-trigger: boolean, PIOBU4 input can trigger a fast restart signal.
- atmel,piobu5-trigger: boolean, PIOBU5 input can trigger a fast restart signal.
- atmel,piobu6-trigger: boolean, PIOBU6 input can trigger a fast restart signal.
- atmel,piobu7-trigger: boolean, PIOBU7 input can trigger a fast restart signal.
- atmel,gmac-wol-trigger: boolean, GMAC_WOL can trigger a fast restart signal.
- atmel,rtc-alarm-trigger: boolean, RTC alarm can trigger a fast restart signal.
- atmel,usb-resume-trigger: boolean, USB resume can trigger a fast restart
  signal.
- atmel,sdmmc-cd-trigger: boolean, SDMMC card detect can trigger a fast
  restart signal.
- atmel,rxlp-match-trigger: boolean, Matching condition on RXLP can trigger
  a fast restart signal.
- atmel,acc-comparison-trigger: boolean, ACC comparison can trigger a fast
  restart signal.

- atmel,wkup-trigger-level: int, defines the active polarity of the wake-up
  input. Supported values are: 1 or 0.
- atmel,piobu0-trigger-level: int, defines the active polarity of
  the corresponding PIOBU0 input. Supported values are: 1 or 0.
- atmel,piobu1-trigger-level: int, defines the active polarity of
  the corresponding PIOBU1 input. Supported values are: 1 or 0.
- atmel,piobu2-trigger-level: int, defines the active polarity of
  the corresponding PIOBU2 input. Supported values are: 1 or 0".
- atmel,piobu3-trigger-level: int, defines the active polarity of
  the corresponding PIOBU3 input. Supported values are: 1 or 0.
- atmel,piobu4-trigger-level: int, defines the active polarity of
  the corresponding PIOBU4 input. Supported values are: 1 or 0.
- atmel,piobu5-trigger-level: int, defines the active polarity of
  the corresponding PIOBU5 input. Supported values are: 1 or 0.
- atmel,piobu6-trigger-level: int, defines the active polarity of
  the corresponding PIOBU6 input. Supported values are: 1 or 0.
- atmel,piobu7-trigger-level: int, defines the active polarity of
  the corresponding PIOBU7 input. Supported values are: 1 or 0.

Example:

	pmc: pmc@f0014000 {
		compatible = "atmel,sama5d2-pmc";
		reg = <0xf0014000 0x160>;

		pmc_fast_restart {
			compatible = "atmel,sama5d2-pmc-fast-startup";
			atmel,wkup-trigger;
			atmel,rtc-alarm-trigger;
			atmel,wkup-trigger-level = <0>;
		};
	};
```

## Documentation/devicetree/bindings/arm/axis.txt
```
Axis Communications AB
ARTPEC series SoC Device Tree Bindings

ARTPEC-6 ARM SoC
================

Required root node properties:
- compatible = "axis,artpec6";

ARTPEC-6 DMA Configuration
--------------------------

The DMA configuration unit muxes dma request lines between single and burst
alternatives.

Required properties:
- compatible: axis,artpec6-dmacfg
- reg: Address and length of DMACFG register.

Example:
	dmacfg {
		compatible = "axis,artpec6-dmacfg";
		reg = <0xf8000010 4>;
	};

ARTPEC-6 Development board:
---------------------------
Required root node properties:
- compatible = "axis,artpec6-dev-board", "axis,artpec6";
```

## Documentation/devicetree/bindings/arm/bcm/brcm,bcm4708.txt
```
Broadcom BCM4708 device tree bindings
-------------------------------------------

Boards with the BCM4708 SoC shall have the following properties:

Required root node property:

bcm94708
compatible = "brcm,bcm4708";

bcm94709
compatible = "brcm,bcm4709";

bcm953012
compatible = "brcm,bcm53012";
```

## Documentation/devicetree/bindings/arm/cavium-thunder2.txt
```
Cavium Thunder2 Family device tree bindings
-------------------------------------------

Boards with Cavium ThunderX2 CN99XX shall have the root property:
  compatible = "cavium,thunder-99xx";
```

## Documentation/devicetree/bindings/arm/compulab-boards.txt
```
CompuLab SB-SOM is a multi-module baseboard capable of carrying CM-T43, CM-T54,
and QS-600 modules with minor modifications to the SB-SOM assembly.

Required root node properties:
    - compatible = should be "compulab,sb-som"
```

## Documentation/devicetree/bindings/arm/cpu-capacity.txt
```
==========================================
ARM CPUs capacity bindings
==========================================

==========================================
1 - Introduction
==========================================

ARM systems may be configured to have cpus with different power/performance
characteristics within the same chip. In this case, additional information
has to be made available to the kernel (the scheduler in particular) for
it to be aware of such differences and take decisions accordingly.

==========================================
2 - CPU capacity definition
==========================================

CPU capacity is a number that provides the scheduler information about CPUs
heterogeneity. Such heterogeneity can come from micro-architectural differences
(e.g., ARM big.LITTLE systems) or maximum frequency at which CPUs can run
(e.g., SMP systems with multiple frequency domains). Heterogeneity in this
context is about differing performance characteristics; this binding tries to
capture a first-order approximation of the relative performance of CPUs.

One simple way to estimate CPU capacities is to iteratively run a well-known
CPU user space benchmark (e.g, sysbench, dhrystone, etc.) on each CPU at
maximum frequency and then normalize values w.r.t.  the best performing CPU.
One can also do a statistically significant study of a wide collection of
benchmarks, but pros of such an approach are not really evident at the time of
writing.

==========================================
3 - capacity-scale
==========================================

CPUs capacities are defined with respect to capacity-scale property in the cpus
node [1]. The property is optional; if not defined a 1024 capacity-scale is
assumed. This property defines both the highest CPU capacity present in the
system and granularity of CPU capacity values.

==========================================
4 - capacity
==========================================

capacity is an optional cpu node [1] property: u32 value representing CPU
capacity, relative to capacity-scale. It is required and enforced that capacity
<= capacity-scale.

===========================================
5 - Examples
===========================================

Example 1 (ARM 64-bit, 6-cpu system, two clusters):
capacity-scale is not defined, so it is assumed to be 1024

cpus {
	#address-cells = <2>;
	#size-cells = <0>;

	cpu-map {
		cluster0 {
			core0 {
				cpu = <&A57_0>;
			};
			core1 {
				cpu = <&A57_1>;
			};
		};

		cluster1 {
			core0 {
				cpu = <&A53_0>;
			};
			core1 {
				cpu = <&A53_1>;
			};
			core2 {
				cpu = <&A53_2>;
			};
			core3 {
				cpu = <&A53_3>;
			};
		};
	};

	idle-states {
		entry-method = "arm,psci";

		CPU_SLEEP_0: cpu-sleep-0 {
			compatible = "arm,idle-state";
			arm,psci-suspend-param = <0x0010000>;
			local-timer-stop;
			entry-latency-us = <100>;
			exit-latency-us = <250>;
			min-residency-us = <150>;
		};

		CLUSTER_SLEEP_0: cluster-sleep-0 {
			compatible = "arm,idle-state";
			arm,psci-suspend-param = <0x1010000>;
			local-timer-stop;
			entry-latency-us = <800>;
			exit-latency-us = <700>;
			min-residency-us = <2500>;
		};
	};

	A57_0: cpu@0 {
		compatible = "arm,cortex-a57","arm,armv8";
		reg = <0x0 0x0>;
		device_type = "cpu";
		enable-method = "psci";
		next-level-cache = <&A57_L2>;
		clocks = <&scpi_dvfs 0>;
		cpu-idle-states = <&CPU_SLEEP_0 &CLUSTER_SLEEP_0>;
		capacity = <1024>;
	};

	A57_1: cpu@1 {
		compatible = "arm,cortex-a57","arm,armv8";
		reg = <0x0 0x1>;
		device_type = "cpu";
		enable-method = "psci";
		next-level-cache = <&A57_L2>;
		clocks = <&scpi_dvfs 0>;
		cpu-idle-states = <&CPU_SLEEP_0 &CLUSTER_SLEEP_0>;
		capacity = <1024>;
	};

	A53_0: cpu@100 {
		compatible = "arm,cortex-a53","arm,armv8";
		reg = <0x0 0x100>;
		device_type = "cpu";
		enable-method = "psci";
		next-level-cache = <&A53_L2>;
		clocks = <&scpi_dvfs 1>;
		cpu-idle-states = <&CPU_SLEEP_0 &CLUSTER_SLEEP_0>;
		capacity = <447>;
	};

	A53_1: cpu@101 {
		compatible = "arm,cortex-a53","arm,armv8";
		reg = <0x0 0x101>;
		device_type = "cpu";
		enable-method = "psci";
		next-level-cache = <&A53_L2>;
		clocks = <&scpi_dvfs 1>;
		cpu-idle-states = <&CPU_SLEEP_0 &CLUSTER_SLEEP_0>;
		capacity = <447>;
	};

	A53_2: cpu@102 {
		compatible = "arm,cortex-a53","arm,armv8";
		reg = <0x0 0x102>;
		device_type = "cpu";
		enable-method = "psci";
		next-level-cache = <&A53_L2>;
		clocks = <&scpi_dvfs 1>;
		cpu-idle-states = <&CPU_SLEEP_0 &CLUSTER_SLEEP_0>;
		capacity = <447>;
	};

	A53_3: cpu@103 {
		compatible = "arm,cortex-a53","arm,armv8";
		reg = <0x0 0x103>;
		device_type = "cpu";
		enable-method = "psci";
		next-level-cache = <&A53_L2>;
		clocks = <&scpi_dvfs 1>;
		cpu-idle-states = <&CPU_SLEEP_0 &CLUSTER_SLEEP_0>;
		capacity = <447>;
	};

	A57_L2: l2-cache0 {
		compatible = "cache";
	};

	A53_L2: l2-cache1 {
		compatible = "cache";
	};
};

Example 2 (ARM 32-bit, 4-cpu system, two clusters,
	   cpus 0,1@1GHz, cpus 2,3@500MHz):
capacity-scale is equal to 2, so first cluster is twice faster than second
cluster (which matches with clock frequencies)

cpus {
	#address-cells = <1>;
	#size-cells = <0>;
	capacity-scale = <2>;

	cpu0: cpu@0 {
		device_type = "cpu";
		compatible = "arm,cortex-a15";
		reg = <0>;
		capacity = <2>;
	};

	cpu1: cpu@1 {
		device_type = "cpu";
		compatible = "arm,cortex-a15";
		reg = <1>;
		capacity = <2>;
	};

	cpu2: cpu@2 {
		device_type = "cpu";
		compatible = "arm,cortex-a15";
		reg = <0x100>;
		capacity = <1>;
	};

	cpu3: cpu@3 {
		device_type = "cpu";
		compatible = "arm,cortex-a15";
		reg = <0x101>;
		capacity = <1>;
	};
};

===========================================
6 - References
===========================================

[1] ARM Linux Kernel documentation - CPUs bindings
    Documentation/devicetree/bindings/arm/cpus.txt
```

## Documentation/devicetree/bindings/arm/freescale/fsl,vf610-soc.txt
```
Vybrid System-on-Chip
---------------------

Required properties:

- compatible: "fsl,vf610-soc"
- rom-revision: phandle to the on-chip ROM node
- mscm: phandle to the MSCM CPU configuration node
- nvmem-cells: phandles to two OCOTP child nodes ocotp_cfg0 and ocotp_cfg1
- nvmem-cell-names: should contain string names "cfg0" and "cfg1"

Example:

	vf610-soc {
		compatible = "fsl,vf610-soc";
		rom-revision = <&ocrom>;
		mscm = <&mscm_cpucfg>;
		nvmem-cells = <&ocotp_cfg0>, <&ocotp_cfg1>;
		nvmem-cell-names = "cfg0", "cfg1";
	};
```

## Documentation/devicetree/bindings/arm/hisilicon/djtag.txt
```
The Hisilicon Djtag is an independent component which connects with some other
components in the SoC by Debug Bus. The djtag is available in CPU and IO dies
in the chip. The djtag controls access to connecting modules of CPU and IO
dies.
The various connecting components in CPU die (like L3 cache, L3 cache PMU etc.)
are accessed by djtag during real time debugging. In IO die there are connecting
components like RSA. These components appear as devices attached to djtag bus.

Hisilicon HiP05/06/07 djtag for CPU and IO die
Required properties:
  - compatible : The value should be as follows
	(a) "hisilicon,hip05-djtag-v1" for CPU and IO die which use v1 hw in
	    HiP05 chipset.
	(b) "hisilicon,hip06-djtag-v1" for CPU die which use v1 hw in HiP06 chipset.
	(c) "hisilicon,hip06-djtag-v2" for IO die which use v2 hw in HiP06 chipset.
	(d) "hisilicon,hip07-djtag-v2" for CPU and IO die which use v2 hw in
	    HiP07 chipset.
  - reg : Register address and size
  - hisi-scl-id : The Super Cluster ID for CPU or IO die

Example 1: Djtag for CPU die

	/* for Hisilicon HiP05 djtag for CPU Die */
	djtag0: djtag@80010000 {
		compatible = "hisilicon,hip05-djtag-v1";
		reg = <0x0 0x80010000 0x0 0x10000>;
		hisi-scl-id = <0x02>;

		/* All connecting components will appear as child nodes */
	};

Example 2: Djtag for IO die

	/* for Hisilicon HiP05 djtag for IO Die */
	djtag1: djtag@d0000000 {
		compatible = "hisilicon,hip05-djtag-v1";
		reg = <0x0 0xd0000000 0x0 0x10000>;
		hisi-scl-id = <0x01>;

		/* All connecting components will appear as child nodes */
	};
```

## Documentation/devicetree/bindings/arm/marvell/98dx3236.txt
```
Marvell 98DX3236, 98DX3336 and 98DX4251 Platforms Device Tree Bindings
----------------------------------------------------------------------

Boards with a SoC of the Marvell 98DX3236, 98DX3336 and 98DX4251 families
shall have the following property:

Required root node property:

compatible: one of "marvell,armadaxp-98dx3236", "marvell,armadaxp-98dx3336"
            or "marvell,armadaxp-98dx4251"
```

## Documentation/devicetree/bindings/arm/marvell/iap140.txt
```
Marvell IAP140 Device Tree Bindings
-----------------------------------

Boards using a SoC of the Marvell IAP140 family must carry the following
root node property:

 - compatible :  must contain "mrvl,iap140"
```
