## Documentation/devicetree/bindings/arm/marvell/mv98dx3236-soc-id.txt
```
Marvell 98dx3236 SoC ID
---------------------------------------------------------------

Required properties:

- compatible: Should be "marvell,mv98dx3236-soc-id".

- reg: should be the register base and length as documented in the
  datasheet for the Device ID Status

soc-id@f8244 {
	compatible = "marvell,mv98dx3236-soc-id";
	reg = <0xf8244 0x4>;
};
```

## Documentation/devicetree/bindings/arm/mbigen.txt
```
Hisilicon mbigen device tree bindings.
=======================================

Mbigen means: message based interrupt generator.

MBI is kind of msi interrupt only used on Non-PCI devices.

To reduce the wired interrupt number connected to GIC,
Hisilicon designed mbigen to collect and generate interrupt.


Non-pci devices can connect to mbigen and generate the
interrupt by writing ITS register.

The mbigen chip and devices connect to mbigen have the following properties:

Mbigen main node required properties:
-------------------------------------------
- compatible: Should be "hisilicon,mbigen-v2"
- reg: Specifies the base physical address and size of the Mbigen
  registers.
- interrupt controller: Identifies the node as an interrupt controller
- msi-parent: This property has two cells.
	The 1st cell specifies the ITS this device connected.
	The 2nd cell specifies the device id.
- nr-msis:Specifies the total number of interrupt this device has.
- #interrupt-cells : Specifies the number of cells needed to encode an
  interrupt source. The value is 2 now.

  The 1st cell is global hardware pin number of the interrupt.
		This value depends on the Soc design.
  The 2nd cell is the interrupt trigger type.

Examples:

 	mbigen_device_gmac:intc {
			compatible = "hisilicon,mbigen-v2";
			reg = <0x0 0xc0080000 0x0 0x10000>;
			interrupt-controller;
			msi-parent = <&its_dsa 0x40b1c>;
			num-msis = <9>;
			#interrupt-cells = <2>;
 	};

Devices connect to mbigen required properties:
----------------------------------------------------
-interrupt-parent: Specifies the mbigen device node which device connected.
-interrupts:specifies the interrupt source.
  The 1st cell is global hardware pin number of the interrupt.
		This value depends on the Soc design.
  The 2nd cell is the interrupt trigger type

Examples:
	gmac0: ethernet@c2080000 {
		#address-cells = <1>;
		#size-cells = <0>;
		reg = <0 0xc2080000 0 0x20000>,
		      <0 0xc0000000 0 0x1000>;
		interrupt-parent  = <&mbigen_device_gmac>;
		interrupts =	<656 1>,
				<657 1>;
	};
```

## Documentation/devicetree/bindings/arm/mediatek/mediatek,audsys.txt
```
MediaTek Audio Subsystem
============================
The audio subsystem is one of the multi-function blocks of MediaTek SoCs.
It contains a system controller, which provides a number registers giving
access to two features: AUDSYS clocks and Audio Front End (AFE) components.

For the top level node:
- compatible: must be: "syscon", "simple-mfd";
- reg: register area of the Audio Subsystem

Required sub-nodes:

AUDSYS clocks:
-------
The MediaTek AUDSYS controller provides various clocks to the system.

Required Properties:

- compatible: Should be one of:
	- "mediatek,mt2701-audsys";
	- "mediatek,mt7622-audsys";
- #clock-cells: Must be 1

The AUDSYS controller uses the common clk binding from
Documentation/devicetree/bindings/clock/clock-bindings.txt
The available clocks are defined in dt-bindings/clock/mt*-clk.h.

AFE components:
-------
For common binding part and usage, refer to
../sonud/mt2701-afe-pcm.txt.

Example:

	audio-subsystem@11220000 {
		compatible = "syscon", "simple-mfd";
		reg = <0 0x11220000 0 0x2000>;

		audsys: clock {
			compatible = "mediatek,mt2701-audsys";
			#clock-cells = <1>;
		};

		...
	};
```

## Documentation/devicetree/bindings/arm/mediatek/mediatek,camsys.txt
```
MediaTek CAMSYS controller
============================

The MediaTek CAMSYS controller provides various clocks to the system.

Required Properties:

- compatible: Should be one of:
	- "mediatek,mt6765-camsys", "syscon"
- #clock-cells: Must be 1

The AUDSYS controller uses the common clk binding from
Documentation/devicetree/bindings/clock/clock-bindings.txt
The available clocks are defined in dt-bindings/clock/mt*-clk.h.

Required sub-nodes:
-------
For common binding part and usage, refer to
../sonud/mt2701-afe-pcm.txt.

Example:

camsys: camsys@1a000000  {
	compatible = "mediatek,mt6765-camsys", "syscon";
	reg = <0 0x1a000000  0 0x1000>;
	#clock-cells = <1>;
};
```

## Documentation/devicetree/bindings/arm/mediatek/mediatek,mipi0a.txt
```
Mediatek mipi_rx_ana_csi0a controller
============================

The Mediatek mipi_rx_ana_csi0a controller provides various clocks
to the system.

Required Properties:

- compatible: Should be one of:
	- "mediatek,mt6765-mipi_rx_ana_csi0a", "syscon"
- #clock-cells: Must be 1

The vencsys controller uses the common clk binding from
Documentation/devicetree/bindings/clock/clock-bindings.txt
The available clocks are defined in dt-bindings/clock/mt*-clk.h.

Example:

mipi_rx_ana_csi0a: mipi_rx_ana_csi0a@11c10000 {
	compatible = "mediatek,mt6765-mipi_rx_ana_csi0a", "syscon";
	reg = <0 0x11c10000 0 0x1000>;
	#clock-cells = <1>;
};
```

## Documentation/devicetree/bindings/arm/msm/cmd-db.txt
```
Command DB
---------

Command DB is a database that provides a mapping between resource key and the
resource address for a system resource managed by a remote processor. The data
is stored in a shared memory region and is loaded by the remote processor.

Some of the Qualcomm Technologies Inc SoC's have hardware accelerators for
controlling shared resources. Depending on the board configuration the shared
resource properties may change. These properties are dynamically probed by the
remote processor and made available in the shared memory.

The devicetree representation of the command DB driver should be:

PROPERTIES:
- compatible:
	Usage: required
	Value type: <string>
	Definition: Should be "qcom,cmd-db"

- memory-region:
	Usage: required
	Value type: <phandle>
	Definition: The phandle to the reserved memory region.

Example:

	reserved-memory {
		[...]
		cmd_db_mem: qcom,cmd-db@c3f000c {
			reg = <0x0 0xc3f000c 0x0 0x8>;
		};
	};

	qcom,cmd-db@c3f000c {
		compatible = "qcom,cmd-db";
		memory-region = <&cmd_db_mem>;
	};
```

## Documentation/devicetree/bindings/arm/msm/qcom,llcc.txt
```
* LLCC (Last Level Cache Controller)

Properties:
- compatible:
	Usage: required
	Value type: <string>
	Definition: must be "qcom,llcc-core"

- reg:
	Usage: required
	Value Type: <prop-encoded-array>
	Definition: must be addresses and sizes of the LLCC registers

- llcc-bank-off:
	Usage: required
	Value Type: <u32 array>
	Definition: Offsets of llcc banks from llcc base address starting from
		    LLCC bank0.

- llcc-broadcast-off:
	Usage: required
	Value Type: <u32>
	Definition: Offset of broadcast register from LLCC bank0 address.

- #cache-cells:
	Usage: required
	Value Type: <u32>
	Definition: Number of cache cells, must be 1

- max-slices:
	usage: required
	Value Type: <u32>
	Definition: Number of cache slices supported by hardware

- status:
	Usage: optional
	Value type: <string>
	Definition: Property to enable or disable the driver

== llcc amon device ==

Properties:
-qcom,fg-cnt : The value of fine grained counter of activity monitor
	        block.

compatible devices:
		qcom,sdm845-llcc

Example:

	qcom,system-cache@1300000 {
		compatible = "qcom,llcc-core", "syscon", "simple-mfd";
		reg = <0x1300000 0x50000>;
		reg-names = "llcc_base";

		llcc: qcom,sdm845-llcc {
			compatible = "qcom,sdm845-llcc";
			#cache-cells = <1>;
			max-slices = <32>;
		};

		qcom,llcc-ecc {
			compatible = "qcom,llcc-ecc";
		};

		qcom,llcc-amon {
			compatible = "qcom,llcc-amon";
			qcom,fg-cnt = <0x7>;
		};

	};

== Client ==

Properties:
- cache-slice-names:
	Usage: required
	Value type: <stringlist>
	Definition: A set of names that identify the usecase names of a client that uses
		    cache slice. These strings are used to look up the cache slice
		    entries by name.

- cache-slices:
	Usage: required
	Value type: <prop-encoded-array>
	Definition: The tuple has phandle to llcc device as the first argument and the
		    second argument is the usecase id of the client.
For example:

	video-decoder-encoder {
		cache-slice-names = "vidsc0", "vidsc1";
		cache-slices = <&llcc 2>, <&llcc 3>;
	};
```

## Documentation/devicetree/bindings/arm/msm/ssbi.txt
```
* Qualcomm SSBI

Some Qualcomm MSM devices contain a point-to-point serial bus used to
communicate with a limited range of devices (mostly power management
chips).

These require the following properties:

- compatible: "qcom,ssbi"

- qcom,controller-type
  indicates the SSBI bus variant the controller should use to talk
  with the slave device.  This should be one of MSM_SBI_CTRL_SSBI,
  MSM_SBI_CTRL_SSBI2 or MSM_SBI_CTRL_PMIC_ARBITER.
  The type chosen is determined by the attached slave.

The slave device should be the single child node of the ssbi device
with a compatible field.
```

## Documentation/devicetree/bindings/arm/npcm/npcm.txt
```
NPCM Platforms Device Tree Bindings
-----------------------------------
NPCM750 SoC
Required root node properties:
	- compatible = "nuvoton,npcm750";
	- enable-method = "nuvoton,npcm7xx-smp"; required for dual core variant.
```

## Documentation/devicetree/bindings/arm/psci.txt
```
* Power State Coordination Interface (PSCI)

Firmware implementing the PSCI functions described in ARM document number
ARM DEN 0022A ("Power State Coordination Interface System Software on ARM
processors") can be used by Linux to initiate various CPU-centric power
operations.

Issue A of the specification describes functions for CPU suspend, hotplug
and migration of secure software.

Functions are invoked by trapping to the privilege level of the PSCI
firmware (specified as part of the binding below) and passing arguments
in a manner similar to that specified by AAPCS:

	 r0		=> 32-bit Function ID / return value
	{r1 - r3}	=> Parameters

Note that the immediate field of the trapping instruction must be set
to #0.


Main node required properties:

 - compatible    : should contain at least one of:

     * "arm,psci"     : For implementations complying to PSCI versions prior
			to 0.2.
			For these cases function IDs must be provided.

     * "arm,psci-0.2" : For implementations complying to PSCI 0.2.
			Function IDs are not required and should be ignored by
			an OS with PSCI 0.2 support, but are permitted to be
			present for compatibility with existing software when
			"arm,psci" is later in the compatible list.

     * "arm,psci-1.0" : For implementations complying to PSCI 1.0.
			PSCI 1.0 is backward compatible with PSCI 0.2 with
			minor specification updates, as defined in the PSCI
			specification[2].

 - method        : The method of calling the PSCI firmware. Permitted
                   values are:

                   "smc" : SMC #0, with the register assignments specified
		           in this binding.

                   "hvc" : HVC #0, with the register assignments specified
		           in this binding.

Main node optional properties:

 - cpu_suspend   : Function ID for CPU_SUSPEND operation

 - cpu_off       : Function ID for CPU_OFF operation

 - cpu_on        : Function ID for CPU_ON operation

 - migrate       : Function ID for MIGRATE operation

Device tree nodes that require usage of PSCI CPU_SUSPEND function (ie idle
state nodes, as per bindings in [1]) must specify the following properties:

- arm,psci-suspend-param
		Usage: Required for state nodes[1] if the corresponding
                       idle-states node entry-method property is set
                       to "psci".
		Value type: <u32>
		Definition: power_state parameter to pass to the PSCI
			    suspend call.

Example:

Case 1: PSCI v0.1 only.

	psci {
		compatible	= "arm,psci";
		method		= "smc";
		cpu_suspend	= <0x95c10000>;
		cpu_off		= <0x95c10001>;
		cpu_on		= <0x95c10002>;
		migrate		= <0x95c10003>;
	};

Case 2: PSCI v0.2 only

	psci {
		compatible	= "arm,psci-0.2";
		method		= "smc";
	};

Case 3: PSCI v0.2 and PSCI v0.1.

	A DTB may provide IDs for use by kernels without PSCI 0.2 support,
	enabling firmware and hypervisors to support existing and new kernels.
	These IDs will be ignored by kernels with PSCI 0.2 support, which will
	use the standard PSCI 0.2 IDs exclusively.

	psci {
		compatible = "arm,psci-0.2", "arm,psci";
		method = "hvc";

		cpu_on = < arbitrary value >;
		cpu_off = < arbitrary value >;

		...
	};

PSCI v1.0 onwards, supports OS-Initiated mode for powering off CPU domains
from the firmware. Such PM domains for which the PSCI firmware driver acts as
pseudo-controller, may also be specified in the DT under the psci node. The
domain definitions must follow the domain idle state specifications per [3].
The domain states themselves must be compatible with 'arm,idle-state' defined
in [1] and need to specify the arm,psci-suspend-param property for each idle
state.

More information on defining CPU PM domains is available in [4].

Example: OS-Iniated PSCI based PM domains with 1 CPU in each domain

	cpus {
		#address-cells = <1>;
		#size-cells = <0>;

		CPU0: cpu@0 {
			device_type = "cpu";
			compatible = "arm,cortex-a53", "arm,armv8";
			reg = <0x0>;
			enable-method = "psci";
			cpu-idle-states = <&CPU_PWRDN>;
			power-domains = <&CPU_PD0>;
		};

		CPU1: cpu@1 {
			device_type = "cpu";
			compatible = "arm,cortex-a57", "arm,armv8";
			reg = <0x100>;
			enable-method = "psci";
			cpu-idle-states = <&CPU_PWRDN>;
			power-domains = <&CPU_PD1>;
		};

		idle-states {
			CPU_PWRDN: cpu_power_down{
				compatible = "arm,idle-state";
				arm,psci-suspend-param = <0x000001>;
				entry-latency-us = <10>;
				exit-latency-us = <10>;
				min-residency-us = <100>;
			};

			CLUSTER_RET: domain_ret {
				compatible = "arm,idle-state";
				arm,psci-suspend-param = <0x1000010>;
				entry-latency-us = <500>;
				exit-latency-us = <500>;
				min-residency-us = <2000>;
			};

			CLUSTER_PWR_DWN: domain_gdhs {
				compatible = "arm,idle-state";
				arm,psci-suspend-param = <0x1000030>;
				entry-latency-us = <2000>;
				exit-latency-us = <2000>;
				min-residency-us = <6000>;
			};
	};

	psci {
		compatible = "arm,psci-1.0";
		method = "smc";

		CPU_PD0: cpu-pd@0 {
			#power-domain-cells = <0>;
			domain-idle-states = <&CLUSTER_RET>, <&CLUSTER_PWR_DWN>;
		};

		CPU_PD1: cpu-pd@1 {
			#power-domain-cells = <0>;
			domain-idle-states =  <&CLUSTER_PWR_DWN>;
		};
	};

[1] Kernel documentation - ARM idle states bindings
    Documentation/devicetree/bindings/arm/idle-states.txt
[2] Power State Coordination Interface (PSCI) specification
    http://infocenter.arm.com/help/topic/com.arm.doc.den0022c/DEN0022C_Power_State_Coordination_Interface.pdf
[3]. PM Domains description
    Documentation/devicetree/bindings/power/power_domain.txt
[4]. CPU PM Domains description
    Documentation/power/cpu_domains.txt
```
