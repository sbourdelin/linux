## Documentation/devicetree/bindings/arm/qcom.txt
```
QCOM device tree bindings
-------------------------

Some qcom based bootloaders identify the dtb blob based on a set of
device properties like SoC, platform, PMIC, and revisions of those components.
To support this scheme, we encode this information into the board compatible
string.

Each board must specify a top-level board compatible string with the following
format:

	compatible = "qcom,<SoC>(-<soc_version>)(-<foundry_id>)-<plat_type>(/<subtype>)(-<plat_version>)(-<mb>MB)(-<panel>-panel)(-boot-<boot>)(-<pmic>(-v<pmic_version>)){0-4}"

where elements in parentheses "()" are optional and elements in brackets "<>"
are names of elements. Meaning only the 'SoC' and 'plat_type' elements are
required.

The 'SoC' element must be one of the following strings:

	apq8016
	apq8074
	apq8084
	apq8096
	msm8916
	msm8974
	msm8996

The 'plat_type' element must be one of the following strings:

	cdp
	liquid
	dragonboard
	mtp sbc


The 'soc_version', 'plat_version' and 'pmic_version' elements take the form of
v<Major>.<Minor> where the minor number may be omitted when it's zero, i.e.
v1.0 is the same as v1. If all versions of the 'plat_version' element's match,
then a wildcard '*' should be used, e.g. 'v*'.

The 'foundry_id', 'subtype', and 'mb' elements are one or more digits from 0
to 9.

The 'panel' element must be one of the following strings:

	720p
	fWVGA
	hd
	qHD

The 'boot' element must be one of the following strings:

	emmc_sdc1
	ufs

The 'pmic' element must be one of the following strings:

	pm8841
	pm8019
	pm8110
	pma8084
	pmi8962
	pmd9635
	pm8994
	pmi8994
	pm8916
	pm8004
	pm8909

The 'pmic' element is specified in order of ascending USID. The PMIC in USID0
goes first, and then USID2, USID4, and finally USID6. Up to four PMICs may be
specified and no holes in the USID number space are allowed.

Examples:

	"qcom,msm8916-v1-cdp-pm8916-v2.1"

A CDP board with an msm8916 SoC, version 1 paired with a pm8916 PMIC of version
2.1.

	"qcom,apq8074-v2.0-2-dragonboard/1-v0.1-512MB-panel-qHD-boot-emmc_sdc1-pm8941-v0.2-pm8909-v2.2-pma8084-v3-pm8110-v1"

A dragonboard board v0.1 of subtype 1 with an apq8074 SoC version 2, made in
foundry 2 with 512MB of memory and a qHD panel booting from emmc_sdc1, paired
with a pm8941 PMIC version 0.2 at USID0, pm8909 PMIC version 2.2 at USID2,
pma8084 version 3 at USID4 and a pm8110 version 1 at USID6.
```

## Documentation/devicetree/bindings/arm/realtek.txt
```
Realtek platforms device tree bindings
--------------------------------------


RTD1295 SoC
===========

Required root node properties:

 - compatible :  "realtek,rtd1295"


Board compatible strings:

 - Zidoo X9S: "zidoo,x9s"
```

## Documentation/devicetree/bindings/arm/samsung/exynos-srom.txt
```
SAMSUNG Exynos SoCs SROM Controller driver.

Required properties:
- compatible : Should contain "samsung,exynos-srom".

- reg: offset and length of the register set

- #address-cells, #size-cells : should be '1' if the device has sub-nodes
				with 'reg' property.
- ranges: allows valid 1:1 translation between child's address space and
	  parent's address space

Sub-nodes:
The SROM controller can be used to attach external peripherials. In this case
device nodes should be added as subnodes to the SROMc node. These subnodes,
except regular device specification, should contain the following properties,
describing configuration of the relevant SROM bank:

Required properties:
- samsung,srom-bank : bank number (0 - 3)

- samsung,srom-timing : array of 7 integers: PMC, Tacp, Tcah, Tcoh, Tacc, Tcos,
			Tacs

Optional properties:
- samsung,srom-data-width : data width in bytes (1 or 2). If omitted, default
			    of 1 is used.

Example: basic definition, no banks are configured
	sromc@12570000 {
		compatible = "samsung,exynos-srom";
		reg = <0x12570000 0x14>;
	};

Example: SROMc with smsc 911x ethernet chip on bank 3
	sromc@12570000 {
		#address-cells = <1>;
		#size-cells = <1>;
		ranges;

		compatible = "samsung,exynos-srom";
		reg = <0x12570000 0x14>;

		ethernet@07000000 {
			compatible = "smsc,lan9115";
			reg = <0x07000000 0x10000>;
			phy-mode = "mii";
			interrupt-parent = <&gpx0>;
			interrupts = <5 8>;
			reg-io-width = <2>;
			smsc,irq-push-pull;
			smsc,force-internal-phy;

			samsung,srom-bank = <3>;
			samsung,srom-data-width = <2>;
			samsung,srom-timing = <1 9 12 1 9 1 1>;
		};
	};
```
