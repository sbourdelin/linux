## Documentation/devicetree/bindings/usb/snps,dw-ahb-udc.txt
```
Synopsys USB Device controller.

The device node is used for Synopsys Designware Cores AHB
Subsystem Device Controller (UDC).

This device node is used by UDCs integrated it Broadcom's
Northstar2 and Cygnus SoC's.

Required properties:
 - compatible: should be "snps,dw-ahb-udc"
 - reg: Offset and length of UDC register set
 - interrupts: description of interrupt line
 - phys: phandle to phy node.
 - extcon: phandle to the extcon device. This is optional and
   not required for those that don't require extcon support.
   Extcon support will be required if the UDC is connected to
   a Dual Role Device Phy that supports both Host and Device
   mode based on the external cable.

Example:
	udc_dwc: usb@664e0000 {
		compatible = "snps,dw-ahb-udc";
		reg = <0x664e0000 0x2000>;
		interrupts = <GIC_SPI 424 IRQ_TYPE_LEVEL_HIGH>;
		phys = <&usbdrd_phy>;
		extcon = <&usbdrd_phy>";
	};
```

## Documentation/devicetree/bindings/usb/udc-xilinx.txt
```
Xilinx USB2 device controller

Required properties:
- compatible		: Should be "xlnx,usb2-device-4.00.a" or
			  "xlnx,usb2-device-5.00"
- reg			: Physical base address and size of the USB2
			  device registers map.
- interrupts		: Should contain single irq line of USB2 device
			  controller
- xlnx,has-builtin-dma	: if DMA is included
- dma-ranges		: Should be as the following
			  <child-bus-address, parent-bus-address, length>
- xlnx,addrwidth	: Should be the dma addressing size in bits(ex: 64 bits)

Example:
		axi-usb2-device@42e00000 {
			compatible = "xlnx,usb2-device-4.00.a";
			interrupts = <0x0 0x39 0x1>;
			reg = <0x42e00000 0x10000>;
			dma-ranges = <0x00000000 0x00000000 0x40000000>;
			xlnx,has-builtin-dma;
			xlnx,addrwidth = <0x40>;
		};
```

## Documentation/devicetree/bindings/usb/ulpi.txt
```
ULPI bus binding
----------------

Phys that are behind a ULPI connection can be described with the following
binding. The host controller shall have a "ulpi" named node as a child, and
that node shall have one enabled node underneath it representing the ulpi
device on the bus.

PROPERTIES
----------

- ulpi-vendor:
    Usage: optional
    Value type: <u16>
    Definition: The USB-IF assigned vendor id for this device

- ulpi-product:
    Usage: required if ulpi-vendor is present
    Value type: <u16>
    Definition: The vendor assigned product id for this device

EXAMPLE
-------

usb {
	compatible = "vendor,usb-controller";

	ulpi {
		phy {
			compatible = "vendor,phy";
			ulpi-vendor = /bits/ 16 <0x1d6b>;
			ulpi-product = /bits/ 16 <0x0002>;
		};
	};
};
```

## Documentation/devicetree/bindings/usb/usb-device.txt
```
Generic USB Device Properties

Usually, we only use device tree for hard wired USB device.
The reference binding doc is from:
http://www.firmware.org/1275/bindings/usb/usb-1_0.ps

Required properties:
- compatible: usbVID,PID
- reg: the port number which this device is connecting to.


Example:

hub: genesys@01 {
	compatible = "usb05e3,0608";
	reg = <0x01>;
};
```

## Documentation/devicetree/bindings/usb/usb-hcd.txt
```
Generic USB HCD (Host Controller Device) Properties

Optional properties:
- phys: a list of all USB PHYs on this HCD
- an alias of the form "usbN" may be defined to suggest the use of
  busnumer "N" for this platform bus.

Example:

	aliases {
		usb1 = "/usb@c5000000";
		usb2 = "/usb@c5004000";
		usb3 = "/usb@c5008000";
	}

	&usb1 {
		phys = <&usb2_phy1>, <&usb3_phy1>;
	};
```

## Documentation/devicetree/bindings/usb/usb-uhci.txt
```
Generic Platform UHCI Controller
-----------------------------------------------------

Required properties:
- compatible : "generic-uhci" (deprecated: "platform-uhci")
  supports additional Aspeed specific workarounds by also
  including the "aspeed,ast2400-uhci" or "aspeed,ast2500-uhci"
  string.
- reg : Should contain 1 register ranges(address and length)
- interrupts : UHCI controller interrupt
- #ports: (optional) 1 cell, number of ports (overrides
  auto-detection which is needed among others on some Aspeed
  parts).

Example:

	uhci@d8007b00 {
		compatible = "generic-uhci";
		reg = <0xd8007b00 0x200>;
		interrupts = <43>;
	};
```

## Documentation/devicetree/bindings/usb/usb251x.txt
```
SMSC USB 2.0 Hi-Speed Hub Controller

Required properties:
- compatible = "smsc,usb251x";
- reg = <0x2c>;

Optional properties:
- smsc,usb251x-cfg-data1 : u8, set configuration data 1 (byte 0x06)
- smsc,usb251x-cfg-data2 : u8, set configuration data 2 (byte 0x07)
- smsc,usb251x-cfg-data3 : u8, set configuration data 3 (byte 0x08)
- smsc,usb251x-portmap12 : u8, set port mapping for ports 1 and 2 (byte 0xfb)
- smsc,usb251x-portmap34 : u8, set port mapping for ports 3 and 4 (byte 0xfc)
- smsc,usb251x-portmap56 : u8, set port mapping for ports 5 and 6 (byte 0xfd)
- smsc,usb251x-portmap7 : u8, set port mapping for port 7 (byte 0xfe)
- smsc,usb251x-status-command : u8, configure smbus behaviour (byte 0xff)

Example:

	usb251x: usb251x@2c {
		compatible = "smsc,usb251x";
		reg = <0x2c>;
		smsc,usb251x-cfg-data3 = <0x09>;
		smsc,usb251x-portmap12 = <0x21>;
		smsc,usb251x-portmap12 = <0x43>;
		smsc,usb251x-status-command = <0x1>;
	};
```

## Documentation/devicetree/bindings/video/backlight/arcxcnn.txt
```
arcxcnn bindings

Required properties:
  - compatible: "arc,arcxcnn", "arc,arc2c0608"
  - reg: I2C slave address (u8)

Optional properties:
  - bl-name: Backlight device name (string)
  - init-brt: Initial value of backlight brightness (u32) low 16 bits used
  - pwm-period: PWM period value. Set only PWM input mode used (u32)
  - prg-addr: Register address of ROM area to be updated (u32) low 8 bits used
  - prg-val: Register value to be updated (u32) low 8 bits used

Example:

	/* ARC2C0608 */
	backlight@30 {
		compatible = "arc,arc2c0608";
		reg = <0x30>;

		init-brt = <123>;

		/* LED0+1 string enabled */
		prg_06h {
			prg-addr = <0x06>;
			prg-val = <0x83>;
		};

	};
```

## Documentation/devicetree/bindings/video/bridge/anx7814.txt
```
Analogix ANX7814 SlimPort (Full-HD Transmitter)
-----------------------------------------------

The ANX7814 is an ultra-low power Full-HD (1080p60) SlimPort transmitter
designed for portable devices.

Required properties:

 - compatible		: "analogix,anx7814"
 - reg			: I2C address of the device
 - cable-det-gpios	: Which GPIO to use for cable detection
 - pd-gpios		: Which GPIO to use for power down
 - reset-gpios		: Which GPIO to use for reset

Optional properties:

 - v10-gpios	: Which GPIO to use for V10 control.
 - video interfaces: Device node can contain video interface port nodes.

Example:

	anx7814: anx7814@38 {
		compatible = "analogix,anx7814";
		reg = <0x38>;
		cable-det-gpios = <&gpio0 1 GPIO_ACTIVE_HIGH>;
		pd-gpios = <&gpio0 2 GPIO_ACTIVE_HIGH>;
		reset-gpios = <&gpio0 3 GPIO_ACTIVE_HIGH>;
		v10-gpios = <&gpio0 4 GPIO_ACTIVE_HIGH>;
		ports {
			port@0 {
				anx7814_in: endpoint {
					remote-endpoint = <&hdmi0_out>;
				};
			};
		};
	};
```

## Documentation/devicetree/bindings/video/dw_mipi_dsi_rockchip.txt
```
Rockchip specific extensions to the Synopsys Designware MIPI DSI
================================

Required properties:
- compatible: "rockchip,rk3288-mipi-dsi", "snps,dw-mipi-dsi".
- rockchip,grf: this soc should set GRF regs to mux vopl/vopb.
- ports: contain a port node with endpoint definitions as defined in [1].
  For vopb,set the reg = <0> and set the reg = <1> for vopl.

For more required properties, please refer to [2].

[1] Documentation/devicetree/bindings/media/video-interfaces.txt
[2] Documentation/devicetree/bindings/drm/bridge/dw_mipi_dsi.txt

Example:
	mipi_dsi: mipi@ff960000 {
		#address-cells = <1>;
		#size-cells = <0>;
		compatible = "rockchip,rk3288-mipi-dsi", "snps,dw-mipi-dsi";
		reg = <0xff960000 0x4000>;
		interrupts = <GIC_SPI 83 IRQ_TYPE_LEVEL_HIGH>;
		clocks = <&cru SCLK_MIPI_24M>, <&cru PCLK_MIPI_DSI0>;
		clock-names = "ref", "pclk";
		rockchip,grf = <&grf>;
		status = "okay";

		ports {
			#address-cells = <1>;
			#size-cells = <0>;
			reg = <1>;

			mipi_in: port {
				#address-cells = <1>;
				#size-cells = <0>;
				mipi_in_vopb: endpoint@0 {
					reg = <0>;
					remote-endpoint = <&vopb_out_mipi>;
				};
				mipi_in_vopl: endpoint@1 {
					reg = <1>;
					remote-endpoint = <&vopl_out_mipi>;
				};
			};
		};

		panel {
			compatible ="boe,tv080wum-nl0";
			reg = <0>;

			enable-gpios = <&gpio7 3 GPIO_ACTIVE_HIGH>;
			pinctrl-names = "default";
			pinctrl-0 = <&lcd_en>;
			backlight = <&backlight>;
			status = "okay";
		};
	};
```

## Documentation/devicetree/bindings/video/intelfpgavipfb.txt
```
Intel FPGA Video and Image Processing(VIP) Frame Buffer bindings

Required properties:
- compatible: "intel,vip-frame-buffer2"
- reg: Physical base address and length of the framebuffer controller's
  registers.
- max-width: The width of the framebuffer in pixels.
- max-height: The height of the framebuffer in pixels.
- bits-per-color: only "8" is currently supported
- mem-word-width = the bus width of the avalon master port on the frame reader

Example:

alt_vip_vfr_0: vip@0xff260000 {
	compatible = "intel,vip-frame-buffer2";
	reg = <0xff260000 0x00000080>;
	max-width = <1024>;
	max-height = <768>;
	bits-per-color = <8>;
	mem-word-width = <128>;
};
```

## Documentation/devicetree/bindings/w1/w1-ds2760.txt
```
Devicetree bindings for Maxim DS2760
====================================

The ds2760 is a w1 slave device and must hence have its sub-node in DT
under a w1 bus master node.

Required properties:
- compatible: must be "maxim,ds2760-w1"
```

## Documentation/devicetree/bindings/w1/w1.txt
```
Generic devicetree bindings for onewire (w1) busses
===================================================

Onewire busses are described through nodes of their master bus controller.
Slave devices are listed as sub-nodes of such master devices. For now, one
one slave is allowed per bus master.


Example:

	onewire {
		compatible = "w1-gpio";
		gpios = <&gpio 0 GPIO_ACTIVE_HIGH>;

		battery {
			compatible = "maxim,ds2760";
		};
	};
```

## Documentation/devicetree/bindings/watchdog/aspeed-wdt.txt
```
Aspeed Watchdog Timer

Required properties:
 - compatible: must be one of:
	- "aspeed,ast2400-wdt"
	- "aspeed,ast2500-wdt"

 - reg: physical base address of the controller and length of memory mapped
   region

Optional properties:
   Signal behavior - Whenever a timeout occurs the watchdog can be programmed
   to generate/not generate 6 types of signals:

 - aspeed,arm-reset:	If property is present then reset ARM CPU only.
			If not specified no ARM CPU reset is done.

 - aspeed,no-soc-reset: If property is present then do not reset SOC.
			If not specified then SOC reset is done.

 - aspeed,no-sys-reset: If property is present then do not reset system.
			Typcally used in tandem with 'aspeed-external-signal'
			If not specified then system reset is done.

 - aspeed,interrupt:	If property is present then interrupt CPU.
			If not specified then don't interrupt CPU.

 - aspeed,external-signal: If property is present then signal is sent to
			external reset counter (only WDT1 and WDT2). If not
			specified no external signal is sent.
 - aspeed,alt-boot:    If property is present then boot from alternate block.

Example:

	wdt1: watchdog@1e785000 {
		compatible = "aspeed,ast2400-wdt";
		reg = <0x1e785000 0x1c>;
		aspeed,no-sys-reset;
		aspeed,external-signal;
	};
```

## Documentation/devicetree/bindings/watchdog/da9062-wdt.txt
```
* Dialog Semiconductor DA9062/61 Watchdog Timer

Required properties:
- compatible: "dlg,da9062-watchdog"
              "dlg,da9061-watchdog"

Example:
	watchdog {
		compatible = "dlg,da9062-watchdog";
	};
```

## Documentation/devicetree/bindings/watchdog/jnx-ptxpmb-wdt.txt
```
Juniper's PTXPMB FPGA watchdog driver

Required properties:

- compatible:	Should be "jnx,ptxpmb-wdt"

Optional properties:

- reg : Specifies base physical address and size of the registers. It is
  optional since the MFD parent driver supplies it, but can be overridden.

Example:

wdt {
	compatible = "jnx,ptxpmb-wdt";
	/* no properties defined */
};
```

## Documentation/devicetree/bindings/watchdog/sbsa-gwdt.txt
```
* SBSA (Server Base System Architecture) Generic Watchdog

The SBSA Generic Watchdog Timer is used to force a reset of the system
after two stages of timeout have elapsed.  A detailed definition of the
watchdog timer can be found in the ARM document: ARM-DEN-0029 - Server
Base System Architecture (SBSA)

Required properties:
- compatible: Should at least contain "arm,sbsa-gwdt".

- reg: Each entry specifies the base physical 64-bit address of a register
  frame and the 64-bit length of that frame; currently, two frames must be
  defined, in this order:
  1: Watchdog control frame
  2: Refresh frame.

- interrupts: At least one interrupt must be defined that will be used as
  the WS0 interrupt.  A WS1 interrupt definition can be provided, but is
  optional.  The interrupts must be defined in this order:
  1: WS0 interrupt
  2: WS1 interrupt

Optional properties
- timeout-sec: To use a timeout value that is different from the driver
  default values, use this property.  If used, at least one timeout value
  (in seconds) must be provided.  A second optional timeout value (in
  seconds) may also be provided and will be used as the pre-timeout value,
  if it is given.

  There are two possible sources for driver default timeout values:
  (1) the driver contains hard-coded default values, or
  (2) module parameters can be given when the module is loaded

  If timeout/pretimeout values are provided when the module loads, they
  will take priority.  Second priority will be the timeout-sec from DTB,
  and third the hard-coded driver values.

Example for FVP Foundation Model v8:

watchdog@2a440000 {
	compatible = "arm,sbsa-gwdt";
	reg = <0x0 0x2a440000 0 0x1000>,
	      <0x0 0x2a450000 0 0x1000>;
	interrupts = <0 27 4>;
	timeout-sec = <60 30>;
};
```

## Documentation/devicetree/bindings/watchdog/st,stm32-iwdg.txt
```
STM32 Independent WatchDoG (IWDG)
---------------------------------

Required properties:
- compatible: Should be either "st,stm32-iwdg" or "st,stm32mp1-iwdg"
- reg: Physical base address and length of the registers set for the device
- clocks: Reference to the clock entry lsi. Additional pclk clock entry
  is required only for st,stm32mp1-iwdg.
- clock-names: Name of the clocks used.
  "lsi" for st,stm32-iwdg
  "pclk", "lsi" for st,stm32mp1-iwdg

Optional Properties:
- timeout-sec: Watchdog timeout value in seconds.

Examples:

iwdg: watchdog@40003000 {
	compatible = "st,stm32-iwdg";
	reg = <0x40003000 0x400>;
	clocks = <&clk_lsi>;
	clock-names = "lsi";
	timeout-sec = <32>;
};

iwdg: iwdg@5a002000 {
	compatible = "st,stm32mp1-iwdg";
	reg = <0x5a002000 0x400>;
	clocks = <&rcc IWDG2>, <&clk_lsi>;
	clock-names = "pclk", "lsi";
	timeout-sec = <32>;
};
```

## Documentation/devicetree/bindings/watchdog/st,stpmu1-wdt.txt
```
STMicroelectronics STPMU1 Watchdog

Required properties:

- compatible : should be "st,stpmu1-wdt"

Example:

watchdog {
	compatible = "st,stpmu1-wdt";
};
```

## Documentation/devicetree/bindings/watchdog/ts4600-wdt.txt
```
TS-4600 Technologic Systems Watchdog

Required properties:
- compatible: must be "technologic,ts4600-wdt"
- reg: offset to the FPGA's watchdog register

Optional property:
- timeout-sec: contains the watchdog timeout in seconds.

Example:

watchdog {
	compatible = "technologic,ts4600-wdt";
	reg = <0x2a>;
	timeout-sec = <10>;
};
```
