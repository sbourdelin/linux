## Documentation/devicetree/bindings/dma/stm32-dma.txt
```
* STMicroelectronics STM32 DMA controller

The STM32 DMA is a general-purpose direct memory access controller capable of
supporting 8 independent DMA channels. Each channel can have up to 8 requests.

Required properties:
- compatible: Should be "st,stm32-dma"
- reg: Should contain DMA registers location and length. This should include
  all of the per-channel registers.
- interrupts: Should contain all of the per-channel DMA interrupts.
- clocks: Should contain the input clock of the DMA instance.
- #dma-cells : Must be <4>. See DMA client paragraph for more details.

Optional properties:
- resets: Reference to a reset controller asserting the DMA controller
- st,mem2mem: boolean; if defined, it indicates that the controller supports
  memory-to-memory transfer

Example:

	dma2: dma-controller@40026400 {
		compatible = "st,stm32-dma";
		reg = <0x40026400 0x400>;
		interrupts = <56>,
			     <57>,
			     <58>,
			     <59>,
			     <60>,
			     <68>,
			     <69>,
			     <70>;
		clocks = <&clk_hclk>;
		#dma-cells = <4>;
		st,mem2mem;
		resets = <&rcc 150>;
	};

* DMA client

Required properties:
- dmas: Comma separated list of dma channel requests
- dma-names: Names of the aforementioned requested channels

Each dmas request consists of 5 cells:
1. A phandle pointing to the STM32 DMA controller
2. The channel id
3. The request line number
4. A 32bit mask specifying the DMA channel configuration
 -bit 1: Direct Mode Error Interrupt
	0x0: disabled
	0x1: enabled
 -bit 2: Transfer Error Interrupt
	0x0: disabled
	0x1: enabled
 -bit 3: Half Transfer Mode Error Interrupt
	0x0: disabled
	0x1: enabled
 -bit 4: Transfer Complete Interrupt
	0x0: disabled
	0x1: enabled
 -bit 9: Peripheral Increment Address
	0x0: no address increment between transfers
	0x1: increment address between transfers
 -bit 10: Memory Increment Address
	0x0: no address increment between transfers
	0x1: increment address between transfers
 -bit 15: Peripheral Increment Offset Size
	0x0: offset size is linked to the peripheral bus width
	0x1: offset size is fixed to 4 (32-bit alignment)
 -bit 16-17: Priority level
	0x0: low
	0x1: medium
	0x2: high
	0x3: very high
5. A 32bit mask specifying the DMA FIFO configuration
 -bit 0-1: Fifo threshold
	0x0: 1/4 full FIFO
	0x1: 1/2 full FIFO
	0x2: 3/4 full FIFO
	0x3:full FIFO
 -bit 2: Direct mode
	0x0: enabled
	0x1: disabled
 -bit 7: FIFO Error Interrupt
	0x0: disabled
	0x1: enabled

Example:

	usart1: serial@40011000 {
		compatible = "st,stm32-usart", "st,stm32-uart";
		reg = <0x40011000 0x400>;
		interrupts = <37>;
		clocks = <&clk_pclk2>;
		dmas = <&dma2 2 4 0x20610 0x3>,
		       <&dma2 7 5 0x20610 0x3>;
		dma-names = "rx", "tx";
	};
```

## Documentation/devicetree/bindings/dma/stm32-dmamux.txt
```
STM32 DMA MUX (DMA request router)

Required properties:
- compatible:	"st,stm32h7-dmamux"
- reg:		Memory map for accessing module
- #dma-cells:	Should be set to <3>.
		First parameter is request line number.
		Second is DMA channel configuration
		Third is Fifo threshold
		For more details about the three cells, please see
		stm32-dma.txt documentation binding file
- dma-masters:	Phandle pointing to the DMA controller

Optional properties:
- dma-channels : Number of DMA channels supported.
- dma-requests : Number of DMA requests supported.
- resets: Reference to a reset controller asserting the DMA controller
- clocks: Input clock of the DMAMUX instance.

Example:

/* DMA controller */
dma2: dma-controller@40026400 {
	compatible = "st,stm32-dma";
	reg = <0x40026400 0x400>;
	interrupts = <56>,
		     <57>,
		     <58>,
		     <59>,
		     <60>,
		     <68>,
		     <69>,
		     <70>;
	clocks = <&clk_hclk>;
	#dma-cells = <4>;
	st,mem2mem;
	resets = <&rcc 150>;
	st,dmamux;
	dma-channels = <8>;
};

/* DMA mux */
dmamux2: dma-router@40020820 {
	compatible = "st,stm32h7-dmamux";
	reg = <0x40020800 0x1c>;
	#dma-cells = <3>;
	dma-requests = <128>;
	dma-masters = <&dma2>;
};

/* DMA client */
usart1: serial@40011000 {
	compatible = "st,stm32-usart", "st,stm32-uart";
	reg = <0x40011000 0x400>;
	interrupts = <37>;
	clocks = <&clk_pclk2>;
	dmas = <&dmamux2 41 0x414 0>,
	       <&dmamux2 42 0x414 0>;
	dma-names = "rx", "tx";
};
```

## Documentation/devicetree/bindings/dma/tegra210-adma.txt
```
* NVIDIA Tegra Audio DMA (ADMA) controller

Required properties:
- compatible: Must be "nvidia,tegra210-adma".
- reg: Should contain DMA registers location and length. This should be
  a single entry that includes all of the per-channel registers in one
  contiguous bank.
- interrupt-parent: Phandle to the interrupt parent controller.
- interrupts: Should contain all of the per-channel DMA interrupts in
  ascending order with respect to the DMA channel index.
- clocks: Must contain one entry for the ADMA module clock, "adma_ape".
- clock-names: Must contain the entry "adma_ape".
- #dma-cells : Must be 1. The first cell denotes the receive/transmit
  request number and should be between 1 and the maximum number of
  requests supported. This value corresponds to the RX/TX_REQUEST_SELECT
  fields in the ADMA_CHn_CTRL register.


Example:

adma: adma@702e2000 {
	compatible = "nvidia,tegra210-adma";
	reg = <0x0 0x702e2000 0x0 0x2000>;
	interrupt-parent = <&tegra_agic>;
	interrupts = <GIC_SPI INT_ADMA_EOT0 IRQ_TYPE_LEVEL_HIGH>,
		     <GIC_SPI INT_ADMA_EOT1 IRQ_TYPE_LEVEL_HIGH>,
		     <GIC_SPI INT_ADMA_EOT2 IRQ_TYPE_LEVEL_HIGH>,
		     <GIC_SPI INT_ADMA_EOT3 IRQ_TYPE_LEVEL_HIGH>,
		     <GIC_SPI INT_ADMA_EOT4 IRQ_TYPE_LEVEL_HIGH>,
		     <GIC_SPI INT_ADMA_EOT5 IRQ_TYPE_LEVEL_HIGH>,
		     <GIC_SPI INT_ADMA_EOT6 IRQ_TYPE_LEVEL_HIGH>,
		     <GIC_SPI INT_ADMA_EOT7 IRQ_TYPE_LEVEL_HIGH>,
		     <GIC_SPI INT_ADMA_EOT8 IRQ_TYPE_LEVEL_HIGH>,
		     <GIC_SPI INT_ADMA_EOT9 IRQ_TYPE_LEVEL_HIGH>,
		     <GIC_SPI INT_ADMA_EOT10 IRQ_TYPE_LEVEL_HIGH>,
		     <GIC_SPI INT_ADMA_EOT11 IRQ_TYPE_LEVEL_HIGH>,
		     <GIC_SPI INT_ADMA_EOT12 IRQ_TYPE_LEVEL_HIGH>,
		     <GIC_SPI INT_ADMA_EOT13 IRQ_TYPE_LEVEL_HIGH>,
		     <GIC_SPI INT_ADMA_EOT14 IRQ_TYPE_LEVEL_HIGH>,
		     <GIC_SPI INT_ADMA_EOT15 IRQ_TYPE_LEVEL_HIGH>,
		     <GIC_SPI INT_ADMA_EOT16 IRQ_TYPE_LEVEL_HIGH>,
		     <GIC_SPI INT_ADMA_EOT17 IRQ_TYPE_LEVEL_HIGH>,
		     <GIC_SPI INT_ADMA_EOT18 IRQ_TYPE_LEVEL_HIGH>,
		     <GIC_SPI INT_ADMA_EOT19 IRQ_TYPE_LEVEL_HIGH>,
		     <GIC_SPI INT_ADMA_EOT20 IRQ_TYPE_LEVEL_HIGH>,
		     <GIC_SPI INT_ADMA_EOT21 IRQ_TYPE_LEVEL_HIGH>;
	clocks = <&tegra_car TEGRA210_CLK_ADMA_APE>;
	clock-names = "adma_ape";
	#dma-cells = <1>;
};
```

## Documentation/devicetree/bindings/dma/xilinx/zynqmp_dma.txt
```
Xilinx ZynqMP DMA engine, it does support memory to memory transfers,
memory to device and device to memory transfers. It also has flow
control and rate control support for slave/peripheral dma access.

Required properties:
- compatible		: Should be "xlnx,zynqmp-dma-1.0"
- reg			: Memory map for gdma/adma module access.
- interrupt-parent	: Interrupt controller the interrupt is routed through
- interrupts		: Should contain DMA channel interrupt.
- xlnx,bus-width	: Axi buswidth in bits. Should contain 128 or 64
- clock-names		: List of input clocks "clk_main", "clk_apb"
			  (see clock bindings for details)

Optional properties:
- xlnx,include-sg	: Indicates the controller to operate in simple or
			  scatter gather dma mode
- xlnx,ratectrl		: Scheduling interval in terms of clock cycles for
			  source AXI transaction
- xlnx,overfetch	: Tells whether the channel is allowed to over
			  fetch the data
- xlnx,src-issue	: Number of AXI outstanding transactions on source side
- xlnx,src-burst-len	: AXI length for data read. Support only power of
			  2 byte values.
- xlnx,dst-burst-len	: AXI length for data write. Support only power of
			  2 byte values.
- dma-coherent		: Present if dma operations are coherent.

Example:
++++++++
fpd_dma_chan1: dma@fd500000 {
	compatible = "xlnx,zynqmp-dma-1.0";
	reg = <0x0 0xFD500000 0x1000>;
	interrupt-parent = <&gic>;
	interrupts = <0 117 4>;
	clock-names = "clk_main", "clk_apb";
	xlnx,bus-width = <128>;
	xlnx,include-sg;
	xlnx,overfetch;
	dma-coherent;
	xlnx,ratectrl = <0>;
	xlnx,src-issue = <16>;
	xlnx,src-burst-len = <4>;
	xlnx,dst-burst-len = <4>;
};
```

## Documentation/devicetree/bindings/drm/bridge/dw_mipi_dsi.txt
```
Device-Tree bindings for Synopsys DesignWare MIPI DSI host controller

The controller is a digital core that implements all protocol functions
defined in the MIPI DSI specification, providing an interface between
the system and the MIPI DPHY, and allowing communication with a MIPI DSI
compliant display.

Required properties:
 - #address-cells: Should be <1>.
 - #size-cells: Should be <0>.
 - compatible: The first compatible string should be "fsl,imx6q-mipi-dsi"
   for i.MX6q/sdl SoCs.  For other SoCs, please refer to their specific
   device tree binding documentations.  A common compatible string
   "snps,dw-mipi-dsi" should be appended for all SoCs.
 - reg: Represent the physical address range of the controller.
 - interrupts: Represent the controller's interrupt to the CPU(s).
 - clocks, clock-names: Phandles to the controller's pll reference
   clock(ref), configuration clock(cfg) and APB clock(pclk), as
   described in [1].

For more required properties, please refer to relevant device tree binding
documentations which describe the controller embedded in specific SoCs.

Required sub-nodes:
 - A node to represent a DSI peripheral as described in [2].

For more required sub-nodes, please refer to relevant device tree binding
documentations which describe the controller embedded in specific SoCs.

[1] Documentation/devicetree/bindings/clock/clock-bindings.txt
[2] Documentation/devicetree/bindings/mipi/dsi/mipi-dsi-bus.txt

example:
	gpr: iomuxc-gpr@020e0000 {
		/* ... */
	};

	mipi_dsi: mipi@021e0000 {
		#address-cells = <1>;
		#size-cells = <0>;
		compatible = "fsl,imx6q-mipi-dsi", "snps,dw-mipi-dsi";
		reg = <0x021e0000 0x4000>;
		interrupts = <0 102 IRQ_TYPE_LEVEL_HIGH>;
		gpr = <&gpr>;
		clocks = <&clks IMX6QDL_CLK_MIPI_CORE_CFG>,
			 <&clks IMX6QDL_CLK_MIPI_CORE_CFG>,
			 <&clks IMX6QDL_CLK_MIPI_IPG>;
		clock-names = "ref", "cfg", "pclk";

		ports {
			#address-cells = <1>;
			#size-cells = <0>;

			port@0 {
				reg = <0>;

				mipi_mux_0: endpoint {
					remote-endpoint = <&ipu1_di0_mipi>;
				};
			};

			port@1 {
				reg = <1>;

				mipi_mux_1: endpoint {
					remote-endpoint = <&ipu1_di1_mipi>;
				};
			};
		};

		panel {
			compatible = "truly,tft480800-16-e-dsi";
			reg = <0>;
			/* ... */
		};
	};
```

## Documentation/devicetree/bindings/edac/amd-seattle-edac.txt
```
* AMD Seattle SoC EDAC node

EDAC node is defined to describe on-chip error detection and reporting.

Required properties:
- compatible: Should be "amd,arm-seattle-edac"
- poll-delay-msec: Indicates how often the edac check callback should be called.
  Time in msec.

Example:
	edac {
		compatible = "amd,arm-seattle-edac";
		poll-delay-msec = <100>;
	};
```

## Documentation/devicetree/bindings/edac/armv8-edac.txt
```
* ARMv8 L1/L2 cache error reporting

On ARMv8, CPU Memory Error Syndrome Register and L2 Memory Error Syndrome
Register can be used for checking L1 and L2 memory errors.

The following section describes the ARMv8 EDAC DT node binding.

Required properties:
- compatible: Should be "arm,armv8-edac"

Example:
	edac {
		compatible = "arm,armv8-edac";
	};
```

## Documentation/devicetree/bindings/edac/aspeed-sdram-edac.txt
```
Aspeed AST2500 SoC EDAC device driver

The Aspeed AST2500 SoC supports DDR3 and DDR4 memory with and without ECC (error
correction check).

The memory controller supports SECDED (single bit error correction, double bit
error detection) and single bit error auto scrubbing by reserving 8 bits for
every 64 bit word (effectively reducing available memory to 8/9).

First, ECC must be configured in u-boot. Then, this driver will expose error
counters via the edac kernel framework.

A note on memory organization in ECC mode: every 512 bytes are followed by 64
bytes of ECC codes. The address remapping is done in hardware and is fully
transparent to firmware and software. Because of this, ECC mode must be
configured in u-boot as part of the memory initialization as one can not switch
from one mode to another when executing in memory.



Required properties:
- compatible: should be "aspeed,ast2500-sdram-edac"
- reg:        sdram controller register set should be <0x1e6e0000 0x174>
- interrupts: should be AVIC interrupt #0


Example:

	edac: sdram@1e6e0000 {
		compatible = "aspeed,ast2500-sdram-edac";
		reg = <0x1e6e0000 0x174>;
		interrupts = <0>;
		status = "okay";
	};
```

## Documentation/devicetree/bindings/eeprom/at24.txt
```
EEPROMs (I2C)

Required properties:

  - compatible: must be a "<manufacturer>,<model>" pair with one of the
                following values as fallback:

                "atmel,24c00",
                "atmel,24c01",
                "atmel,24c02",
                "atmel,24c04",
                "atmel,24c08",
                "atmel,24c16",
                "atmel,24c32",
                "atmel,24c64",
                "atmel,24c128",
                "atmel,24c256",
                "atmel,24c512",
                "atmel,24c1024"

  - reg : the I2C address of the EEPROM

Optional properties:

  - pagesize : the length of the pagesize for writing. Please consult the
               manual of your device, that value varies a lot. A wrong value
	       may result in data loss! If not specified, a safety value of
	       '1' is used which will be very slow.

  - read-only: this parameterless property disables writes to the eeprom

  - size: total eeprom size in bytes

  - no-read-rollover:
			This parameterless property indicates that the multi-address
			eeprom does not automatically roll over reads to the next
			slave address. Please consult the manual of your device.

  - wp-gpios: GPIO to which the write-protect pin of the chip is connected.

Example:

eeprom@52 {
	compatible = "atmel,24c32";
	reg = <0x52>;
	pagesize = <32>;
	wp-gpios = <&gpio1 3 0>;
};
```

## Documentation/devicetree/bindings/extcon/extcon-gpio.txt
```
GPIO Extcon device

This is a virtual device used to generate the specific cable states from the
GPIO pin.

Required properties:
- compatible: Must be "extcon-gpio".
- extcon-id: The extcon support the various type of external connector to check
  whether connector is attached or detached. The each external connector has
  the unique number to identify it. So this property includes the unique number
  which indicates the specific external connector. When external connector is
  attached or detached, GPIO pin detect the changed state. See include/
  dt-bindings/extcon/extcon.h which defines the unique number for supported
  external connector from extcon framework.
- gpios: GPIO pin to detect the external connector. See gpio binding.

Optional properties:
- debounce-ms: the debounce dealy for GPIO pin in millisecond.
- wakeup-source: Boolean, extcon can wake-up the system from suspend.
  if gpio provided in extcon-gpio DT node is registered as interrupt,
  then extcon can wake-up the system from suspend if wakeup-source property
  is available in DT node, if gpio registered as interrupt but wakeup-source
  is not available in DT node, then system wake-up due to extcon events
  not supported.

Example: Examples of extcon-gpio node as listed below:

	usb_cable: extcon-gpio-0 {
		compatible = "extcon-gpio";
		extcon-id = <EXTCON_USB>;
		extcon-gpio = <&gpio6 1 GPIO_ACTIVE_HIGH>;
	}

	ta_cable: extcon-gpio-1 {
		compatible = "extcon-gpio";
		extcon-id = <EXTCON_CHG_USB_DCP>;
		extcon-gpio = <&gpio3 2 GPIO_ACTIVE_LOW>;
		debounce-ms = <50>;	/* 50 millisecond */
		wakeup-source;
	}

	&dwc3_usb {
		extcon = <&usb_cable>;
	};

	&charger {
		extcon = <&ta_cable>;
	};
```
