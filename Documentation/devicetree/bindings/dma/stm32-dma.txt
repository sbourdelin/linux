## Documentation/devicetree/bindings/extcon/extcon-ptn5150.txt
```
* PTN5150 CC logic device
PTN5150A is a small thin low power CC Logic chip supporting the USB Type-C
connector application with Configuration Channel (CC) control logic detection and
indication functions. It is Interfaced to the host controller using an I2C interface.

Required properties:
- compatible: Should be "nxp,ptn5150"
- reg: Specifies the I2C slave address of the device
- int-gpio: GPIO to which INTB is connected
- vbus-gpio: GPIO which controls VBUS on/off

Example:
		ptn5150@1d  {
			compatible = "nxp,ptn5150";
			reg = <0x1d>;
			int-gpio = <&msmgpio 78 GPIO_ACTIVE_HIGH>;
			vbus-gpio = <&msmgpio 148 GPIO_ACTIVE_HIGH>;
			pinctrl-names = "default";
			pinctrl-0 = <&ptn5150_default>;
			status = "okay";
		};
```

## Documentation/devicetree/bindings/extcon/extcon-usb-gpio.txt
```
USB GPIO Extcon device

This is a virtual device used to generate USB cable states from the USB ID pin
connected to a GPIO pin.

Required properties:
- compatible: Should be "linux,extcon-usb-gpio"

Either one of id-gpio or vbus-gpio must be present. Both can be present as well.
- id-gpio: gpio for USB ID pin. See gpio binding.
- vbus-gpio: gpio for USB VBUS pin.
- extcon-gpio,level-trigger: Boolean, set this gpio's interrupt flag to
level trigger. If not specified defaults to false, gpio's interrupt flag
defaults to edge trigger.

Example: Examples of extcon-usb-gpio node in dra7-evm.dts as listed below:
	extcon_usb1 {
		compatible = "linux,extcon-usb-gpio";
		id-gpio = <&gpio6 1 GPIO_ACTIVE_HIGH>;
	}

	&omap_dwc3_1 {
		extcon = <&extcon_usb1>;
	};
```

## Documentation/devicetree/bindings/firmware/meson/meson_sm.txt
```
* Amlogic Secure Monitor

In the Amlogic SoCs the Secure Monitor code is used to provide access to the
NVMEM, enable JTAG, set USB boot, etc...

Required properties for the secure monitor node:
- compatible: Should be "amlogic,meson-gx-sm"

Example:

	firmware {
		sm: secure-monitor {
			compatible = "amlogic,meson-gx-sm";
		};
	};
```

## Documentation/devicetree/bindings/firmware/nvidia,tegra186-bpmp.txt
```
NVIDIA Tegra Boot and Power Management Processor (BPMP)

The BPMP is a specific processor in Tegra chip, which is designed for
booting process handling and offloading the power management tasks from
the CPU. The binding document defines the resources that would be used by
the BPMP firmware driver, which can create the interprocessor
communication (IPC) between the CPU and BPMP.

Required properties:
- name : Should be bpmp
- compatible : Should be "nvidia,tegra<chip>-bpmp"
- mboxes : The phandle of mailbox controller and the channel ID
           See "Documentation/devicetree/bindings/mailbox/
	   nvidia,tegra186-hsp.txt" and "Documentation/devicetree/
	   bindings/mailbox/mailbox.txt" for more details about the generic
	   mailbox controller and mailbox client driver bindings.
- shmem : List of the phandle of the TX and RX shared memory area that
	  the IPC between CPU and BPMP is based on.
- #clock-cells : Should be 1.
- #reset-cells : Should be 1.

The shared memory bindings for BPMP
-----------------------------------

The shared memory area for the IPC TX and RX between CPU and BPMP are
predefined and work on top of sysram, which is a sram inside the chip.

See "Documentation/devicetree/bindings/sram/sram.txt" for the bindings.

Example:

hsp_top: hsp@03c00000 {
	...
	#mbox-cells = <1>;
};

bpmp@d0000000 {
	compatible = "nvidia,tegra186-bpmp";
	mboxes = <&hsp_mbox HSP_DB_MASTER_BPMP>;
	shmem = <&cpu_bpmp_tx &cpu_bpmp_rx>;
	#clock-cells = <1>;
	#reset-cells = <1>;
};

sysram@30000000 {
	compatible = "nvidia,tegra186-sysram", "mmio-ram";
	reg = <0x0 0x30000000 0x0 0x50000>;
	#address-cells = <2>;
	#size-cells = <2>;
	ranges = <0 0x0 0x0 0x30000000 0x0 0x50000>;

	cpu_bpmp_tx: bpmp_shmem@4e000 {
		compatible = "nvidia,tegra186-bpmp-shmem";
		reg = <0x0 0x4e000 0x0 0x1000>;
	};

	cpu_bpmp_rx: bpmp_shmem@4f000 {
		compatible = "nvidia,tegra186-bpmp-shmem";
		reg = <0x0 0x4f000 0x0 0x1000>;
	};
};
```

## Documentation/devicetree/bindings/firmware/qcom,scm.txt
```
QCOM Secure Channel Manager (SCM)

Qualcomm processors include an interface to communicate to the secure firmware.
This interface allows for clients to request different types of actions.  These
can include CPU power up/down, HDCP requests, loading of firmware, and other
assorted actions.

Required properties:
- compatible: must contain one of the following:
 * "qcom,scm-apq8064" for APQ8064
 * "qcom,scm-apq8084" for MSM8084
 * "qcom,scm-msm8916" for MSM8916
 * "qcom,scm-msm8974" for MSM8974
- clocks: One to three clocks may be required based on compatible.
 * Only core clock required for "qcom,scm-apq8064"
 * Core, iface, and bus clocks required for all other compatibles.
- clock-names: Must contain "core" for the core clock, "iface" for the interface
  clock and "bus" for the bus clock per the requirements of the compatible.

Example for MSM8916:

	firmware {
		compatible = "simple-bus";

		scm {
			compatible = "qcom,scm-msm8916";
			clocks = <&gcc GCC_CRYPTO_CLK> , <&gcc GCC_CRYPTO_AXI_CLK>, <&gcc GCC_CRYPTO_AHB_CLK>;
			clock-names = "core", "bus", "iface";
		};
	};
```

## Documentation/devicetree/bindings/firmware/xilinx/xlnx,zynqmp-firmware.txt
```
Xilinx Zynq MPSoC Firmware Device Tree Bindings

The zynqmp-firmware node describes the interface to platform firmware.

Required properties:
 - compatible:	Must contain:  "xlnx,zynqmp-firmware"
 - method:	The method of calling the PM-API firmware layer.
		Permitted values are:
		 - "smc" : To be used in configurations without a hypervisor
		 - "hvc" : To be used when hypervisor is present

Examples:
	zynqmp_firmware: zynqmp-firmware {
		compatible = "xlnx,zynqmp-firmware";
		method = "smc";
	};
```

## Documentation/devicetree/bindings/fpga/altera-passive-serial.txt
```
Altera Cyclone Passive Serial SPI FPGA Manager

Altera Cyclone FPGAs support a method of loading the bitstream over what is
referred to as "passive serial".
The passive serial link is not technically spi, and might require extra
circuits in order to play nicely with other spi slaves on the same bus.

See https://www.altera.com/literature/hb/cyc/cyc_c51013.pdf

Required properties:
- compatible: should contain "altr,fpga-passive-serial"
- reg: spi chip select of the FPGA
- nstat-gpios: status pin (referred to as nSTATUS in the cyclone manual)
- nconfig-gpios: config pin (referred to as nCONFIG in the cyclone manual)
- confd-gpios: confd pin (referred to as CONF_DONE in the cyclone manual)

Example:
	fpga_spi: evi-fpga-spi@0 {
		compatible = "altr,cyclone-ps-spi-fpga-mgr";
		spi-max-frequency = <20000000>;
		reg = <0>;
		nconfig-gpios = <&gpio4 9 GPIO_ACTIVE_LOW>;
		nstat-gpios = <&gpio4 11 GPIO_ACTIVE_LOW>;
		confd-gpios = <&gpio4 12 GPIO_ACTIVE_LOW>;
	};
```

## Documentation/devicetree/bindings/fpga/altera-pr-ip.txt
```
Altera Partial Reconfiguration IP

Required properties:
- compatible : should contain "altr,pr-ip"
- reg        : base address and size for memory mapped io.

Example:

	fpga_mgr: fpga-mgr@ff20c000 {
		compatible = "altr,pr-ip";
		reg = <0xff20c000 0x10>;
	};
```

## Documentation/devicetree/bindings/fpga/cyclone-ps-spi-fpga-mgr.txt
```
Altera Cyclone Passive Serial SPI FPGA Manager

Altera Cyclone FPGAs support a method of loading the bitstream over what is
referred to as "passive serial".
The passive serial link is not technically spi, and might require extra
circuits in order to play nicely with other spi slaves on the same bus.

See https://www.altera.com/literature/hb/cyc/cyc_c51013.pdf

Required properties:
- compatible  : should contain "altr,cyclone-ps-spi-fpga-mgr"
- reg         : spi slave id of the fpga
- config-gpio : config pin (referred to as nCONFIG in the cyclone manual)
- status-gpio : status pin (referred to as nSTATUS in the cyclone manual)

Example:
	fpga_spi: evi-fpga-spi@0 {
		compatible = "altr,cyclone-ps-spi-fpga-mgr";
		spi-max-frequency = <20000000>;
		reg = <0>;
		config-gpio = <&gpio4 9 GPIO_ACTIVE_HIGH>;
		status-gpio = <&gpio4 11 GPIO_ACTIVE_HIGH>;
	};
```

## Documentation/devicetree/bindings/fpga/cyclone-spi-fpga-mgr.txt
```
Altera SOCFPGA FPGA Manager

Altera cyclone FPGAs support a method of loading the bitstream over what is
referred to as "passive serial".
The passive serial link is not technically spi, and might require extra
circuits in order to play nicely with other spi slaves on the same bus.

See https://www.altera.com/literature/hb/cyc/cyc_c51013.pdf

Required properties:
- compatible  : should contain "altr,cyclonespi-fpga-mgr"
- reg         : spi slave id of the fpga
- reset-gpio  : reset pin (referred to as nCONFIG in the cyclone manual)
- status-gpio : status pin (referred to as nSTATUS in the cyclone manual)

Example:
	fpga_spi: evi-fpga-spi@0 {
		compatible = "altr,cyclonespi-fpga-mgr";
		spi-max-frequency = <20000000>;
		reg = <0>;
		reset-gpio = <&gpio4 9 GPIO_ACTIVE_HIGH>;
		status-gpio = <&gpio4 11 GPIO_ACTIVE_HIGH>;
	};
```

## Documentation/devicetree/bindings/fpga/lattice-ice40-fpga-mgr.txt
```
Lattice iCE40 FPGA Manager

Required properties:
- compatible:		should contain "lattice,ice40-fpga-mgr"
- reg:			SPI chip select
- spi-max-frequency:	Maximum SPI frequency (>=1000000, <=25000000)
- cdone-gpio:		GPIO connected to CDONE pin
- creset_b-gpio:	GPIO connected to CRESET_B pin. Note that CRESET_B is
			treated as an active-low output because the signal is
			treated as an enable signal, rather than a reset. This
			is necessary because the FPGA will enter Master SPI
			mode and drive SCK with a clock signal, potentially
			jamming other devices on the bus, unless CRESET_B is
			held high until the firmware is loaded.

Example:
	ice40: ice40@0 {
		compatible = "lattice,ice40-fpga-mgr";
		reg = <0>;
		spi-max-frequency = <1000000>;
		cdone-gpio = <&gpio 24 GPIO_ACTIVE_HIGH>;
		creset_b-gpio = <&gpio 22 GPIO_ACTIVE_LOW>;
	};
```

## Documentation/devicetree/bindings/fsi/ibm,p9-occ-hwmon.txt
```
Device-tree bindings for FSI-based On-Chip Controller hwmon driver
------------------------------------------------------------------

This node MUST be a child node of an OCC driver node.

Required properties:
 - compatible = "ibm,p9-occ-hwmon";

Examples:

    occ@1 {
        compatible = "ibm,p9-occ";
        reg = <1>;

        occ-hwmon@1 {
            compatible = "ibm,p9-occ-hwmon";
        };
    };
```

## Documentation/devicetree/bindings/fsi/ibm,p9-occ.txt
```
Device-tree bindings for FSI-based On-Chip Controller driver
------------------------------------------------------------

Required properties:
 - compatible = "ibm,p9-occ";

Optional properties:
 - reg = <processor index>;	: Index for the processor this OCC is on.

Examples:

    occ@1 {
        compatible = "ibm,p9-occ";
        reg = <1>;
    };
```

## Documentation/devicetree/bindings/fsi/ibm,p9-sbefifo.txt
```
Device-tree bindings for FSI-based SBEFIFO driver
-------------------------------------------------

Required properties:
 - reg = < address size >		: FSI CFAM address for the SBE engine
					  and address space size.

Optional properties:
 - <child nodes>			: Devices that are accessible through
					  the SBEFIFO.

Examples:

    sbefifo@2400 {
        reg = < 0x2400 0x400 >;

        occ@1 {
            ...
        };
    };
```

## Documentation/devicetree/bindings/ge/b850v3-lvds-dp.txt
```
Driver for GE B850v3 LVDS/DP++ display bridge

Required properties:
  - compatible : should be "ge,b850v3-lvds-dp".
  - reg : should contain the main address which is used to ack the
    interrupts and address for edid.
  - reg-names : comma separeted list of register names. Valid values
    are "main", and "edid".
  - interrupt-parent : phandle of the interrupt controller that services
    interrupts to the device
  - interrupts : one interrupt should be described here, as in
    <0 IRQ_TYPE_LEVEL_HIGH>.
  - port : should describe the video signal connection between the host
    and the bridge.

Example:

&mux2_i2c2 {
	status = "okay";
	clock-frequency = <100000>;

	b850v3-lvds-dp-bridge@73  {
		compatible = "ge,b850v3-lvds-dp";
		#address-cells = <1>;
		#size-cells = <0>;

		reg = <0x73 0x72>;
		reg-names = "main", "edid";

		interrupt-parent = <&gpio2>;
		interrupts = <0 IRQ_TYPE_LEVEL_HIGH>;

		port {
			b850v3_dp_bridge_in: endpoint {
				remote-endpoint = <&lvds0_out>;
			};
		};
	};
};
```
