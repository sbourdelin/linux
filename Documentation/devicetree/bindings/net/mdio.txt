## Documentation/devicetree/bindings/net/mscc-phy-vsc8531.txt
```
* Microsemi - vsc8531 Giga bit ethernet phy

Required properties:
- compatible	: Should contain phy id as "ethernet-phy-idAAAA.BBBB"
		  The PHY device uses the binding described in
		  Documentation/devicetree/bindings/net/phy.txt

Optional properties:
- vsc8531,vddmac	: The vddmac in mV. Allowed values is listed
			  in the first row of Table 1 (below).
			  This property is only used in combination
			  with the 'edge-slowdown' property.
			  Default value is 3300.
- vsc8531,edge-slowdown	: % the edge should be slowed down relative to
			  the fastest possible edge time.
			  Edge rate sets the drive strength of the MAC
			  interface output signals.  Changing the
			  drive strength will affect the edge rate of
			  the output signal.  The goal of this setting
			  is to help reduce electrical emission (EMI)
			  by being able to reprogram drive strength
			  and in effect slow down the edge rate if
			  desired.
			  To adjust the edge-slowdown, the 'vddmac'
			  must be specified. Table 1 lists the
			  supported edge-slowdown values for a given
			  'vddmac'.
			  Default value is 0%.
			  Ref: Table:1 - Edge rate change (below).
- vsc8531,led-0-mode	: LED mode. Specify how the LED[0] should behave.
			  Allowed values is listed in the 'PHY LED Mode' -
			  Table 2 (below).  Default value is 1.
- vsc8531,led-1-mode	: LED mode. Specify how the LED[1] should behave.
			  Allowed values is listed in the 'PHY LED Mode' -
			  Table 2 (below).  Default value is 2.

Table: 1 - Edge rate change
----------------------------------------------------------------|
| 		Edge Rate Change (VDDMAC)			|
|								|
| 3300 mV	2500 mV		1800 mV		1500 mV		|
|---------------------------------------------------------------|
| 0%		0%		0%		0%		|
| (Fastest)			(recommended)	(recommended)	|
|---------------------------------------------------------------|
| 2%		3%		5%		6%		|
|---------------------------------------------------------------|
| 4%		6%		9%		14%		|
|---------------------------------------------------------------|
| 7%		10%		16%		21%		|
|(recommended)	(recommended)					|
|---------------------------------------------------------------|
| 10%		14%		23%		29%		|
|---------------------------------------------------------------|
| 17%		23%		35%		42%		|
|---------------------------------------------------------------|
| 29%		37%		52%		58%		|
|---------------------------------------------------------------|
| 53%		63%		76%		77%		|
| (slowest)							|
|---------------------------------------------------------------|

Table: 2 - PHY LED Mode
|-----------------------------------------------|
| LINK_ACTIVITY			| 0		|
|-----------------------------------------------|
| LINK_1000_ACTIVITY		| 1		|
|-----------------------------------------------|
| LINK_100_ACTIVITY		| 2		|
|-----------------------------------------------|
| LINK_10_ACTIVITY		| 3		|
|-----------------------------------------------|
| LINK_100_1000_ACTIVITY	| 4		|
|-----------------------------------------------|
| LINK_10_1000_ACTIVITY		| 5		|
|-----------------------------------------------|
| LINK_10_100_ACTIVITY		| 6		|
|-----------------------------------------------|
| DUPLEX_COLLISION		| 8		|
|-----------------------------------------------|
| COLLISION			| 9		|
|-----------------------------------------------|
| ACTIVITY			| 10		|
|-----------------------------------------------|
| AUTONEG_FAULT			| 12		|
|-----------------------------------------------|
| SERIAL_MODE			| 13		|
|-----------------------------------------------|
| FORCE_LED_OFF			| 14		|
|-----------------------------------------------|
| FORCE_LED_ON			| 15		|
|-----------------------------------------------|

Example:

        vsc8531_0: ethernet-phy@0 {
                compatible = "ethernet-phy-id0007.0570";
                vsc8531,vddmac		= <3300>;
                vsc8531,edge-slowdown	= <7>;
                vsc8531,led-0-mode	= <1>;
                vsc8531,led-1-mode	= <2>;
        };
```

## Documentation/devicetree/bindings/net/oxnas-dwmac.txt
```
* Oxford Semiconductor OXNAS DWMAC Ethernet controller

The device inherits all the properties of the dwmac/stmmac devices
described in the file stmmac.txt in the current directory with the
following changes.

Required properties on all platforms:

- compatible:	Depending on the platform this should be one of:
			- "oxsemi,ox820-dwmac"
		Additionally "snps,dwmac" and any applicable more
		detailed version number described in net/stmmac.txt
		should be used.

- reg:	The first register range should be the one of the DWMAC
	controller.

- clocks: Should contain phandles to the following clocks
- clock-names:	Should contain the following:
		- "stmmaceth" - see stmmac.txt
		- "gmac" - peripheral gate clock

- oxsemi,sys-ctrl: a phandle to the system controller syscon node

Example :

etha: ethernet@40400000 {
	compatible = "oxsemi,ox820-dwmac", "snps,dwmac";
	reg = <0x40400000 0x2000>;
	interrupts = <GIC_SPI 8 IRQ_TYPE_LEVEL_HIGH>,
		     <GIC_SPI 17 IRQ_TYPE_LEVEL_HIGH>;
	interrupt-names = "macirq", "eth_wake_irq";
	mac-address = [000000000000]; /* Filled in by U-Boot */
	phy-mode = "rgmii";

	clocks = <&stdclk CLK_820_ETHA>, <&gmacclk>;
	clock-names = "gmac", "stmmaceth";
	resets = <&reset RESET_MAC>;

	/* Regmap for sys registers */
	oxsemi,sys-ctrl = <&sys>;

	status = "disabled";
};
```

## Documentation/devicetree/bindings/net/qcom,dwmac.txt
```
Qualcomm Ethernet ETHQOS device

This device has following properties:

Required properties:

- compatible: Should be qcom,ethqos-qcs404"

- reg: Address and length of the register set for the device

- reg-names: Should contain register names "stmmaceth", "rgmii"

- clocks: Should contain phandle to clocks

- clock-names: Should contain clock names "stmmaceth", "pclk",
		"ptp_ref", "rgmii"

- interrupts: Should contain phandle to interrupts

- interrupt-names: Should contain interrupt names "macirq", "eth_lpi"

Rest of the properties are defined in stmmac.txt file in same directory


Example:

ethernet: ethernet@7a80000 {
	compatible = "qcom,ethqos-qcs404";
	reg = <0x07a80000 0x10000>,
		<0x07a96000 0x100>;
	reg-names = "stmmaceth", "rgmii";
	clock-names = "stmmaceth", "pclk", "ptp_ref", "rgmii";
	clocks = <&gcc GCC_ETH_AXI_CLK>,
		<&gcc GCC_ETH_SLAVE_AHB_CLK>,
		<&gcc GCC_ETH_PTP_CLK>,
		<&gcc GCC_ETH_RGMII_CLK>;
	interrupts = <GIC_SPI 56 IRQ_TYPE_LEVEL_HIGH>,
			<GIC_SPI 55 IRQ_TYPE_LEVEL_HIGH>;
	interrupt-names = "macirq", "eth_lpi";
	snps,reset-gpio = <&tlmm 60 GPIO_ACTIVE_LOW>;
	snps,reset-active-low;
	snps,axi-config = <&stmmac_axi_setup>;
	snps,mtl-rx-config = <&mtl_rx_setup>;
	snps,mtl-tx-config = <&mtl_tx_setup>;

	snps,txpbl = <8>;
	snps,rxpbl = <2>;
	snps,aal;
	snps,tso;

	phy-handle = <&phy1>;
	phy-mode = "rgmii";

	stmmac_axi_setup: stmmac-axi-config {
		snps,wr_osr_lmt = <15>;
		snps,rd_osr_lmt = <15>;
		snps,blen = <256 128 64 32 0 0 0>;
	};

	mtl_rx_setup: rx-queues-config {
		snps,rx-queues-to-use = <4>;
		snps,rx-sched-sp;
		queue0 {
			snps,dcb-algorithm;
			snps,map-to-dma-channel = <0x0>;
			snps,priority = <0x0>;
		};
		queue1 {
			snps,dcb-algorithm;
			snps,map-to-dma-channel = <0x1>;
			snps,priority = <0x1>;
		};
		queue2 {
			snps,dcb-algorithm;
			snps,map-to-dma-channel = <0x2>;
			snps,priority = <0x1>;
		};
		queue3 {
			snps,dcb-algorithm;
			snps,map-to-dma-channel = <0x3>;
			snps,priority = <0x1>;
		};
	};

	mtl_tx_setup: tx-queues-config {
		snps,tx-queues-to-use = <4>;
		snps,tx-sched-wrr;
		queue0 {
			snps,weight = <0x10>;
			snps,dcb-algorithm;
			snps,priority = <0x0>;
		};
		queue1 {
			snps,avb-algorithm;
			snps,send_slope = <0x1000>;
			snps,idle_slope = <0x1000>;
			snps,high_credit = <0x3E800>;
			snps,low_credit = <0xFFC18000>;
			snps,priority = <0x1>;
		};
		queue2 {
			snps,avb-algorithm;
			snps,send_slope = <0x1000>;
			snps,idle_slope = <0x1000>;
			snps,high_credit = <0x3E800>;
			snps,low_credit = <0xFFC18000>;
			snps,priority = <0x1>;
		};
		queue3 {
			snps,avb-algorithm;
			snps,send_slope = <0x1000>;
			snps,idle_slope = <0x1000>;
			snps,high_credit = <0x3E800>;
			snps,low_credit = <0xFFC18000>;
			snps,priority = <0x1>;
		};
	};

	mdio {
		#address-cells = <0x1>;
		#size-cells = <0x0>;
		compatible = "snps,dwmac-mdio";
		phy1: phy@4 {
			device_type = "ethernet-phy";
			reg = <0x4>;
		};
	};

};
```

## Documentation/devicetree/bindings/net/qcom-emac.txt
```
Qualcomm EMAC Gigabit Ethernet Controller

Required properties:
- compatible : Should be "qcom,fsm9900-emac".
- reg : Offset and length of the register regions for the device
- reg-names : Register region names referenced in 'reg' above.
	Required register resource entries are:
	"base"   : EMAC controller base register block.
	"csr"    : EMAC wrapper register block.
	"sgmii"  : EMAC SGMII PHY register block.
	Optional register resource entries are:
	"ptp"    : EMAC PTP (1588) register block.
- interrupts : Interrupt numbers used by this controller
- interrupt-names : Interrupt resource names referenced in 'interrupts' above.
	Required interrupt resource entries are:
	"emac_core0"   : EMAC core0 interrupt.
	"sgmii_irq"   : EMAC SGMII interrupt.
- mac-address               : The 6-byte MAC address. If present, it is the
			      default MAC address.

Optional properties:
- phy-version : the version of the integrated emac phy, either 1 or 2.

The external phy child node:
- compatible : Should be "qcom,fsm9900-emac-phy".
- reg : The phy address

Example:
soc {
	#address-cells = <1>;
	#size-cells = <1>;
	dma-ranges = <0 0 0xffffffff>;

	emac0: ethernet@feb20000 {
		compatible = "qcom,fsm9900-emac";
		#address-cells = <1>;
		#size-cells = <1>;
		phy-version = <1>;
		reg-names = "base", "csr", "ptp", "sgmii";
		reg =   <0xfeb20000 0x10000>,
			<0xfeb36000 0x1000>,
			<0xfeb3c000 0x4000>,
			<0xfeb38000 0x400>;
		interrupt-parent = <&emac0>;
		#interrupt-cells = <1>;
		interrupts = <76 80>;
		interrupt-names = "emac_core0", "sgmii_irq";
		phy0: ethernet-phy@0 {
			compatible = "qcom,fsm9900-emac-phy";
			reg = <0>;
		}

		pinctrl-names = "default";
		pinctrl-0 = <&mdio_pins_a>;
	};

	tlmm: pinctrl@fd510000 {
		compatible = "qcom,fsm9900-pinctrl";

		mdio_pins_a: mdio {
			state {
				pins = "gpio123", "gpio124";
				function = "mdio";
			};
		};
	};
```

## Documentation/devicetree/bindings/net/qualcomm-bluetooth.txt
```
Qualcomm Bluetooth Chips
---------------------

This documents the binding structure and common properties for serial
attached Qualcomm devices.

Serial attached Qualcomm devices shall be a child node of the host UART
device the slave device is attached to.

Required properties:
 - compatible: should contain one of the following:
   * "qcom,qca6174-bt"
   * "qcom,wcn3990-bt"

Optional properties for compatible string qcom,qca6174-bt:

 - enable-gpios: gpio specifier used to enable chip
 - clocks: clock provided to the controller (SUSCLK_32KHZ)

Optional properties for compatible string qcom,wcn3990-bt:

 - vddio-supply: Bluetooth wcn3990 VDD_IO supply regulator handle.
 - vddxo-supply: Bluetooth wcn3990 VDD_XO supply regulator handle.
 - vddrf-supply: Bluetooth wcn3990 VDD_RF supply regulator handle.
 - vddch0-supply: Bluetooth wcn3990 VDD_CH0 supply regulator handle.
 - max-speed: see Documentation/devicetree/bindings/serial/slave-device.txt

Examples:

serial@7570000 {
	label = "BT-UART";
	status = "okay";

	bluetooth {
		compatible = "qcom,qca6174-bt";

		enable-gpios = <&pm8994_gpios 19 GPIO_ACTIVE_HIGH>;
		clocks = <&divclk4>;
	};
};

serial@898000 {
	label = "BT-UART";
	status = "okay";

	bluetooth {
		compatible = "qcom,wcn3990-bt";
		vddio-supply = <&vreg_s4a_1p8>;
		vddxosupply = <&vreg_l7a_1p8>;
		vddrf-supply = <&vreg_l17a_1p3>;
		vddch0-supply = <&vreg_l25a_3p3>;
		max-speed = <3200000>;
	};
};
```

## Documentation/devicetree/bindings/net/realtek,rtl8211e.txt
```
Realtek RTL8211E Ethernet PHY

One batch of RTL8211E is slight broken, that needs some special (and
full of magic numbers) tweaking in order to make GbE to operate properly.
The only well-known board that used the broken batch is Pine64+.
Configure it through an Ethernet OF device node.

Optional properties:

- realtek,disable-rx-delay:
  If set, RX delay will be completely disabled (according to Realtek). This
  will affect the performance on non-broken boards.
  default: do not disable RX delay.

Examples:
Pine64+ with broken RTL8211E:
&mdio {
	ext_phy: ethernet-phy@0 {
		reg = <0>;
		realtek,disable-rx-delay;
	};
};
```

## Documentation/devicetree/bindings/net/realtek-bluetooth-serial.txt
```
Realtek bluetooth devices connected via a UART.
These devices typically also have a wi-fi connected via sdio - the
compatible described here is used just for referencing the bluetooth.

- compatible: should be "realtek,<name>-bt"
  except for "realtek,trl8761atv" - which only has a serial bluetooth connection
       "realtek,rtl8723as-bt"
       "realtek,rtl8723bs-bt"
       "realtek,rtl8723ds-bt"
       "realtek,rtl8761atv"
       "realtek,rtl8821as-bt"
       "realtek,rtl8821cs-bt"
       "realtek,rtl8822bs-bt"

Example:

&uart0 {
	status = "okay";
	pinctrl-0 = <&uart0_xfer>, <&uart0_cts>;
	bluetooth {
		compatible = "realtek,rtl8723bs-bluetooth";
		uart_rts_gpios = <&gpio4 19 GPIO_ACTIVE_LOW>;
		pinctrl-names = "default","rts_gpio";
		pinctrl-0 = <&uart0_rts>;
		pinctrl-1 = <&uart0_gpios>;
		BT,reset_gpio    = <&gpio4 29 GPIO_ACTIVE_HIGH>;
		BT,wake_gpio     = <&gpio4 26 GPIO_ACTIVE_HIGH>;
		BT,wake_host_irq = <&gpio4 31 GPIO_ACTIVE_HIGH>;
	};
};

this ensures that the bluetooth device is tied to the correct uart
```

## Documentation/devicetree/bindings/net/realtek-phy.txt
```
Realtek Ethernet PHY

Some boards require special tuning values of the phy.

Optional properties:

realtek,disable-eee-1000t:
realtek,disable-eee-100tx:
  If set, respectively disable 1000-BaseT and 100-BaseTx energy efficient
  ethernet capabilty advertisement
  default: Leave the phy default settings unchanged (capabilities advertised)

Example:

&mdio0 {
	ethernetphy0: ethernet-phy@0 {
		reg = <0>;
		realtek,disable-eee-1000t;
	};
};
```

## Documentation/devicetree/bindings/net/rfkill-regulator.txt
```
Device tree bindings for the rfkill-regulator driver

Required properties:
  - compatible:	should be "rfkill-regulator"
  - rfkill-name:	the name of this rfkill device
  - rfkill-type:	the type of this rfkill device;
			must correspond to a valid rfkill_type from <uapi/linux/rfkill.h>
  - vrfkill-supply:	phandle to a regulator

Example:

	wlan-rfkill {
		compatible = "rfkill-regulator";
		rfkill-name = "WLAN power switch";
		rfkill-type = <1>;

		vrfkill-supply = <&wlan_power>;
	};
```

## Documentation/devicetree/bindings/net/sff-sfp.txt
```
Small Form Factor (SFF) Committee Small Form-factor Pluggable (SFP)
Transceiver

Required properties:

- compatible : must be "sff,sfp"

Optional Properties:

- i2c-bus : phandle of an I2C bus controller for the SFP two wire serial
  interface

- moddef0-gpio : phandle of the MOD-DEF0 (AKA Mod_ABS) module presence input
  gpio signal

- los-gpio : phandle of the Receiver Loss of Signal Indication input gpio
  signal

- tx-fault-gpio : phandle of the Module Transmitter Fault input gpio signal

- tx-disable-gpio : phandle of the Transmitter Disable output gpio signal

- rate-select-gpio : phandle of the Rx Signaling Rate Select (AKA RS0) output
  gpio
```
