## Documentation/devicetree/bindings/net/mdio.txt
```
Common MDIO bus properties.

These are generic properties that can apply to any MDIO bus.

Optional properties:
- reset-gpios: List of one or more GPIOs that control the RESET lines
  of the PHYs on that MDIO bus.
- reset-delay-us: RESET pulse width as per PHY datasheet.

Example :

	davinci_mdio: ethernet@0x5c030000 {
		compatible = "ti,davinci_mdio";
		ti,hwmods = "davinci_mdio";
		reg = <0x5c030000 0x1000>;
		#address-cells = <1>;
		#size-cells = <0>;
		reset-gpios = <&gpio2 5 GPIO_ACTIVE_LOW>;
		reset-delay-us = <2>;   /* PHY datasheet states 1uS min */
	};
```

## Documentation/devicetree/bindings/net/mediatek-dwmac.txt
```
MediaTek DWMAC glue layer controller

This file documents platform glue layer for stmmac.
Please see stmmac.txt for the other unchanged properties.

The device node has following properties.

Required properties:
- compatible:  Should be "mediatek,mt2712-gmac" for MT2712 SoC
- reg:  Address and length of the register set for the device
- interrupts:  Should contain the MAC interrupts
- interrupt-names: Should contain a list of interrupt names corresponding to
	the interrupts in the interrupts property, if available.
	Should be "macirq" for the main MAC IRQ
- clocks: Must contain a phandle for each entry in clock-names.
- clock-names: The name of the clock listed in the clocks property. These are
	"axi", "apb", "mac_main", "ptp_ref" for MT2712 SoC
- mac-address: See ethernet.txt in the same directory
- phy-mode: See ethernet.txt in the same directory

Optional properties:
- mediatek,tx-delay: TX clock delay macro value. Range is 0~31. Default is 0.
	It should be defined for rgmii/rgmii-rxid/mii interface.
- mediatek,rx-delay: RX clock delay macro value. Range is 0~31. Default is 0.
	It should be defined for rgmii/rgmii-txid/mii/rmii interface.
- mediatek,fine-tune: boolean property, if present indicates that fine delay
	is selected for rgmii interface.
	If present, tx-delay/rx-delay is 170+/-50ps per stage.
	Else tx-delay/rx-delay of coarse delay macro is 0.55+/-0.2ns per stage.
	This property do not apply to non-rgmii PHYs.
	Only coarse-tune delay is supported for mii/rmii PHYs.
- mediatek,rmii-rxc: boolean property, if present indicates that the rmii
	reference clock, which is from external PHYs, is connected to RXC pin
	on MT2712 SoC.
	Otherwise, is connected to TXC pin.
- mediatek,txc-inverse: boolean property, if present indicates that
	1. tx clock will be inversed in mii/rgmii case,
	2. tx clock inside MAC will be inversed relative to reference clock
	   which is from external PHYs in rmii case, and it rarely happen.
- mediatek,rxc-inverse: boolean property, if present indicates that
	1. rx clock will be inversed in mii/rgmii case.
	2. reference clock will be inversed when arrived at MAC in rmii case.
- assigned-clocks: mac_main and ptp_ref clocks
- assigned-clock-parents: parent clocks of the assigned clocks

Example:
	eth: ethernet@1101c000 {
		compatible = "mediatek,mt2712-gmac";
		reg = <0 0x1101c000 0 0x1300>;
		interrupts = <GIC_SPI 237 IRQ_TYPE_LEVEL_LOW>;
		interrupt-names = "macirq";
		phy-mode ="rgmii-id";
		mac-address = [00 55 7b b5 7d f7];
		clock-names = "axi",
			      "apb",
			      "mac_main",
			      "ptp_ref",
			      "ptp_top";
		clocks = <&pericfg CLK_PERI_GMAC>,
			 <&pericfg CLK_PERI_GMAC_PCLK>,
			 <&topckgen CLK_TOP_ETHER_125M_SEL>,
			 <&topckgen CLK_TOP_ETHER_50M_SEL>;
		assigned-clocks = <&topckgen CLK_TOP_ETHER_125M_SEL>,
				  <&topckgen CLK_TOP_ETHER_50M_SEL>;
		assigned-clock-parents = <&topckgen CLK_TOP_ETHERPLL_125M>,
					 <&topckgen CLK_TOP_APLL1_D3>;
		mediatek,pericfg = <&pericfg>;
		mediatek,tx-delay = <9>;
		mediatek,rx-delay = <9>;
		mediatek,fine-tune;
		mediatek,rmii-rxc;
		mediatek,txc-inverse;
		mediatek,rxc-inverse;
		snps,txpbl = <32>;
		snps,rxpbl = <32>;
		snps,reset-gpio = <&pio 87 GPIO_ACTIVE_LOW>;
		snps,reset-active-low;
	};
```

## Documentation/devicetree/bindings/net/mediatek-gmac.txt
```
MediaTek Gigabit Ethernet controller
=========================================

The gigabit ethernet controller can be found on MediaTek SoCs.

* Ethernet controller node

Required properties:
- compatible: Should be
	"mediatek,mt2712-eth": for MT2712 SoC
- reg: Address and length of the register set for the device
- interrupts: Should contain the MAC interrupts
- interrupt-names: the name of interrupt in the interrupts property. These are
	"macirq": For MT2712 SoC
- clocks: the clock used by the controller
- clock-names: the names of the clock listed in the clocks property. These are
	"axi", "apb", "mac_ext", "ptp", "ptp_parent", "ptp_top": For MT2712 SoC
- mac-address: See ethernet.txt in the same directory
- power-domains: phandle to the power domain that the ethernet is part of
- phy-mode: See ethernet.txt file in the same directory.
- reset-gpio: gpio number for phy reset.

Example:

eth: eth@1101c000 {
		compatible = "mediatek,mt2712-eth";
		reg = <0 0x1101c000 0 0x1200>;
		interrupts = <GIC_SPI 237 IRQ_TYPE_LEVEL_LOW>;
		interrupt-names = "macirq";
		phy-mode ="rgmii";
		mac-address = [00 55 7b b5 7d f7];
		clock-names = "axi",
			      "apb",
			      "mac_ext",
			      "ptp",
			      "ptp_parent",
			      "ptp_top";
		clocks = <&pericfg CLK_PERI_GMAC>,
			 <&pericfg CLK_PERI_GMAC_PCLK>,
			 <&topckgen CLK_TOP_ETHER_125M_SEL>,
			 <&topckgen CLK_TOP_ETHER_50M_SEL>,
			 <&topckgen CLK_TOP_APLL1_D3>,
			 <&topckgen CLK_TOP_APLL1>;
		reset-gpio = <&pio 87 GPIO_ACTIVE_HIGH>;
	};
```

## Documentation/devicetree/bindings/net/mediatek-net.txt
```
iMEdiatek Frame Engine Ethernet controller
=======================================

The frame engine ethernet controller can be found on Ralink and Mediatek SoCs
(RT288x, RT3x5x, RT366x, RT388x, rt5350, mt7620, mt7621, mt76x8).

Depending on the SoC, there is a number of ports connected to the CPU port
directly and/or via a (gigabit-)switch. Newer gigabit SoCs can support
a dual MAC setup.

* Ethernet controller node

Required properties:
- compatible: Should be one of "ralink,rt2880-eth", "ralink,rt3050-eth",
  "ralink,rt3050-eth", "ralink,rt3883-eth", "ralink,rt5350-eth",
  "mediatek,mt7620-eth", "mediatek,mt7621-eth", "mediatek,mt7623-eth"
- reg: Address and length of the register set for the device
- interrupts: Should contain the frame engines interrupt
- mediatek,ethsys: phandle to the syscon node that handles the port setup

Required properties for ARM based SoCs:
- clocks: the clock used by the core
- clock-names: the names of the clock listed in the clocks property
- power-domains: phandle the to power domain that the ethernet is part of

Optional properties:
- interrupt-parent: Should be the phandle for the interrupt controller
  that services interrupts for this device
- mediatek,switch : phandle pointing at the device node of the switch device


* Ethernet port node for MT7620

We need to define which physical port is wired and how it should be setup.

Required properties:
- compatible: Should be "mediatek,eth-port"
- reg: The number of the physical port
- phy-handle: reference to the node describing the phy


* Ethernet MAC node - dual MAC SoCs only

Required properties:
- compatible: Should be "mediatek,eth-mac"
- reg: The number of the MAC


Example for singel MAC SoC:

mdio-bus {
	status = "okay";

	phy4: ethernet-phy@4 {
		reg = <4>;
		phy-mode = "rgmii";
	};
};

eth: ethernet@10100000 {
	compatible = "mediatek,mt7620-eth";
	reg = <0x10100000 10000>;

	#address-cells = <1>;
	#size-cells = <0>;

	interrupt-parent = <&cpuintc>;
	interrupts = <5>;

	mediatek,switch = <&gsw>;

	port@4 {
		status = "okay";
		phy-mode = "rgmii";
		phy-handle = <&phy4>;
	};
};


Example for dual MAC SoC:

eth: ethernet@1b100000 {
	compatible = "mediatek,mt7623-eth";
	reg = <0 0x1b100000 0 0x10000>;

	clocks = <&topckgen CLK_TOP_ETHIF_SEL>;
	clock-names = "ethif";

	interrupts = <GIC_SPI 200 IRQ_TYPE_LEVEL_LOW>;
	power-domains = <&scpsys MT2701_POWER_DOMAIN_ETH>;

	mediatek,ethsys = <&ethsys>;
	mediatek,switch = <&gsw>;

	#address-cells = <1>;
	#size-cells = <0>;

	status = "disabled";

	gmac1: mac@0 {
		compatible = "mediatek,eth-mac";
		reg = <0>;

		status = "okay";
	};

	gmac2: mac@1 {
		compatible = "mediatek,eth-mac";
		reg = <1>;

		status = "okay";
	};
};
```

## Documentation/devicetree/bindings/net/mellanox,mlxsw.txt
```
Mellanox Technologies Switch ASICs

This file provides information, what the device node
for the Switch ASIC interface contains.

Required properties:
- compatible		: "mellanox,mlxsw_minimal"
- reg			: The I2C address of the device.

Optional properties:
- cooling-phandle	: phandle of the cooling device, which is to be used
			  for the zone thermal control.
			  If absent, cooling device controlled internally by
			  the ASIC may be used.

- trips			: the nodes to describe a point in the temperature
			  domain with key temperatures at which cooling is
			  recommended. Each node must contain the next values:
			  - type: the trip type. Expected values are:
			    0 - a trip point to enable active cooling;
			    1 - a trip point to enable passive cooling;
			    2 - a trip point to notify emergency;
			  - temperature: unsigned integer indicating the trip
			    temperature level in millicelsius;
			  - minimum cooling state allowed within the trip node;
			  - maximum cooling state allowed within the trip node;

Example:
	asic_thermal: mlxsw_minimal@48 {
		compatible = "mlxsw_minimal";
		reg = <0x48>;
		status = "disabled";
		cooling-phandle = <&cooling>;

		trips {
			trip@0 {
				trip = <0 75000 0 0>;
			};
			trip@1 {
				trip = <2 85000 1 5>;
			};
			trip@3 {
				trip = <2 105000 5 5>;
			};
		};
	};
```

## Documentation/devicetree/bindings/net/meson-dwmac.txt
```
* Amlogic Meson DWMAC Ethernet controller

The device inherits all the properties of the dwmac/stmmac devices
described in the file stmmac.txt in the current directory with the
following changes.

Required properties on all platforms:

- compatible:	Depending on the platform this should be one of:
			- "amlogic,meson6-dwmac"
			- "amlogic,meson8b-dwmac"
			- "amlogic,meson-gxbb-dwmac"
		Additionally "snps,dwmac" and any applicable more
		detailed version number described in net/stmmac.txt
		should be used.

- reg:	The first register range should be the one of the DWMAC
	controller. The second range is is for the Amlogic specific
	configuration (for example the PRG_ETHERNET register range
	on Meson8b and newer)

Required properties on Meson8b and newer:
- clock-names:	Should contain the following:
		- "stmmaceth" - see stmmac.txt
		- "clkin0" - first parent clock of the internal mux
		- "clkin1" - second parent clock of the internal mux

Optional properties on Meson8b and newer:
- amlogic,tx-delay:	The internal RGMII TX clock delay configuration.
			Defaults to DWMAC_MESON8B_TXDLY_QUARTER_CYCLE
			when not given. All possible values are defined
			as preprocessor macro in
			<dt-bindings/net/dwmac-meson8b.h>.
			The delay is specified as divider for the
			internal clock (RGMII typically uses a 125MHz
			clock clock (= 8ns per cycle), so setting
			DWMAC_MESON8B_TXDLY_QUARTER_CYCLE
			results in a TX delay of 8ns/4 = 2ns.

Example for Meson6:

	ethmac: ethernet@c9410000 {
		compatible = "amlogic,meson6-dwmac", "snps,dwmac";
		reg = <0xc9410000 0x10000
		       0xc1108108 0x4>;
		interrupts = <0 8 1>;
		interrupt-names = "macirq";
		clocks = <&clk81>;
		clock-names = "stmmaceth";
	}

Example for GXBB:
	ethmac: ethernet@c9410000 {
		compatible = "amlogic,meson-gxbb-dwmac", "snps,dwmac";
		reg = <0x0 0xc9410000 0x0 0x10000>,
			<0x0 0xc8834540 0x0 0x8>;
		interrupts = <0 8 1>;
		interrupt-names = "macirq";
		clocks = <&clkc CLKID_ETH>,
				<&clkc CLKID_FCLK_DIV2>,
				<&clkc CLKID_MPLL2>;
		clock-names = "stmmaceth", "clkin0", "clkin1";
		phy-mode = "rgmii";
		status = "disabled";
	};
```

## Documentation/devicetree/bindings/net/micrel-ks8995.txt
```
Micrel KS8995 SPI controlled Ethernet Switch families

Required properties (according to spi-bus.txt):
- compatible: either "micrel,ks8995", "micrel,ksz8864" or "micrel,ksz8795"

Optional properties:
- reset-gpios : phandle of gpio that will be used to reset chip during probe

Example:

spi-master {
	...
	ksz8795 {
		compatible = "micrel,ksz8795";

		reg = <0>;
		spi-max-frequency = <50000000>;
		reset-gpios = <&gpio0 46 1>;
	};
};
```
