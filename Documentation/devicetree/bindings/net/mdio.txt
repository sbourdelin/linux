## Documentation/devicetree/bindings/net/smsc-com20020.txt
```
SMSC com20020 Arcnet network controller

Required property:
- timeout-ns: Arcnet bus timeout, Idle Time (328000 - 20500)
- bus-speed-bps: Arcnet bus speed (10000000 - 156250)
- smsc,xtal-mhz: External oscillator frequency
- smsc,backplane-enabled: Controller use backplane mode
- reset-gpios: Chip reset pin
- interrupts: Should contain controller interrupt

arcnet@28000000 {
	compatible = "smsc,com20020";

	timeout-ns = <20500>;
	bus-speed-hz = <10000000>;
	smsc,xtal-mhz = <20>;
	smsc,backplane-enabled;

	reset-gpios = <&gpio3 21 GPIO_ACTIVE_LOW>;
	interrupts = <&gpio2 10 GPIO_ACTIVE_LOW>;
};
```

## Documentation/devicetree/bindings/net/smsc-lan87xx.txt
```
SMSC LAN87xx Ethernet PHY

Some boards require special tuning values. Configure them
through an Ethernet OF device node.

Optional properties:

- disable-energy-detect:
  If set, do not enable energy detect mode for the SMSC phy.
  default: enable energy detect mode

Examples:

	/* Attach to an Ethernet device with autodetected PHY */
	&cpsw_emac0 {
		phy_id = <&davinci_mdio>, <0>;
		phy-mode = "mii";
		disable-energy-detect;
	};
```

## Documentation/devicetree/bindings/net/snps,dwc-qos-ethernet.txt
```
* Synopsys DWC Ethernet QoS IP version 4.10 driver (GMAC)

This binding supports the Synopsys Designware Ethernet QoS (Quality Of Service)
IP block. The IP supports multiple options for bus type, clocking and reset
structure, and feature list. Consequently, a number of properties and list
entries in properties are marked as optional, or only required in specific HW
configurations.

Required properties:
- compatible: One of:
  - "axis,artpec6-eqos", "snps,dwc-qos-ethernet-4.10"
    Represents the IP core when integrated into the Axis ARTPEC-6 SoC.
  - "nvidia,tegra186-eqos", "snps,dwc-qos-ethernet-4.10"
    Represents the IP core when integrated into the NVIDIA Tegra186 SoC.
  - "snps,dwc-qos-ethernet-4.10"
    This combination is deprecated. It should be treated as equivalent to
    "axis,artpec6-eqos", "snps,dwc-qos-ethernet-4.10". It is supported to be
    compatible with earlier revisions of this binding.
- reg: Address and length of the register set for the device
- clocks: Phandle and clock specifiers for each entry in clock-names, in the
  same order. See ../clock/clock-bindings.txt.
- clock-names: May contain any/all of the following depending on the IP
  configuration, in any order:
  - "tx"
    (Alternate name "phy_ref_clk"; only one alternate must appear.)
    The EQOS transmit path clock. The HW signal name is clk_tx_i.
    In some configurations (e.g. GMII/RGMII), this clock also drives the PHY TX
    path. In other configurations, other clocks (such as tx_125, rmii) may
    drive the PHY TX path.
  - "rx"
    The EQOS receive path clock. The HW signal name is clk_rx_i.
    In some configurations (e.g. GMII/RGMII), this clock also drives the PHY RX
    path. In other configurations, other clocks (such as rx_125, pmarx_0,
    pmarx_1, rmii) may drive the PHY RX path.
  - "slave_bus"
    (Alternate name "apb_pclk"; only one alternate must appear.)
    The CPU/slave-bus (CSR) interface clock. Despite the name, this applies to
    any bus type; APB, AHB, AXI, etc. The HW signal name is hclk_i (AHB) or
    clk_csr_i (other buses).
  - "master_bus"
    The master bus interface clock. Only required in configurations that use a
    separate clock for the master and slave bus interfaces. The HW signal name
    is hclk_i (AHB) or aclk_i (AXI).
  - "ptp_ref"
    The PTP reference clock. The HW signal name is clk_ptp_ref_i.

  Note: Support for additional IP configurations may require adding the
  following clocks to this list in the future: clk_rx_125_i, clk_tx_125_i,
  clk_pmarx_0_i, clk_pmarx1_i, clk_rmii_i, clk_revmii_rx_i, clk_revmii_tx_i.

  The following compatible values require the following set of clocks:
  - "nvidia,tegra186-eqos", "snps,dwc-qos-ethernet-4.10":
    - "slave_bus"
    - "master_bus"
    - "rx"
    - "tx"
    - "ptp_ref"
  - "axis,artpec6-eqos", "snps,dwc-qos-ethernet-4.10":
    - "phy_ref_clk"
    - "apb_clk"
- interrupt-parent: Should be the phandle for the interrupt controller
  that services interrupts for this device
- interrupts: Should contain the core's combined interrupt signal
- phy-mode: See ethernet.txt file in the same directory
- resets: Phandle and reset specifiers for each entry in reset-names, in the
  same order. See ../reset/reset.txt.
- reset-names: May contain any/all of the following depending on the IP
  configuration, in any order:
  - "eqos". The reset to the entire module. The HW signal name is hreset_n
    (AHB) or aresetn_i (AXI).

  The following compatible values require the following set of resets:
  (the reset properties may be omitted if empty)
  - "nvidia,tegra186-eqos", "snps,dwc-qos-ethernet-4.10":
    - "eqos".
  - "axis,artpec6-eqos", "snps,dwc-qos-ethernet-4.10":
    - None.

Optional properties:
- dma-coherent: Present if dma operations are coherent
- mac-address: See ethernet.txt in the same directory
- local-mac-address: See ethernet.txt in the same directory
- phy-reset-gpios: Phandle and specifier for any GPIO used to reset the PHY.
  See ../gpio/gpio.txt.
- snps,en-lpi: If present it enables use of the AXI low-power interface
- snps,write-requests: Number of write requests that the AXI port can issue.
  It depends on the SoC configuration.
- snps,read-requests: Number of read requests that the AXI port can issue.
  It depends on the SoC configuration.
- snps,burst-map: Bitmap of allowed AXI burst lengts, with the LSB
  representing 4, then 8 etc.
- snps,txpbl: DMA Programmable burst length for the TX DMA
- snps,rxpbl: DMA Programmable burst length for the RX DMA
- snps,en-tx-lpi-clockgating: Enable gating of the MAC TX clock during
  TX low-power mode.
- phy-handle: See ethernet.txt file in the same directory
- mdio device tree subnode: When the GMAC has a phy connected to its local
    mdio, there must be device tree subnode with the following
    required properties:
    - compatible: Must be "snps,dwc-qos-ethernet-mdio".
    - #address-cells: Must be <1>.
    - #size-cells: Must be <0>.

    For each phy on the mdio bus, there must be a node with the following
    fields:

    - reg: phy id used to communicate to phy.
    - device_type: Must be "ethernet-phy".
    - fixed-mode device tree subnode: see fixed-link.txt in the same directory

Examples:
ethernet2@40010000 {
	clock-names = "phy_ref_clk", "apb_pclk";
	clocks = <&clkc 17>, <&clkc 15>;
	compatible = "snps,dwc-qos-ethernet-4.10";
	interrupt-parent = <&intc>;
	interrupts = <0x0 0x1e 0x4>;
	reg = <0x40010000 0x4000>;
	phy-handle = <&phy2>;
	phy-mode = "gmii";
	phy-reset-gpios = <&gpioctlr 43 GPIO_ACTIVE_LOW>;

	snps,en-tx-lpi-clockgating;
	snps,en-lpi;
	snps,write-requests = <2>;
	snps,read-requests = <16>;
	snps,burst-map = <0x7>;
	snps,txpbl = <8>;
	snps,rxpbl = <2>;

	dma-coherent;

	mdio {
		#address-cells = <0x1>;
		#size-cells = <0x0>;
		phy2: phy@1 {
			compatible = "ethernet-phy-ieee802.3-c22";
			device_type = "ethernet-phy";
			reg = <0x1>;
		};
	};
};
```

## Documentation/devicetree/bindings/net/stm32-dwmac.txt
```
STMicroelectronics STM32 / MCU DWMAC glue layer controller

This file documents platform glue layer for stmmac.
Please see stmmac.txt for the other unchanged properties.

The device node has following properties.

Required properties:
- compatible:  Should be "st,stm32-dwmac" to select glue, and
	       "snps,dwmac-3.50a" to select IP vesrion.
- clocks: Should contain the GMAC main clock, and tx clock
- compatible:  Should be "st,stm32-dwmac" to select glue and
	       "snps,dwmac-3.50a" to select IP version.
- clocks: Should contain the MAC main clock
- clock-names: Should contain the clock names "stmmaceth".
- st,syscon : Should be phandle/offset pair. The phandle to the syscon node which
	      encompases the glue register, and the offset of the control register.

Optional properties:
- clocks: Could contain:
	- the tx clock,
	- the rx clock
- clock-names: Could contain the clock names "tx-clk", "rx-clk"

Example:

		ethernet0: dwmac@40028000 {
			device_type = "network";
			compatible = "st,stm32-dwmac", "snps,dwmac-3.50a";
			status = "disabled";
			reg = <0x40028000 0x8000>;
			reg-names = "stmmaceth";
			interrupts = <0 61 0>, <0 62 0>;
			interrupt-names = "macirq", "eth_wake_irq";
			clock-names = "stmmaceth", "tx-clk", "rx-clk";
			clocks = <&rcc 0 25>, <&rcc 0 26>, <&rcc 0 27>;
			st,syscon = <&syscfg 0x4>;
			snps,pbl = <32>;
			snps,mixed-burst;
			dma-ranges;
		};
```

## Documentation/devicetree/bindings/net/ti,dp83867.txt
```
* Texas Instruments - dp83867 Giga bit ethernet phy

Required properties:
	- reg - The ID number for the phy, usually a small integer
	- ti,rx-internal-delay - RGMII Receive Clock Delay - see dt-bindings/net/ti-dp83867.h
		for applicable values
	- ti,tx-internal-delay - RGMII Transmit Clock Delay - see dt-bindings/net/ti-dp83867.h
		for applicable values
	- ti,fifo-depth - Transmitt FIFO depth- see dt-bindings/net/ti-dp83867.h
		for applicable values

Optional property:
	- ti,impedance-control - MAC Interface Impedance control to vary the
				 output impedance with an approximate range
				 from 35-70 ohms in 32 steps. Value range can
				 be 0x0 to 0x1f. Lowest impedance value is
				 0x1f and highest impedance being 0x0.

Default child nodes are standard Ethernet PHY device
nodes as described in Documentation/devicetree/bindings/net/phy.txt

Example:

	ethernet-phy@0 {
		reg = <0>;
		ti,rx-internal-delay = <DP83867_RGMIIDCTL_2_25_NS>;
		ti,tx-internal-delay = <DP83867_RGMIIDCTL_2_75_NS>;
		ti,fifo-depth = <DP83867_PHYCR_FIFO_DEPTH_4_B_NIB>;
	};

Datasheet can be found:
http://www.ti.com/product/DP83867IR/datasheet
```

## Documentation/devicetree/bindings/net/wireless/allwinner,xr819.txt
```
Allwinner XRadio wireless SDIO devices

This node provides properties for controlling the XRadio wireless device. The
node is expected to be specified as a child node to the SDIO controller that
connects the device to the system.

Required properties:

 - compatible : Should be "allwinner,xr819".

Optional properties:
 - interrupt-parent : the phandle for the interrupt controller to which the
	device interrupts are connected.
 - interrupts : specifies attributes for the out-of-band interrupt (host-wake).
	When not specified the device will use in-band SDIO interrupts.

Example:

mmc1: mmc@01c10000 {
	#address-cells = <1>;
	#size-cells = <0>;

	pinctrl-names = "default";
	pinctrl-0 = <&mmc1_pins_a>;
	vmmc-supply = <&reg_vcc_wifi>;
	mmc-pwrseq = <&wifi_pwrseq>;
	bus-width = <4>;
	non-removable;
	status = "okay";

	xr819: sdio_wifi@1 {
		reg = <1>;
		compatible = "allwinner,xr819";
		interrupt-parent = <&pio>;
		interrupts = <6 10 IRQ_TYPE_EDGE_RISING>;
	};
};
```

## Documentation/devicetree/bindings/net/wireless/ieee80211.txt
```
Common IEEE 802.11 properties

This provides documentation of common properties that are valid for all wireless
devices.

Optional properties:
 - ieee80211-freq-limit : list of supported frequency ranges in KHz. This can be
	used to specify extra hardware limitations caused by e.g. used antennas
	or power amplifiers.

Example:

pcie@0,0 {
	reg = <0x0000 0 0 0 0>;
	wifi@0,0 {
		reg = <0x0000 0 0 0 0>;
		ieee80211-freq-limit = <2402000 2482000>,
				       <5170000 5250000>;
	};
};
```

## Documentation/devicetree/bindings/net/wireless/mediatek,mt76.txt
```
* MediaTek mt76xx devices

This node provides properties for configuring the MediaTek mt76xx wireless
device. The node is expected to be specified as a child node of the PCI
controller to which the wireless chip is connected.

Optional properties:

- mac-address: See ethernet.txt in the parent directory
- local-mac-address: See ethernet.txt in the parent directory
- ieee80211-freq-limit: See ieee80211.txt
- mediatek,mtd-eeprom: Specify a MTD partition + offset containing EEPROM data

&pcie {
	status = "okay";

	pcie0 {
		mt76@0,0 {
			reg = <0x0000 0 0 0 0>;
			device_type = "pci";
			ieee80211-freq-limit = <5000000 6000000>;
			mediatek,mtd-eeprom = <&factory 0x8000>;
		};
	};
};
```
