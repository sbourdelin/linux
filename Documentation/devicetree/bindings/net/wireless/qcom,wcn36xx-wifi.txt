## Documentation/devicetree/bindings/net/wireless/qcom,wcn36xx-wifi.txt
```
Qualcomm WCN36xx WiFi Binding

This binding describes the Qualcomm WCN36xx WiFi hardware. The hardware block
is part of the Qualcomm WCNSS core, a WiFi/BT/FM combo chip, found in a variety
of Qualcomm platforms.

- compatible:
	Usage: required
	Value type: <string>
	Definition: must be one of:
		    "qcom,wcn3620-wlan",
		    "qcom,wcn3660-wlan",
		    "qcom,wcn3680-wlan"

- qcom,smd-channel:
	Usage: required
	Value type: <string>
	Definition: standard SMD property specifying the SMD channel used for
		    communication with the WiFi firmware

- interrupts:
	Usage: required
	Value type: <prop-encoded-array>
	Definition: should specify the two IRQs for tx and rx respectively

- qcom,wcnss-mmio:
	Usage: required
	Value type: <prop-encoed-array>
	Definition: should specify base address and size of the WiFi related
		    registers of WCNSS

- qcom,state:
	Usage: required
	Value type: <prop-encoded-array>
	Definition: should specify the tx-enable and tx-ring-empty state
		    references

- qcom,state-names:
	Usage: required
	Value type: <stringlist>
	Definition: name of the states, must be "tx-enable", "tx-rings-empty";

- local-mac-address:
	Usage: optional
	Value type: <prop-encoded-array> encoded as array of hex numbers
	Definition: specifies MAC address that was assigned to the network
		    device described by the node containing this property.

= EXAMPLE
The following example represents a SMD node, with one edge representing the
"pronto" subsystem, with the wcn3680 WiFi device described; as found on the
8974 platform.

smd {
	compatible = "qcom,smd";

	pronto {
		interrupts = <0 142 1>;

		qcom,ipc = <&apcs 8 17>;
		qcom,smd-edge = <6>;

		wifi {
			compatible = "qcom,wcn3680-wlan";
			qcom,smd-channels = "WLAN_CTRL";

			interrupts = <0 145 0>, <0 146 0>;
			interrupt-names = "tx", "rx";

			qcom,wcnss-mmio = <0xfb000000 0x21b000>;

			qcom,state = <&apps_smsm 10>, <&apps_smsm 9>;
			qcom,state-names = "tx-enable", "tx-rings-empty";
		};
	};
};
```

## Documentation/devicetree/bindings/net/wireless/ti,wlcore,spi.txt
```
* Texas Instruments wl1271 wireless lan controller

The wl1271 chip can be connected via SPI or via SDIO. This
document describes the binding for the SPI connected chip.

Required properties:
- compatible :          Should be "ti,wl1271"
- reg :                 Chip select address of device
- spi-max-frequency :   Maximum SPI clocking speed of device in Hz
- ref-clock-frequency : Reference clock frequency
- interrupts :          Should contain interrupt line and trigger type
- interrupt-parent :    Should be the phandle for the interrupt controller
                        that services interrupts for this device
- vwlan-supply :        Point the node of the regulator that controls the wl1271 chip WLAN_EN pin

Optional properties:
- clock-xtal :          boolean, clock is generated from XTAL

- Please consult Documentation/devicetree/bindings/spi/spi-bus.txt
  for optional SPI connection related properties,

Examples:

&spi1 {
	wl1271@1 {
		compatible = "ti,wl1271";

		reg = <1>;
		spi-max-frequency = <48000000>;
		clock-xtal;
		interrupt-parent = <&gpio3>;
		interrupts = <8 IRQ_TYPE_LEVEL_HIGH>;
		wifi-supply = <&wifi_fixed>;
	};
};
```

## Documentation/devicetree/bindings/nfc/pn532.txt
```
NXP PN532 NFC Chip

Required properties:
- compatible: Should be
    - "nxp,pn532" Place a node with this inside the devicetree node of the bus
                  where the NFC chip is connected to.
                  Currently the kernel has phy bindings for uart and i2c.
    - "nxp,pn532-i2c" (DEPRECATED) only works for the i2c binding.
    - "nxp,pn533-i2c" (DEPRECATED) only works for the i2c binding.

Required properties if connected on i2c:
- reg: for the i2c bus address. This is fixed at 0x48 for the PN532.

Example uart:

uart4: serial@49042000 {
        compatible = "ti,omap3-uart";

        pn532: nfc {
                compatible = "nxp,pn532";
        };
};

Example i2c:

i2c1: i2c@0 {
        compatible = "ti,omap3-i2c";

        pn532: nfc {
                compatible = "nxp,pn532";
                reg = <0x48>;
        };
};
```

## Documentation/devicetree/bindings/nvmem/atmel-secumod.txt
```
= Atmel Secumod device tree bindings =

This binding is intended to represent Atmel's Secumod which is found
in SAMA5D2 and perhaps others.

Required properties:
- compatible: should be "atmel,sama5d2-secumod"
- reg: Should contain RAM location and length, followed
       by register location and length of the Secumod controller.

= Data cells =
Are child nodes of secumod, bindings of which as described in
bindings/nvmem/nvmem.txt

Example:

    secumod@fc040000 {
            compatible = "atmel,sama5d2-secumod";
            reg = <0xf8044000 0x1420>, <0xfc040000 0x4000>;
            reg-names = "SECURAM", "SECUMOD";
            status = "okay";

            #address-cells = <1>;
            #size-cells = <1>;
            ranges;

            secram-auto-erasable@0 {
                    reg = <0x0000 0x1000>;
            };
            secram@1000 {
                    reg = <0x1000 0x400>;
            };
            ram@1400 {
                    reg = <0x1400 0x20>;
            };
    };

= Data consumers =
Are device nodes which consume nvmem data cells.

For example:

	ram {
		...
		nvmem-cells = <&ram>;
		nvmem-cell-names = "RAM";
	};
```

## Documentation/devicetree/bindings/nvmem/blob.txt
```
= Deviece Tree Embedded Blob As NVMEM Device =

This binding is designed to provide a way for a developer to reference
data, built-in into device tree blob file, as NVMEM provider and acccess
certain portions of that data as NVMEM cells using NVMEM consumer API.

Required properties:
- compatible: should be "nvmem-blob"
- data: specifies data contained in nvmem device

= Data cells =
Are child nodes of nvmem-composite, bindings of which as described in
bindings/nvmem/nvmem.txt

Example:

	a-blob {
		compatible = "nvmem-blob";
		data = [aa bb cc dd ee];

		cell1: cell@0 {
			reg = <0 5>;
		};
	};

= Data consumers =
Are device nodes which consume nvmem data cells.

Example:

	a-node {
		...
		nvmem-cells = <&cell1>;
		nvmem-cell-names = "some-data";
	};
```

## Documentation/devicetree/bindings/nvmem/composite.txt
```
= NVMEM cell compositor =

This binding is designed to provide a way for a developer to combine
portions of other NVMEM cell and acces that data as a signle NVMEM
cell using NVMEM consumer API.

Required properties:
- compatible: should be "nvmem-composite"
- layout: specifies which sources comprise data in nvmem device
  	  format is "<nvmem-cell-phandle offset size>"

= Data cells =
Are child nodes of nvmem-composite, bindings of which as described in
bindings/nvmem/nvmem.txt

Example:

	composite-nvmem {
		compatible = "nvmem-composite";
		layout = <&another_cell_a 0 2
 			  &another_cell_b 0 1
			  &another_cell_c 3 2>;

		cell1: cell@0 {
			reg = <0 5>;
		};
	}

the result of reading variable cell1 would be:

[a[0] a[1] b[0] c[3] c[4]],

where a[i], b[i], c[i], represnet i-th bytes of NVMEM cells
another_cell_a, another_cell_b and another_cell_c respectively

= Data consumers =
Are device nodes which consume nvmem data cells.

Example:

	a-node {
		nvmem-cells = <&cell1>;
		nvmem-cell-names = "some-data";
	};
```

## Documentation/devicetree/bindings/nvmem/snvs-lpgpr.txt
```
Device tree bindings for Low Power General Purpose Register found in i.MX6Q/D
Secure Non-Volatile Storage.

Required properties:
- compatible: should be one of
	"fsl,imx6q-snvs-lpgpr" (i.MX6Q/D/DL/S).
- offset: Should contain the offset relative to syscon parent node.
- regmap: Should contain a phandle pointing to syscon.

Example:
	snvs_lpgpr: snvs-lpgpr {
		compatible = "fsl,imx6q-snvs-lpgpr";
		regmap = <&snvs>;
		offset = <0x68>;
	};
```

## Documentation/devicetree/bindings/pci/amlogic,meson-pcie.txt
```
Amlogic Meson AXG DWC PCIE SoC controller

Amlogic Meson PCIe host controller is based on the Synopsys DesignWare PCI core.
It shares common functions with the PCIe DesignWare core driver and
inherits common properties defined in
Documentation/devicetree/bindings/pci/designware-pci.txt.

Additional properties are described here:

Required properties:
- compatible:
	should contain "amlogic,axg-pcie" to identify the core.
- reg:
	Should contain the configuration address space.
- reg-names: Must be
	- "elbi"	External local bus interface registers
	- "cfg"		Meson specific registers
	- "config"	PCIe configuration space
- clocks: Must contain an entry for each entry in clock-names.
- clock-names: Must include the following entries:
	- "pcie"
	- "pcie_bus"
	- "pcie_general"
	- "pcie_mipi_en"

Example configuration:

	pcie: pcie@dffff000 {
			compatible = "amlogic,axg-pcie", "snps,dw-pcie";
			reg = <0x0 0xf9800000 0x0 0x400000
					0x0 0xff646000 0x0 0x2000
					0x0 0xf9f00000 0x0 0x100000>;
			reg-names = "elbi", "cfg", "config";
			reset-gpio = <&gpio GPIOX_19 GPIO_ACTIVE_HIGH>;
			interrupts = <0 177 IRQ_TYPE_EDGE_RISING>;
			#interrupt-cells = <1>;
			interrupt-map-mask = <0 0 0 0>;
			interrupt-map = <0 0 0 0 &gic GIC_SPI 179 IRQ_TYPE_EDGE_RISING>;
			bus-range = <0x0 0xff>;
			#address-cells = <3>;
			#size-cells = <2>;
			device_type = "pci";
			phys = <&pcie_phy>;
			ranges = <0x82000000 0 0 0x0 0xf9c00000 0 0x00300000>;
			num-lanes = <1>;
			pcie-num = <1>;

			clocks = <&clkc CLKID_USB
					&clkc CLKID_MIPI_ENABLE
					&clkc CLKID_PCIE_A
					&clkc CLKID_PCIE_CML_EN0>;
			clock-names = "pcie_general",
					"pcie_refpll",
					"pcie_mipi_en",
					"pcie",
					"port";
	};
```

## Documentation/devicetree/bindings/pci/axis,artpec6-pcie.txt
```
* Axis ARTPEC-6 PCIe interface

This PCIe host controller is based on the Synopsis Designware PCIe IP
and thus inherits all the common properties defined in designware-pcie.txt.

Required properties:
- compatible: "axis,artpec6-pcie", "snps,dw-pcie"
- reg: base addresses and lengths of the pcie controller (DBI),
	the phy controller, and configuration address space.
- reg-names: Must include the following entries:
	- "dbi"
	- "phy"
	- "config"
- interrupts: A list of interrupt outputs of the controller. Must contain an
  entry for each entry in the interrupt-names property.
- interrupt-names: Must include the following entries:
	- "msi": The interrupt that is asserted when an MSI is received
- syscon: Should contain a link to the syscon device node.

Example:

	pcie@f8050000 {
		compatible = "axis,artpec6-pcie", "snps,dw-pcie";
		reg = <0xf8050000 0x2000
		       0xf8040000 0x1000
		       0xc0000000 0x1000>;
		reg-names = "dbi", "phy", "config";
		#address-cells = <3>;
		#size-cells = <2>;
		device_type = "pci";
			  /* downstream I/O */
		ranges = <0x81000000 0 0	  0xc0001000 0 0x00010000
			  /* non-prefetchable memory */
			  0x82000000 0 0xc0011000 0xc0011000 0 0x1ffef000>;
		num-lanes = <2>;
		interrupts = <GIC_SPI 148 IRQ_TYPE_LEVEL_HIGH>;
		interrupt-names = "msi";
		#interrupt-cells = <1>;
		interrupt-map-mask = <0 0 0 0x7>;
		interrupt-map = <0 0 0 1 &intc GIC_SPI 144 IRQ_TYPE_LEVEL_HIGH>,
		                <0 0 0 2 &intc GIC_SPI 145 IRQ_TYPE_LEVEL_HIGH>,
		                <0 0 0 3 &intc GIC_SPI 146 IRQ_TYPE_LEVEL_HIGH>,
		                <0 0 0 4 &intc GIC_SPI 147 IRQ_TYPE_LEVEL_HIGH>;
		syscon = <&syscon>;
	};
```

## Documentation/devicetree/bindings/pci/cdns,cdns-pcie-ep.txt
```
* Cadence PCIe endpoint controller

Required properties:
- compatible: should contain "cdns,cdns-pcie-ep" to identify the IP used.
- reg: should contain the controller register base address and AXI interface
  region base address respectively.
- reg-names: Must be "reg" and "mem" respectively.

Optional properties:
- max-functions: maximum number of functions that can be configured.

Example:

	pci@fc000000 {
		compatible = "cdns,cdns-pcie-ep";
		reg = <0x0 0xfc000000 0x0 0x01000000>, /* Base Address */
		      <0x0 0x80000000 0x0 0x40000000>; /* AXI region */
		reg-names = "reg", "mem";
		max-functions = /bits/ 8 <8>;
	};
```

## Documentation/devicetree/bindings/pci/cdns,cdns-pcie-host.txt
```
* Cadence PCIe host controller

This PCIe controller inherits the base properties defined in
host-generic-pci.txt.

Required properties:
- compatible: should contain "cdns,cdns-pcie-host" to identify the IP used.
- reg: Should contain the PCIe configuration window base address, controller
  register base address, and AXI interface region base address respectively.
- reg-names: Must be "cfg", "reg" and "mem" respectively.
- #address-cells: set to <3>
- #size-cells: set to <2>
- device_type: set to "pci"
- ranges: ranges for the PCI memory and I/O regions
- #interrupt-cells: set to <1>
- interrupt-map-mask and interrupt-map: standard PCI
	properties to define the mapping of the PCIe interface to interrupt
	numbers.

Example:

	pci@fb000000 {
		compatible = "cdns,cdns-pcie-host";
		device_type = "pci";
		#address-cells = <3>;
		#size-cells = <2>;
		bus-range = <0x0 0xff>;
		linux,pci-domain = <0>;

		// CPU_PHYSICAL(2)  SIZE(2)
		reg = <0x0 0x41000000  0x0 0x00001000>, /* Config space */
		      <0x0 0xfb000000  0x0 0x01000000>, /* Base Address */
		      <0x0 0x40000000  0x0 0x04000000>; /* AXI region */
		reg-names = "cfg", "reg", "mem";

		// BUS_ADDRESS(3)  CPU_PHYSICAL(1)  SIZE(2)
		ranges =
			<0x02000000 0x0 0x42000000  0x0 0x42000000  0x0 0x1000000>,
			<0x01000000 0x0 0x43000000  0x0 0x43000000  0x0 0x0010000>;


		#interrupt-cells = <0x1>;

		// PCI_DEVICE(3)  INT#(1)  CONTROLLER(PHANDLE)  CONTROLLER_DATA(5)
		interrupt-map = <0x0 0x0 0x0  0x1  &gic  0x0 0x0 0x0 14 0x1
				 0x0 0x0 0x0  0x2  &gic  0x0 0x0 0x0 15 0x1
				 0x0 0x0 0x0  0x3  &gic  0x0 0x0 0x0 16 0x1
				 0x0 0x0 0x0  0x4  &gic  0x0 0x0 0x0 17 0x1>;

		// PCI_DEVICE(3)  INT#(1)
		interrupt-map-mask = <0x0000 0x0 0x0  0x7>;

		msi-parent = <&its_pci>;
	};
```
