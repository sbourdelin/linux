## Documentation/devicetree/bindings/pci/pci.txt
```
PCI bus bridges have standardized Device Tree bindings:

PCI Bus Binding to: IEEE Std 1275-1994
http://www.devicetree.org/open-firmware/bindings/pci/pci2_1.pdf

And for the interrupt mapping part:

Open Firmware Recommended Practice: Interrupt Mapping
http://www.devicetree.org/open-firmware/practice/imap/imap0_9d.pdf

Additionally to the properties specified in the above standards a host bridge
driver implementation may support the following properties:

- linux,pci-domain:
   If present this property assigns a fixed PCI domain number to a host bridge,
   otherwise an unstable (across boots) unique number will be assigned.
   It is required to either not set this property at all or set it for all
   host bridges in the system, otherwise potentially conflicting domain numbers
   may be assigned to root buses behind different host bridges.  The domain
   number for each host bridge in the system must be unique.
- max-link-speed:
   If present this property specifies PCI gen for link capability.  Host
   drivers could add this as a strategy to avoid unnecessary operation for
   unsupported link speed, for instance, trying to do training for
   unsupported link speed, etc.  Must be '4' for gen4, '3' for gen3, '2'
   for gen2, and '1' for gen1. Any other values are invalid.

PCI devices may support the following properties:

- interrupts: Interrupt specifier for each name in interrupt-names.
- interrupt-names:
    May contain "wakeup" for PCIe WAKE# interrupt and "pci" for PCI interrupt.
    The PCI devices may optionally include an 'interrupts' property that
    represents the legacy PCI interrupt. And when we try to specify the PCIe
    WAKE# pin, a corresponding 'interrupt-names' property is required to
    distinguish them.
```

## Documentation/devicetree/bindings/pci/pcie-snpsdev.txt
```
Synopsys PCI RC IP Prototyping Kit
----------------------------------

This is the reference platform driver to be used in the Synopsys PCI RC IP
Prototyping Kits.

Required properties:
- compatible: "snps,pcie-snpsdev";
- reg:	A list of physical regions to access the device.
- interrupts: interrupt for the device.
- #address-cells: must be 3.
- #size-cells: must be 2.

Example configuration:

	pcie: pcie@0xdffff000 {
		#interrupt-cells = <1>;
		compatible = "snps,pcie-snpsdev";
		reg = <0xdffff000 0x1000>;
		interrupts = <25>, <24>;
		#address-cells = <3>;
		#size-cells = <2>;
		device_type = "pci";
		ranges = <0x00000800 0 0xd0000000 0xd0000000 0 0x00002000
			  0x81000000 0 0x00000000 0xde000000 0 0x00010000
			  0x82000000 0 0xd0400000 0xd0400000 0 0x0d000000>;
		num-lanes = <1>;
	};
```

## Documentation/devicetree/bindings/pci/sh7751-pci.txt
```
* Renesas SH7751 PCI host interfaces

Required properties:
  - compatible: "renesas,sh7751-pci" is required.
    And board specific compatible if fixup required.

  - reg: base address and length of the pcie controller registers.
  - #address-cells: set to <2>
  - #size-cells: set to <1>
  - bus-range: PCI bus numbers covered
  - device_type: set to "pci"
  - ranges: ranges for the PCI memory and I/O regions.
  - interrupt-map-mask and interrupt-map: standard PCI properties
  	to define the mapping of the PCIe interface to interrupt
	numbers.

Example:
	pci: pci-controller@fe200000 {
		compatible = "renesas,sh7751-pci", "iodata,landisk";
		device_type = "pci";
		bus-range = <0 0>;
		#address-cells = <2>;
		#size-cells = <1>;
		ranges = <0x02000000 0x00000000 0xfd000000 0xfd000000 0x00000000 0x01000000>,
		         <0x01000000 0x00000000 0xfe240000 0x00000000 0x00000000 0x00040000>;
		reg = <0xfe200000 0x0400>,
		      <0x0c000000 0x04000000>,
		      <0xff800000 0x0030>;
		#interrupt-cells = <1>;
		interrupt-map-mask = <0x1800 0 7>;
		interrupt-map = <0x0000 0 1 &cpldintc evt2irq(0x2a0) 0
		                 0x0000 0 2 &cpldintc evt2irq(0x2c0) 0
		                 0x0000 0 3 &cpldintc evt2irq(0x2e0) 0
		                 0x0000 0 4 &cpldintc evt2irq(0x300) 0

		                 0x0800 0 1 &cpldintc evt2irq(0x2c0) 0
		                 0x0800 0 2 &cpldintc evt2irq(0x2e0) 0
		                 0x0800 0 3 &cpldintc evt2irq(0x300) 0
		                 0x0800 0 4 &cpldintc evt2irq(0x2a0) 0

		                 0x1000 0 1 &cpldintc evt2irq(0x2e0) 0
		                 0x1000 0 2 &cpldintc evt2irq(0x300) 0
		                 0x1000 0 3 &cpldintc evt2irq(0x2a0) 0
		                 0x1000 0 4 &cpldintc evt2irq(0x2c0) 0

		                 0x1800 0 1 &cpldintc evt2irq(0x300) 0
		                 0x1800 0 2 &cpldintc evt2irq(0x2a0) 0
		                 0x1800 0 3 &cpldintc evt2irq(0x2c0) 0
		                 0x1800 0 4 &cpldintc evt2irq(0x2e0) 0>;
	};
};
```

## Documentation/devicetree/bindings/pci/tango-pcie.txt
```
Sigma Designs Tango PCIe controller

Required properties:

- compatible: "sigma,smp8759-pcie"
- reg: address/size of PCI configuration space, address/size of register area
- device_type: "pci"
- #size-cells: <2>
- #address-cells: <3>
- #interrupt-cells: <1>
- ranges: translation from system to bus addresses
- interrupts: spec for misc interrupts, spec for MSI
- msi-controller

http://elinux.org/Device_Tree_Usage#PCI_Address_Translation
http://elinux.org/Device_Tree_Usage#Advanced_Interrupt_Mapping

Example:

	pcie@2e000 {
		compatible = "sigma,smp8759-pcie";
		reg = <0x50000000 SZ_4M>, <0x2e000 0x100>;
		device_type = "pci";
		#size-cells = <2>;
		#address-cells = <3>;
		#interrupt-cells = <1>;
		ranges = <0x02000000 0x0 0x00400000  0x50400000  0x0 SZ_60M>;
		msi-controller;
		interrupts =
			<54 IRQ_TYPE_LEVEL_HIGH>, /* misc interrupts */
			<55 IRQ_TYPE_LEVEL_HIGH>; /* MSI */
	};
```

## Documentation/devicetree/bindings/peci/peci-aspeed.txt
```
Device tree configuration for PECI buses on the AST24XX and AST25XX SoCs.

Required properties:
- compatible
	"aspeed,ast2400-peci" or "aspeed,ast2500-peci"
	- aspeed,ast2400-peci: Aspeed AST2400 family PECI controller
	- aspeed,ast2500-peci: Aspeed AST2500 family PECI controller

- reg
	Should contain PECI registers location and length.

- #address-cells
	Should be <1>.

- #size-cells
	Should be <0>.

- interrupts
	Should contain PECI interrupt.

- clocks
	Should contain clock source for PECI hardware module. Should reference
	clkin clock.

- clock_frequency
	Should contain the operation frequency of PECI hardware module.
	187500 ~ 24000000

Optional properties:
- msg-timing-nego
	Message timing negotiation period. This value will determine the period
	of message timing negotiation to be issued by PECI controller. The unit
	of the programmed value is four times of PECI clock period.
	0 ~ 255 (default: 1)

- addr-timing-nego
	Address timing negotiation period. This value will determine the period
	of address timing negotiation to be issued by PECI controller. The unit
	of the programmed value is four times of PECI clock period.
	0 ~ 255 (default: 1)

- rd-sampling-point
	Read sampling point selection. The whole period of a bit time will be
	divided into 16 time frames. This value will determine which time frame
	this controller will sample PECI signal for data read back. Usually in
	the middle of a bit time is the best.
	0 ~ 15 (default: 8)

- cmd_timeout_ms
	Command timeout in units of ms.
	1 ~ 60000 (default: 1000)

Example:
	peci: peci@1e78b000 {
		compatible = "simple-bus";
		#address-cells = <1>;
		#size-cells = <1>;
		ranges = <0x0 0x1e78b000 0x60>;

		peci0: peci-bus@0 {
			compatible = "aspeed,ast2500-peci";
			reg = <0x0 0x60>;
			#address-cells = <1>;
			#size-cells = <0>;
			interrupts = <15>;
			clocks = <&clk_clkin>;
			clock-frequency = <24000000>;
			msg-timing-nego = <1>;
			addr-timing-nego = <1>;
			rd-sampling-point = <8>;
			cmd-timeout-ms = <1000>;
		};
	};
```

## Documentation/devicetree/bindings/peci/peci.txt
```
Generic device tree configuration for PECI buses
================================================

Required properties:
- compatible     : Should be "simple-bus".
- #address-cells : Should be present if the device has sub-nodes.
- #size-cells    : Should be present if the device has sub-nodes.
- ranges         : Should contain PECI controller registers ranges.

Example:
	peci: peci@10000000 {
		compatible = "simple-bus";
		#address-cells = <1>;
		#size-cells = <1>;
		ranges = <0x0 0x10000000 0x1000>;
	};

Generic device tree configuration for PECI adapters
===================================================

Required properties:
- #address-cells : Should be <1>. Read more about client addresses below.
- #size-cells    : Should be <0>. Read more about client addresses below.

The cells properties above define that an address of CPU clients of a PECI bus
are described by a single value.

Example:
	peci0: peci-bus@0 {
		compatible = "soc,soc-peci";
		reg = <0x0 0x1000>;
		#address-cells = <1>;
		#size-cells = <0>;
	};

Generic device tree configuration for PECI clients
==================================================

Required properties:
- compatible : Should contain name of PECI client.
- reg        : Should contain address of a client CPU. Address range of CPU
	       clients is starting from 0x30 based on PECI specification.

Example:
	peci-bus@0 {
		#address-cells = <1>;
		#size-cells = <0>;
		< more properties >

		function@30 {
			compatible = "device,function";
			reg = <0x30>;
		};

		function@31 {
			compatible = "device,function";
			reg = <0x31>;
		};
	};
```

## Documentation/devicetree/bindings/phy/amlogic,meson-pcie-phy.txt
```
* Amlogic Meson AXG PCIE PHY binding

Required properties:
- compatible:	Should be
	- "amlogic,axg-pcie-phy"
- #phys-cells:	must be 0 (see phy-bindings.txt in this directory)
- reg:		The base address and length of the registers
- resets:	phandle to the reset lines
- reset-names:	must contain "phy" and "peripheral"
	- "phy"	PHY reset
Optional properties:
- phy-supply:	see phy-bindings.txt in this directory

Example:
	pcie_phy: pcie-phy@ff644000 {
		#phy-cells = <0>;
		compatible = "amlogic,axg-pcie-phy";
		reg = <0x0 0xff644000 0x0 0x2000>;
		resets = <&reset RESET_PCIE_PHY>;
		reset-names = "phy";
	};
```

## Documentation/devicetree/bindings/phy/bcm-ns-usb2-phy.txt
```
Driver for Broadcom Northstar USB 2.0 PHY

Required properties:
- compatible: brcm,ns-usb2-phy
- syscon-cru: phandle to the CRU (Central Resource Unit) syscon
- clocks: USB PHY reference clock
- clock-names: "phy-ref-clk", the only needed & supported clock right now

Deprecated:

PHY block should not claim the whole DMU so such a binding has been deprecated.
It only requires to access few CRU (a DMU subblock) registers and that should be
handled with a syscon since CRU is a MFD (Multi-Function Device).

- reg: iomem address range of DMU (Device Management Unit)
- reg-names: "dmu", the only needed & supported reg right now

To initialize USB 2.0 PHY driver needs to setup PLL correctly. To do this it
requires passing phandle to the USB PHY reference clock.

Example:
	dmu@1800c000 {
		compatible = "simple-bus";
		ranges = <0 0x1800c000 0x1000>;
		#address-cells = <1>;
		#size-cells = <1>;

		cru: cru@100 {
			compatible = "syscon", "simple-mfd";
			reg = <0x100 0x1a4>;
		};
	};

	usb2-phy {
		compatible = "brcm,ns-usb2-phy";
		syscon-cru = <&cru>;
		#phy-cells = <0>;
		clocks = <&genpll BCM_NSP_GENPLL_USB_PHY_REF_CLK>;
		clock-names = "phy-ref-clk";
	};
```

## Documentation/devicetree/bindings/phy/brcm,brcmstb-usb-phy.txt
```
Broadcom STB USB PHY

Required properties:
 - compatible: brcm,brcmstb-usb-phy
 - reg: two offset and length pairs. The second pair specifies optional
        registers used by some of the SoCs that support USB 3.x
 - #phy-cells: Shall be 1 as it expects one argument for setting
	       the type of the PHY. Possible values are 0 (1.1 and 2.0),
	       1 (3.x)

Optional Properties:
- clocks : clock phandles.
- clock-names: String, clock name.
- brcm,ipp: Boolean, Invert Port Power.
  Possible values are: 0 (Don't invert), 1 (Invert)
- brcm,ioc: Boolean, Invert Over Current detection.
  Possible values are: 0 (Don't invert), 1 (Invert)
- brcm,has-xhci: Boolean indicating an optional 3.x only XHCI controller.
- brcm,has-xhci-only: Boolean indicating an XHCI controller that supports
  1.1, 2.0 and 3.0 devices
- brcm,device: String, PHY Device mode.
  Possible values are: off (Host), on (Device), dual (DRD)
  or typec-pd (Type-C PD control)

Example:

usbphy_0: usb-phy@f0470200 {
	reg = <0xf0470200 0xb8>,
		<0xf0471940 0x6c0>;
	compatible = "brcm,brcmstb-usb-phy";
	#phy-cells = <1>;
	brcm,ioc = <1>;
	brcm,ipp = <1>;
	brcm,has-xhci;
	clocks = <&usb20>, <&usb30>;
	clock-names = "sw_usb", "sw_usb3";
};
```

## Documentation/devicetree/bindings/phy/brcm,ns2-usb3-phy.txt
```
Broadcom USB3 dual port phy for Northstar2 SoC
This is a child bus node of "brcm,mdio-mux-iproc" node.

Required mdio bus properties:
- reg: MDIO Bus number for the MDIO interface
- #address-cells: must be 1
- #size-cells: must be 0

Required PHY properties:
- compatible: should be "brcm,ns2-usb3-phy"
- reg: MDIO Phy ID for the MDIO interface
- #phy-cells: must be 0
- #address-cells: must be 1
- #size-cells: must be 0

Sub-nodes:
  Each port's PHY should be represented as a sub-node.

Sub-nodes required properties:
 - reg: the PHY number
 - phy-cells: from the generic PHY bindings, must be 0

Example:

mdio@1 {
	reg = <0x1>;
	#address-cells = <1>;
	#size-cells = <0>;

	usb3_phy: usb3_phy@0 {
		compatible = "brcm,ns2-usb3-phy";
		reg = <0x0>;
		#address-cells = <1>;
		#size-cells = <0>;

		usb3_phy0: usb3_phy@0 {
			reg = <0>;
			#phy-cells = <0>;
			status = "disabled";
		};

		usb3_phy1: usb_phy@1 {
			reg = <1>;
			#phy-cells = <0>;
			status = "disabled";
		};
	};
};
```
