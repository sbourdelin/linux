## Documentation/devicetree/bindings/pci/designware-pcie-ecam.txt
```
* Synopsys Designware PCIe root complex in ECAM mode

In some cases, firmware may already have configured the Synopsys Designware
PCIe controller in RC mode with static ATU window mappings that cover all
config, MMIO and I/O spaces in a [mostly] ECAM compatible fashion.
In this case, there is no need for the OS to perform any low level setup
of clocks or device registers, nor is there any reason for the driver to
reconfigure ATU windows for config and/or IO space accesses at runtime.

Such hardware configurations should be described as "pci-host-ecam-generic"
if they are truly ECAM compatible. Configurations that require no low-level
setup by the OS nor any ATU window reconfiguration at runtime, but do
require special handling for type 0 config TLPs may instead be described as
"snps,dw-pcie-ecam".

Required properties:
- compatible: should contain "snps,dw-pcie-ecam".

Please refer to the binding document of "pci-host-ecam-generic" in the
file host-generic-pci.txt for a description of the remaining required
and optional properties.


* MSI support for Synopsys Designware PCIe root complex in ECAM mode

Platforms that elect to perform all configuration of the RC in firmware
and use the "pci-host-ecam-generic" or "snps,dw-pcie-ecam" binding to
describe it to the OS may include a separate description of the embedded
MSI controller in case no MSI support is available in the core interrupt
controller.

Required properties:
- compatible:      should contain "snps,dw-pcie-msi".
- reg:             a single region describing the device registers.
- interrupts:      interrupt specifier for the interrupt that is asserted when
                   an MSI is received by the RC.
- msi-controller:  empty property identifying this device as an MSI controller.

Example for an implementation that routes all legacy INTx interrupts via SPI
#188 and all MSI interrupts via SPI #190:

  pcie@20000000 {
    compatible = "snps,dw-pcie-ecam";
    device_type = "pci";
    msi-parent = <&msi0>;
    interrupt-map-mask = <0x0 0x0 0x0 0x0>;
    interrupt-map = <0x0 0x0 0x0 0x0 &gic GIC_SPI 188 IRQ_TYPE_LEVEL_HIGH>;
    ...
  };

  msi0: msi@10000000 {
    compatible = "snps,dw-pcie-msi";
    reg = <0x0 0x10000000 0x0 0x10000>;
    interrupts = <GIC_SPI 190 IRQ_TYPE_LEVEL_HIGH>;
    msi-controller;
  };
```

## Documentation/devicetree/bindings/pci/exynos5433-pcie.txt
```
* Samsung Exynos5433 PCIe interface

This PCIe host controller is based on the Synopsis Designware PCIe IP
and thus inherits all the common properties defined in designware-pcie.txt.

Required properties:
- compatible: "samsung,exynos5433-pcie"
- reg: base addresses and lengths of the pcie controller,
	the phy controller, additional register for the phy controller.
- reg-names: Must be "elbi", "phy" and "dbi" for each regs
- interrupt-names: Must be "intr" for legacy interrupt pin.

Other common properites refer to
	Documentation/devicetree/binding/pci/designware-pcie.txt

Example:

	pcie: pcie@15700000 {
		compatible ="samsung,exynos5433-pcie", "snps,dw-pcie";
		#address-cells = <3>;
		#size-cells = <2>;
		device_type = "pci";
		interrupts = <GIC_SPI 245 IRQ_TYPE_LEVEL_HIGH>;
		interrupt-names = "intr";
		clocks = <&cmu_fsys CLK_PCIE>, <&cmu_fsys CLK_PCLK_PCIE_PHY>;
		clock-names = "pcie", "pcie_bus";
		num-lanes = <1>;
		pinctrl-names = "default";
		pinctrl-0 = <&pcie_bus>;
		reg = <0x156b0000 0x1000>, <0x15680000 0x1000>,
		    <0x15700000 0x1000>, <0x0c000000 0x1000>;
		reg-names = "elbi", "phy", "dbi", "config";
		ranges = <0x81000000 0 0	  0x0c001000 0 0x00010000
			  0x82000000 0 0x0c011000 0x0c011000 0 0x3feefff>;
		status = "disabled";
	};
```

## Documentation/devicetree/bindings/pci/hisilicon-pcie.txt
```
HiSilicon Hip05 and Hip06 PCIe host bridge DT description

HiSilicon PCIe host controller is based on Designware PCI core.
It shares common functions with PCIe Designware core driver and inherits
common properties defined in
Documentation/devicetree/bindings/pci/designware-pci.txt.

Additional properties are described here:

Required properties
- compatible: Should contain "hisilicon,hip05-pcie" or "hisilicon,hip06-pcie".
- reg: Should contain rc_dbi, config registers location and length.
- reg-names: Must include the following entries:
  "rc_dbi": controller configuration registers;
  "config": PCIe configuration space registers.
- msi-parent: Should be its_pcie which is an ITS receiving MSI interrupts.
- port-id: Should be 0, 1, 2 or 3.

Optional properties:
- status: Either "ok" or "disabled".
- dma-coherent: Present if DMA operations are coherent.

Hip05 Example (note that Hip06 is the same except compatible):
	pcie@0xb0080000 {
		compatible = "hisilicon,hip05-pcie", "snps,dw-pcie";
		reg = <0 0xb0080000 0 0x10000>, <0x220 0x00000000 0 0x2000>;
		reg-names = "rc_dbi", "config";
		bus-range = <0  15>;
		msi-parent = <&its_pcie>;
		#address-cells = <3>;
		#size-cells = <2>;
		device_type = "pci";
		dma-coherent;
		ranges = <0x82000000 0 0x00000000 0x220 0x00000000 0 0x10000000>;
		num-lanes = <8>;
		port-id = <1>;
		#interrupt-cells = <1>;
		interrupt-map-mask = <0xf800 0 0 7>;
		interrupt-map = <0x0 0 0 1 &mbigen_pcie 1 10
				 0x0 0 0 2 &mbigen_pcie 2 11
				 0x0 0 0 3 &mbigen_pcie 3 12
				 0x0 0 0 4 &mbigen_pcie 4 13>;
		status = "ok";
	};

HiSilicon Hip06/Hip07 PCIe host bridge DT (almost-ECAM) description.
The properties and their meanings are identical to those described in
host-generic-pci.txt except as listed below.

Properties of the host controller node that differ from
host-generic-pci.txt:

- compatible     : Must be "hisilicon,pcie-almost-ecam"

- reg            : Two entries: First the ECAM configuration space for any
		   other bus underneath the root bus. Second, the base
		   and size of the HiSilicon host bridge registers include
		   the RC's own config space.

Example:
	pcie0: pcie@a0090000 {
		compatible = "hisilicon,pcie-almost-ecam";
		reg = <0 0xb0000000 0 0x2000000>,  /*  ECAM configuration space */
		      <0 0xa0090000 0 0x10000>; /* host bridge registers */
		bus-range = <0  31>;
		msi-map = <0x0000 &its_dsa 0x0000 0x2000>;
		msi-map-mask = <0xffff>;
		#address-cells = <3>;
		#size-cells = <2>;
		device_type = "pci";
		dma-coherent;
		ranges = <0x02000000 0 0xb2000000 0x0 0xb2000000 0 0x5ff0000
			  0x01000000 0 0 0 0xb7ff0000 0 0x10000>;
		#interrupt-cells = <1>;
		interrupt-map-mask = <0xf800 0 0 7>;
		interrupt-map = <0x0 0 0 1 &mbigen_pcie0 650 4
				 0x0 0 0 2 &mbigen_pcie0 650 4
				 0x0 0 0 3 &mbigen_pcie0 650 4
				 0x0 0 0 4 &mbigen_pcie0 650 4>;
		status = "ok";
	};



HiSilicon Kirin SoC PCIe host DT description

Kirin PCIe host controller is also based on Designware PCI core.
It shares common functions with PCIe Designware core driver and inherits
common properties defined in
Documentation/devicetree/bindings/pci/designware-pci.txt.

Additional properties are described here:

Required properties
- compatible: Should contain "hisilicon,kirin-pcie".
- reg: Should contain rc_dbi, apb, phy, config registers location and length.
- reg-names: Must include the following entries:
  "dbi": controller configuration registers;
  "apb": apb Ctrl register;
  "phy": apb PHY register;
  "config": PCIe configuration space registers.
- reset-gpio: perst assert/deassert gpio

Optional properties:
- status: Either "ok" or "disabled".

Kirin960 Example:
        kirin_pcie@f4000000 {
                        compatible = "hisilicon,kirin-pcie";
                        reg =  <0x0 0xf4000000 0x0 0x1000>, <0x0 0xff3fe000 0x0 0x1000>,
                                 <0x0 0xf3f20000 0x0 0x40000>, <0x0 0xF5000000 0 0x2000>;
                        reg-names = "dbi","apb","phy", "config";
                        bus-range = <0x0  0x1>;
                        #address-cells = <3>;
                        #size-cells = <2>;
                        device_type = "pci";
                        ranges = <0x02000000 0x0 0x00000000 0x0 0xf6000000 0x0 0x2000000>;
                        num-lanes = <1>;
                        #interrupt-cells = <1>;
                        interrupt-map-mask = <0xf800 0 0 7>;
			interrupt-map = <0x0 0 0 2 &gic 0 0 0  283 4>,
                                        <0x0 0 0 3 &gic 0 0 0  284 4>,
                                        <0x0 0 0 4 &gic 0 0 0  285 4>;
                        clocks = <&crg_ctrl HI3660_PCIEPHY_REF>,
                                <&crg_ctrl HI3660_CLK_GATE_PCIEAUX>,
                                <&crg_ctrl HI3660_PCLK_GATE_PCIE_PHY>,
                                <&crg_ctrl HI3660_PCLK_GATE_PCIE_SYS>,
                                <&crg_ctrl HI3660_ACLK_GATE_PCIE>;
                        clock-names = "pcie_phy_ref", "pcie_aux",
                                "pcie_apb_phy", "pcie_apb_sys", "pcie_aclk";
                        reset-gpio = <&gpio11 1 0 >;
                        status = "ok";
        };
```

## Documentation/devicetree/bindings/pci/mediatek,mt7623-pcie.txt
```
Mediatek Gen2 PCIe controller which is available on MT7623 series SoCs

PCIe subsys supports single root complex (RC) with 3 Root Ports. Each root
ports supports a Gen2 1-lane Link and has PIPE interface to PHY.

Required properties:
- compatible: Should contain "mediatek,mt7623-pcie".
- device_type: Must be "pci"
- reg: Base addresses and lengths of the PCIe controller.
- #address-cells: Address representation for root ports (must be 3)
- #size-cells: Size representation for root ports (must be 2)
- #interrupt-cells: Size representation for interrupts (must be 1)
- interrupts: Three interrupt outputs of the controller. Must contain an
  entry for each entry in the interrupt-names property.
- interrupt-names: Must include the following names
  - "pcie-int0"
  - "pcie-int1"
  - "pcie-int2"
- interrupt-map-mask and interrupt-map: Standard PCI IRQ mapping properties
  Please refer to the standard PCI bus binding document for a more detailed
  explanation.
- clocks: Must contain an entry for each entry in clock-names.
  See ../clocks/clock-bindings.txt for details.
- clock-names: Must include the following entries:
  - free_ck :for reference clock of PCIe subsys
  - sys_ck0 :for clock of Port0
  - sys_ck1 :for clock of Port1
  - sys_ck2 :for clock of Port2
- resets: Must contain an entry for each entry in reset-names.
  See ../reset/reset.txt for details.
- reset-names: Must include the following entries:
  - pcie-rst0 :port0 reset
  - pcie-rst1 :port1 reset
  - pcie-rst2 :port2 reset
- phys: list of PHY specifiers (used by generic PHY framework).
- phy-names : must be "pcie-phy0", "pcie-phy1", "pcie-phyN".. based on the
  number of PHYs as specified in *phys* property.
- power-domains: A phandle and power domain specifier pair to the power domain
  which is responsible for collapsing and restoring power to the peripheral.
- bus-range: Range of bus numbers associated with this controller.
- ranges:
  - The first three entries are expected to translate the addresses for the root
    port registers, which are referenced by the assigned-addresses property of
    the root port nodes (see below).
  - The remaining entries setup the mapping for the standard I/O and memory
	regions.
  Please refer to the standard PCI bus binding document for a more detailed
  explanation.

In addition, the device tree node must have sub-nodes describing each
PCIe port interface, having the following mandatory properties:

Required properties:
- device_type: Must be "pci"
- assigned-addresses: Address and size of the port configuration registers
- reg: Only the first four bytes are used to refer to the correct bus number
  and device number.
- #address-cells: Must be 3
- #size-cells: Must be 2
- #interrupt-cells: Must be 1
- interrupt-map-mask and interrupt-map: Standard PCI IRQ mapping properties
  Please refer to the standard PCI bus binding document for a more detailed
  explanation.
- ranges: Sub-ranges distributed from the PCIe controller node. An empty
  property is sufficient.
- num-lanes: Number of lanes to use for this port.

Examples:

	hifsys: syscon@1a000000 {
		compatible = "mediatek,mt7623-hifsys", "syscon";
		reg = <0 0x1a000000 0 0x1000>;
		#clock-cells = <1>;
		#reset-cells = <1>;
	};

	pcie: pcie-controller@1a140000 {
		compatible = "mediatek,mt7623-pcie";
		device_type = "pci";
		reg = <0 0x1a140000 0 0x1000>; /* PCIe shared registers */
		#address-cells = <3>;
		#size-cells = <2>;
		#interrupt-cells = <1>;
		interrupts = <GIC_SPI 193 IRQ_TYPE_LEVEL_LOW>,
			     <GIC_SPI 194 IRQ_TYPE_LEVEL_LOW>,
			     <GIC_SPI 195 IRQ_TYPE_LEVEL_LOW>;
		interrupt-names = "pcie-int0", "pcie-int1", "pcie-int2";
		interrupt-map-mask = <0xf800 0 0 0>;
		interrupt-map = <0x0000 0 0 0 &gic GIC_SPI 193 IRQ_TYPE_NONE>,
				 <0x0800 0 0 0 &gic GIC_SPI 194 IRQ_TYPE_NONE>,
			     <0x1000 0 0 0 &gic GIC_SPI 195 IRQ_TYPE_NONE>;
		clocks = <&topckgen CLK_TOP_ETHIF_SEL>,
			     <&hifsys CLK_HIFSYS_PCIE0>,
				 <&hifsys CLK_HIFSYS_PCIE1>,
				 <&hifsys CLK_HIFSYS_PCIE2>;
		clock-names = "free_ck", "sys_ck0", "sys_ck1", "sys_ck2";
		resets = <&hifsys MT2701_HIFSYS_PCIE0_RST>,
			     <&hifsys MT2701_HIFSYS_PCIE1_RST>,
			     <&hifsys MT2701_HIFSYS_PCIE2_RST>;
		reset-names = "pcie-rst0", "pcie-rst1", "pcie-rst2";
		phys = <&pcie0_phy>, <&pcie1_phy>, <&pcie2_phy>;
		phy-names = "pcie-phy0", "pcie-phy1", "pcie-phy2";
		power-domains = <&scpsys MT2701_POWER_DOMAIN_HIF>;
		bus-range = <0x00 0xff>;
		ranges = <0x82000000 0 0x1a142000 0 0x1a142000 0 0x1000 /* Port0 registers */
			  0x82000000 0 0x1a143000 0 0x1a143000 0 0x1000 /* Port1 registers */
			  0x82000000 0 0x1a144000 0 0x1a144000 0 0x1000 /* Port2 registers */
			  0x81000000 0 0x1a160000 0 0x1a160000 0 0x00010000 /* I/O space */
			  0x83000000 0 0x60000000 0 0x60000000 0 0x10000000>;	/* memory space */

		pcie@1,0 {
			device_type = "pci";
			assigned-addresses = <0x82000000 0 0x1a142000 0 0x1000>;
			reg = <0x0000 0 0 0 0>;
			#address-cells = <3>;
			#size-cells = <2>;
			#interrupt-cells = <1>;
			interrupt-map-mask = <0 0 0 0>;
			interrupt-map = <0 0 0 0 &gic GIC_SPI 193 IRQ_TYPE_NONE>;
			ranges;
			num-lanes = <1>;
		};

		pcie@2,0 {
			device_type = "pci";
			assigned-addresses = <0x82000800 0 0x1a143000 0 0x1000>;
			reg = <0x0800 0 0 0 0>;
			#address-cells = <3>;
			#size-cells = <2>;
			#interrupt-cells = <1>;
			interrupt-map-mask = <0 0 0 0>;
			interrupt-map = <0 0 0 0 &gic GIC_SPI 194 IRQ_TYPE_NONE>;
			ranges;
			num-lanes = <1>;
		};

		pcie@3,0 {
			device_type = "pci";
			assigned-addresses = <0x82001000 0 0x1a144000 0 0x1000>;
			reg = <0x1000 0 0 0 0>;
			#address-cells = <3>;
			#size-cells = <2>;
			#interrupt-cells = <1>;
			interrupt-map-mask = <0 0 0 0>;
			interrupt-map = <0 0 0 0 &gic GIC_SPI 195 IRQ_TYPE_NONE>;
			ranges;
			num-lanes = <1>;
		};
	};
```
