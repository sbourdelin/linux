## Documentation/devicetree/bindings/mtd/stm32-fmc2-nand.txt
```
STMicroelectronics Flexible Memory Controller 2 (FMC2)
NAND Interface

Required properties:
- compatible: "st,stm32mp15-fmc2"
- reg: the first contains the register location and length
       the second contains the data common space used for cs0 and length
       the third contains the cmd attribute space used for cs0 and length
       the fourth contains the addr attribute space used for cs0 and length
       the fifth contains the data common space used for cs1 and length
       the sixth contains the cmd attribute space used for cs1 and length
       the seventh contains the addr attribute space used for cs1 and length
- interrupts: The interrupt number
- pinctrl-0: Standard Pinctrl phandle (see: pinctrl/pinctrl-bindings.txt)
- clocks: Use common clock framework

Optional properties:
- resets: Reference to a reset controller asserting the FMC controller
- dmas: DMA specifiers (see: dma/stm32-mdma.txt)
- dma-names: Must be "tx", "rx" and "ecc"

Optional children nodes:
Children nodes represent the available nand chips.

Optional properties:
- nand-on-flash-bbt: see nand.txt
- nand-ecc-strength: see nand.txt
- nand-ecc-step-size: see nand.txt
- st,fmc2_timings: array of 8 bytes for NAND timings. The meanings of
  these bytes are:
  byte 0 TCLR      : CLE to RE delay in number of AHB clock cycles, only 4 bits
                     are valid. Zero means one clock cycle, 15 means 16 clock
                     cycles.
  byte 1 TAR       : ALE to RE delay, 4 bits are valid. Same format as TCLR.
  byte 2 THIZ      : number of HCLK clock cycles during which the data bus is
                     kept in Hi-Z (tristate) after the start of a write access.
                     Only valid for write transactions. Zero means 1 cycle,
                     255 means 256 cycles.
  byte 3 TWAIT     : number of HCLK clock cycles to assert the command to the
                     NAND flash in response to SMWAITn. Zero means 1 cycle,
                     255 means 256 cycles.
  byte 4 THOLD_MEM : common memory space timing
                     number of HCLK clock cycles to hold the address (and data
                     when writing) after the command deassertion. Zero means
                     1 cycle, 255 means 256 cycles.
  byte 5 TSET_MEM  : common memory space timing
                     number of HCLK clock cycles to assert the address before
                     the command is asserted. Zero means 1 cycle, 255 means 256
                     cycles.
  byte 6 THOLD_ATT : attribute memory space timing
                     number of HCLK clock cycles to hold the address (and data
                     when writing) after the command deassertion. Zero means
                     1 cycle, 255 means 256 cycles.
  byte 7 TSET_ATT  : attribute memory space timing
                     number of HCLK clock cycles to assert the address before
                     the command is asserted. Zero means 1 cycle, 255 means 256
                     cycles.

The following ECC strength and step size are currently supported:
 - nand-ecc-strength = <1>, nand-ecc-step-size = <512> (HAMMING)
 - nand-ecc-strength = <4>, nand-ecc-step-size = <512> (BCH4)
 - nand-ecc-strength = <8>, nand-ecc-step-size = <512> (BCH8) (default)

Example:

	fmc2_nand: fmc2_nand@58002000 {
		compatible = "st,stm32mp15-fmc2";
		reg = <0x58002000 0x1000>,
		      <0x80000000 0x1000>,
		      <0x88010000 0x1000>,
		      <0x88020000 0x1000>,
		      <0x81000000 0x1000>,
		      <0x89010000 0x1000>,
		      <0x89020000 0x1000>;
		interrupts = <GIC_SPI 48 IRQ_TYPE_LEVEL_HIGH>;
		clocks = <&rcc FMC_K>;
		resets = <&rcc FMC_R>;
		pinctrl-names = "default";
		pinctrl-0 = <&fmc2_pins_a>;
		#address-cells = <1>;
		#size-cells = <0>;

		nand@0 {
			reg = <0>;
			nand-on-flash-bbt;
			st,fmc2_timings = /bits/ 8 <2 2 1 7 1 0 104 25>;
			#address-cells = <1>;
			#size-cells = <1>;
		};
	};
```

## Documentation/devicetree/bindings/mtd/stm32-quadspi.txt
```
* STMicroelectronics Quad Serial Peripheral Interface(QuadSPI)

Required properties:
- compatible: should be "st,stm32f469-qspi"
- reg: contains the register location and length.
  (optional) the memory mapping address and length
- reg-names: list of the names corresponding to the previous register
  Should contain "qspi" to register location
  (optional) "qspi_mm" if read in memory map mode (improve read throughput)
- interrupts: should contain the interrupt for the device
- clocks: the phandle of the clock needed by the QSPI controller
- A pinctrl must be defined to set pins in mode of operation for QSPI transfer

Optional properties:
- resets: must contain the phandle to the reset controller.

A spi flash must be a child of the nor_flash node and could have some
properties. Also see jedec,spi-nor.txt.

Required properties:
- reg: chip-Select number (QSPI controller may connect 2 nor flashes)
- spi-max-frequency: max frequency of spi bus

Optional property:
- spi-rx-bus-width: the bus width (number of data wires)

Example:

qspi: qspi@a0001000 {
	compatible = "st,stm32f469-qspi";
	reg = <0xa0001000 0x1000>, <0x90000000 0x10000000>;
	reg-names = "qspi", "qspi_mm";
	interrupts = <91>;
	resets = <&rcc STM32F4_AHB3_RESET(QSPI)>;
	clocks = <&rcc 0 STM32F4_AHB3_CLOCK(QSPI)>;
	pinctrl-names = "default";
	pinctrl-0 = <&pinctrl_qspi0>;

	flash@0 {
		reg = <0>;
		spi-rx-bus-width = <4>;
		spi-max-frequency = <108000000>;
		...
	};
};
```

## Documentation/devicetree/bindings/mux/mmio-mux.txt
```
MMIO bitfield-based multiplexer controller bindings

Define a syscon bitfield to be used to control a multiplexer. The parent
device tree node must be a syscon node to provide register access.

Required properties:
- compatible : "gpio-mux"
- reg : register base of the register containing the control bitfield
- bit-mask : bitmask of the control bitfield in the control register
- bit-shift : bit offset of the control bitfield in the control register
- #mux-control-cells : <0>
* Standard mux-controller bindings as decribed in mux-controller.txt

Optional properties:
- idle-state : if present, the state the mux will have when idle. The
	       special state MUX_IDLE_AS_IS is the default.

The multiplexer state is defined as the value of the bitfield described
by the reg, bit-mask, and bit-shift properties, accessed through the parent
syscon.

Example:

	syscon {
		compatible = "syscon";

		mux: mux-controller@3 {
			compatible = "mmio-mux";
			reg = <0x3>;
			bit-mask = <0x1>;
			bit-shift = <5>;
			#mux-control-cells = <0>;
		};
	};

	video-mux {
		compatible = "video-mux";
		mux-controls = <&mux>;

		ports {
			/* input 0 */
			port@0 {
				reg = <0>;
			};

			/* input 1 */
			port@1 {
				reg = <1>;
			};

			/* output */
			port@2 {
				reg = <2>;
			};
		};
	};
```

## Documentation/devicetree/bindings/mux/mux-adg792a.txt
```
Bindings for Analog Devices ADG792A/G Triple 4:1 Multiplexers

Required properties:
- compatible : "adi,adg792a" or "adi,adg792g"
- #mux-control-cells : <0> if parallel, or <1> if not.
* Standard mux-controller bindings as decribed in mux-controller.txt

Optional properties for ADG792G:
- gpio-controller : if present, #gpio-cells below is required.
- #gpio-cells : should be <2>
			  - First cell is the GPO line number, i.e. 0 or 1
			  - Second cell is used to specify active high (0)
			    or active low (1)

Optional properties:
- adi,parallel : if present, the three muxes are bound together with a single
  mux controller, controlling all three muxes in parallel.
- adi,idle-state : if present, array of 2-tuples with mux controller number
  and state that mux controllers will have when idle. States 0 through 3
  correspond to signals A through D in the datasheet.
- adi,idle-high-impedance : if present, array of mux controller numbers that
  should be in the disconnected high-impedance state when idle.

Mux controller states 0 through 3 correspond to signals A through D in the
datasheet. If a mux controller is mentioned in neither adi,idle-state nor
adi,idle-high-impedance it is left in its previously selected state when idle.

Example:

	/*
	 * Three independent mux controllers (of which one is used).
	 * Mux 0 is disconnected when idle, mux 1 idles with signal C
	 * and mux 2 idles with signal A.
	 */
	&i2c0 {
		mux: adg792a@50 {
			compatible = "adi,adg792a";
			reg = <0x50>;
			#mux-control-cells = <1>;

			adi,idle-high-impedance = <0>;
			adi,idle-state = <1 2>, <2 0>;
		};
	};

	adc-mux {
		compatible = "io-channel-mux";
		io-channels = <&adc 0>;
		io-channel-names = "parent";

		mux-controls = <&mux 1>;

		channels = "sync-1", "", "out";
	};


	/*
	 * Three parallel muxes with one mux controller, useful e.g. if
	 * the adc is differential, thus needing two signals to be muxed
	 * simultaneously for correct operation.
	 */
	&i2c0 {
		pmux: adg792a@50 {
			compatible = "adi,adg792a";
			reg = <0x50>;
			#mux-control-cells = <0>;
			adi,parallel;
		};
	};

	diff-adc-mux {
		compatible = "io-channel-mux";
		io-channels = <&adc 0>;
		io-channel-names = "parent";

		mux-controls = <&pmux>;

		channels = "sync-1", "", "out";
	};
```

## Documentation/devicetree/bindings/mux/mux-controller.txt
```
Common multiplexer controller bindings
======================================

A multiplexer (or mux) controller will have one, or several, consumer devices
that uses the mux controller. Thus, a mux controller can possibly control
several parallel multiplexers. Presumably there will be at least one
multiplexer needed by each consumer, but a single mux controller can of course
control several multiplexers for a single consumer.

A mux controller provides a number of states to its consumers, and the state
space is a simple zero-based enumeration. I.e. 0-1 for a 2-way multiplexer,
0-7 for an 8-way multiplexer, etc.


Consumers
---------

Mux controller consumers should specify a list of mux controllers that they
want to use with a property containing a 'mux-ctrl-list':

	mux-ctrl-list ::= <single-mux-ctrl> [mux-ctrl-list]
	single-mux-ctrl ::= <mux-ctrl-phandle> [mux-ctrl-specifier]
	mux-ctrl-phandle : phandle to mux controller node
	mux-ctrl-specifier : array of #mux-control-cells specifying the
			     given mux controller (controller specific)

Mux controller properties should be named "mux-controls". The exact meaning of
each mux controller property must be documented in the device tree binding for
each consumer. An optional property "mux-control-names" may contain a list of
strings to label each of the mux controllers listed in the "mux-controls"
property.

Drivers for devices that use more than a single mux controller can use the
"mux-control-names" property to map the name of the requested mux controller
to an index into the list given by the "mux-controls" property.

mux-ctrl-specifier typically encodes the chip-relative mux controller number.
If the mux controller chip only provides a single mux controller, the
mux-ctrl-specifier can typically be left out.

Example:

	/* One consumer of a 2-way mux controller (one GPIO-line) */
	mux: mux-controller {
		compatible = "mux-gpio";
		#mux-control-cells = <0>;

		mux-gpios = <&pioA 0 GPIO_ACTIVE_HIGH>;
	};

	adc-mux {
		compatible = "io-channel-mux";
		io-channels = <&adc 0>;
		io-channel-names = "parent";
		mux-controls = <&mux>;
		mux-control-names = "adc";

		channels = "sync", "in";
	};

Note that in the example above, specifying the "mux-control-names" is redundant
because there is only one mux controller in the list.

	/*
	 * Two consumers (one for an ADC line and one for an i2c bus) of
	 * parallel 4-way multiplexers controlled by the same two GPIO-lines.
	 */
	mux: mux-controller {
		compatible = "mux-gpio";
		#mux-control-cells = <0>;

		mux-gpios = <&pioA 0 GPIO_ACTIVE_HIGH>,
			    <&pioA 1 GPIO_ACTIVE_HIGH>;
	};

	adc-mux {
		compatible = "io-channel-mux";
		io-channels = <&adc 0>;
		io-channel-names = "parent";
		mux-controls = <&mux>;

		channels = "sync-1", "in", "out", "sync-2";
	};

	i2c-mux {
		compatible = "i2c-mux-simple,mux-locked";
		i2c-parent = <&i2c1>;
		mux-controls = <&mux>;

		#address-cells = <1>;
		#size-cells = <0>;

		i2c@0 {
			reg = <0>;
			#address-cells = <1>;
			#size-cells = <0>;

			ssd1307: oled@3c {
				/* ... */
			};
		};

		i2c@3 {
			reg = <3>;
			#address-cells = <1>;
			#size-cells = <0>;

			pca9555: pca9555@20 {
				/* ... */
			};
		};
	};


Mux controller nodes
--------------------

Mux controller nodes must specify the number of cells used for the
specifier using the '#mux-control-cells' property.

An example mux controller might look like this:

	mux: adg792a@50 {
		compatible = "adi,adg792a";
		reg = <0x50>;
		#mux-control-cells = <1>;
	};


Combinded controller and consumer of a GPIO mux
-----------------------------------------------

For the common case of a single consumer of a GPIO controlled mux, there is
a simplified binding which will instantiate an implicit mux controller. Just
specify a mux-gpios property with the same interpretation as in mux-gpio.txt.
Note that other properties described in mux-gpio.txt are not available in
this simplified form and that the mux controller is unnamed. If you need
more than one mux controller, a shared mux controller or if you need a
specific idle-state, use the more flexible binding with the mux controller
in its own node.

Example:

	adc-mux {
		compatible = "io-channel-mux";
		io-channels = <&adc 0>;
		io-channel-names = "parent";

		mux-gpios = <&pioA 0 GPIO_ACTIVE_HIGH>,
			    <&pioA 1 GPIO_ACTIVE_HIGH>;

		channels = "sync-1", "in", "out", "sync-2";
	};
```

## Documentation/devicetree/bindings/mwifiex.txt
```
mwifiex
------

Required properties:

  - name : must be "mwifiex"
  - compatible : must be "marvell,mwifiex"

Optional properties:

  - mwifiex,caldata* : A series of properties with marvell,caldata prefix,
  		      represent Calibration data downloaded to the device during
		      initialization. This is an array of unsigned values.
  - mwifiex,chip-gpio : Chip's wakeup gpio pin number. This needs to be downloaded
			to to firmware. Chip notifies wifi wakeup signal to SOC
			through this pin.

Example:

Tx power limit calibration data is configured in below example.
The calibration data is an array of unsigned values, the length
can vary between hw versions.

mwifiex {
	compatible = "marvell,mwifiex";

	mwifiex,caldata_00_txpwrlimit_2g_cfg_set = /bits/ 8 <
0x01 0x00 0x06 0x00 0x08 0x02 0x89 0x01 ...>;
	mwifiex,chip-gpio = <3>;
};
```

## Documentation/devicetree/bindings/nds32/pmu.txt
```
* NDS32 Performance Monitor Units

NDS32 core have a PMU for counting cpu and cache events like cache misses.
The NDS32 PMU representation in the device tree should be done as under:

Required properties:

- compatilbe :
	"andestech,atcpmu"

- interrupts : The interrupt number for NDS32 PMU is 13.

Example:
pmu{
	compatible = "andestech,atcpmu";
	interrupts = <13>;
}
```

## Documentation/devicetree/bindings/net/aurora,nb8800.txt
```
* Aurora VLSI AU-NB8800 Ethernet controller

Required properties:
- compatible: Should be "sigma,smp8640-ethernet", "aurora,nb8800"
	The former indicates presence of extra features added by Sigma Designs.
- reg: Should be MMIO address space of the device
- interrupts: Should contain the interrupt specifier for the device
- interrupt-parent: Should be a phandle for the interrupt controller
- clocks: Should be a phandle for the clock for the device

Common properties described in ethernet.txt:
- local-mac-address
- mac-address
- max-speed
- phy-mode

Example:

ethernet@26000 {
	compatible = "aurora,nb8800";
	reg = <0x10000 0x800>;
	interrupts = <42>;
	clocks = <&sys_clk>;
	max-speed = <1000>;
	phy-connection-type = "rgmii";
};
```
