## Documentation/devicetree/bindings/net/brcm,bgmac-enet.txt
```
Broadcom GMAC Ethernet Controller Device Tree Bindings
-------------------------------------------------------------

Required properties:
 - compatible:	"brcm,bgmac-enet"
 - reg:		Address and length of the GMAC registers,
		Address and length of the GMAC IDM registers
 - interrupts:	Interrupt number

Optional properties:
- mac-address:	mac address to be assigned to the device

Examples:

gmac0: enet@18022000 {
	compatible = "brcm,bgmac-enet";
	reg = <0x18022000 0x1000>,
	      <0x18110000 0x1000>;
	interrupts = <GIC_SPI 147 IRQ_TYPE_LEVEL_HIGH>;
	status = "disabled";
};
```

## Documentation/devicetree/bindings/net/broadcom-bluetooth.txt
```
Broadcom Bluetooth Chips
---------------------

This documents the binding structure and common properties for serial
attached Broadcom devices.

Serial attached Broadcom devices shall be a child node of the host UART
device the slave device is attached to.

Required properties:

 - compatible: should contain one of the following:
   * "brcm,bcm43438-bt"

Optional properties:

 - max-speed: see Documentation/devicetree/bindings/serial/slave-device.txt
 - shutdown-gpios: GPIO specifier, used to enable the BT module
 - device-wakeup-gpios: GPIO specifier, used to wakeup the controller
 - host-wakeup-gpios: GPIO specifier, used to wakeup the host processor
 - clocks: clock specifier if external clock provided to the controller
 - clock-names: should be "extclk"

 SCO routing parameters:
 - sco-routing: 0-3 (PCM, Transport, Codec, I2S)
 - pcm-interface-rate: 0-4 (128 Kbps - 2048 Kbps)
 - pcm-frame-type: 0 (short), 1 (long)
 - pcm-sync-mode: 0 (slave), 1 (master)
 - pcm-clock-mode: 0 (slave), 1 (master)

Example:

&uart2 {
       pinctrl-names = "default";
       pinctrl-0 = <&uart2_pins>;

       bluetooth {
               compatible = "brcm,bcm43438-bt";
               max-speed = <921600>;
               sco-routing = <1>; /* 1 = transport (UART) */
       };
};
```

## Documentation/devicetree/bindings/net/can/ti_hecc-can.txt
```
* TI HECC CAN *

Required properties:
  - compatible: Should be "ti,hecc"
  - reg: Should contain CAN controller registers location and length
  - interrupts: Should contain IRQ line for the CAN controller

Example:

	can0: hecc@5c050000 {
		compatible = "ti,hecc";
		reg = <0x5c050000 0x4000>;
		interrupts = <24>;
		ti,hecc_scc_offset = <0>;
		ti,hecc_scc_ram_offset = <0x3000>;
		ti,hecc_ram_offset = <0x3000>;
		ti,hecc_mbx_offset = <0x2000>;
		ti,hecc_int_line = <0>;
		ti,hecc_version = <1>;
	};
```

## Documentation/devicetree/bindings/net/cavium-bgx.txt
```
* Common Ethernet Interface (BGX) block

Properties:

- compatible: "cavium,octeon-7890-bgx": Compatibility with all cn7xxx SOCs.

- reg: The base address of the BGX block.

- #address-cells: Must be <1>.

- #size-cells: Must be <0>.  BGX addresses have no size component.

A BGX block has several children, each representing an Ethernet
interface.


* Ethernet Interface (BGX port) connects to PKI/PKO

Properties:

- compatible: "cavium,octeon-7890-bgx-port": Compatibility with all
	      cn7xxx SOCs.

	      "cavium,octeon-7360-xcv": Compatibility with cn73xx SOCs
	      for RGMII.

- reg: The index of the interface within the BGX block.

Optional properties:

- local-mac-address: Mac address for the interface.

- phy-handle: phandle to the phy node connected to the interface.

- phy-mode: described in ethernet.txt.

- fixed-link: described in fixed-link.txt.

Example:

	ethernet-mac-nexus@11800e0000000 {
		compatible = "cavium,octeon-7890-bgx";
		reg = <0x00011800 0xe0000000 0x00000000 0x01000000>;
		#address-cells = <1>;
		#size-cells = <0>;

		ethernet-mac@0 {
			compatible = "cavium,octeon-7360-xcv";
			reg = <0>;
			local-mac-address = [ 00 01 23 45 67 89 ];
			phy-handle = <&phy3>;
			phy-mode = "rgmii-rxid"
		};
		ethernet-mac@1 {
			compatible = "cavium,octeon-7890-bgx-port";
			reg = <1>;
			local-mac-address = [ 00 01 23 45 67 8a ];
			phy-handle = <&phy4>;
			phy-mode = "sgmii"
		};
	};
```

## Documentation/devicetree/bindings/net/dsa/lan9303.txt
```
SMSC/MicroChip LAN9303 three port ethernet switch
-------------------------------------------------

Required properties:

- compatible: should be "smsc,lan9303"
- #size-cells: must be 0
- #address-cells: must be 1

Optional properties:

- reset-gpios: GPIO to be used to reset the whole device, always low active
- reset-duration: reset duration in milliseconds, defaults to 200 ms

Subnodes:

The integrated switch subnode should be specified according to the binding
described in dsa/dsa.txt. The CPU port of this switch is always port 0.

Example:

I2C managed mode:

	master: masterdevice@X {
		status = "okay";

		fixed-link { /* RMII fixed link to LAN9303 */
			speed = <100>;
			full-duplex;
		};
	};

	switch: switch@a {
		compatible = "smsc,lan9303";
		reg = <0xa>;
		status = "okay";
		reset-gpios = <&gpio7 6 GPIO_ACTIVE_LOW>;
		reset-duration = <200>;

		dsa,member = <0 0>;

		ports {
			#address-cells = <1>;
			#size-cells = <0>;

			port@0 { /* RMII fixed link to master */
				reg = <0>;
				label = "cpu";
				ethernet = <&master>;
			};

			port@1 { /* external port 1 */
				compatible = "ethernet-phy-ieee802.3-c22";
				reg = <1>;
				label = "lan1;
			};

			port@2 { /* external port 2 */
				compatible = "ethernet-phy-ieee802.3-c22";
				reg = <2>;
				label = "lan2";
			};
		};
	};
```

## Documentation/devicetree/bindings/net/dsa/marvell.txt
```
Marvell DSA Switch Device Tree Bindings
---------------------------------------

WARNING: This binding is currently unstable. Do not program it into a
FLASH never to be changed again. Once this binding is stable, this
warning will be removed.

If you need a stable binding, use the old dsa.txt binding.

Marvell Switches are MDIO devices. The following properties should be
placed as a child node of an mdio device.

The properties described here are those specific to Marvell devices.
Additional required and optional properties can be found in dsa.txt.

Required properties:
- compatible           : Should be one of:
                         * "marvell,mv88e6085",
                         * "marvell,mv88e6095",
                         * "marvell,mv88e6123",
                         * "marvell,mv88e6131",
                         * "marvell,mv88e6161",
                         * "marvell,mv88e6165",
                         * "marvell,mv88e6171",
                         * "marvell,mv88e6172",
                         * "marvell,mv88e6175",
                         * "marvell,mv88e6176",
                         * "marvell,mv88e6185",
                         * "marvell,mv88e6240",
                         * "marvell,mv88e6320",
                         * "marvell,mv88e6321",
                         * "marvell,mv88e6350",
                         * "marvell,mv88e6351",
                         * "marvell,mv88e6352",
- reg                  : Address on the MII bus for the switch.

Optional properties:

- reset-gpios		: Should be a gpio specifier for a reset line

Example:

       mdio {
               #address-cells = <1>;
               #size-cells = <0>;

               switch0: switch@0 {
                       compatible = "marvell,mv88e6085";
                       reg = <0>;
		       reset-gpios = <&gpio5 1 GPIO_ACTIVE_LOW>;
               };
       };
```

## Documentation/devicetree/bindings/net/dsa/mt7530.txt
```
Mediatek MT7530 Ethernet switch
================================

Required properties:

- compatible: Must be compatible = "mediatek,mt7530";
- #address-cells: Must be 1
- #size-cells: Must be 0
- mediatek,ethsys: Phandle to the syscon node that handles the reset.
- mediatek,ethernet: Phandle to the syscon node that Mediatek ethernet driver
	provides that handles the TRGMII setup used by the switch.
	See
	Documentation/devicetree/bindings/net/mediatek-net.txt for the detailed
	setup on mediatek ethernet.
- mediatek,mcm: String, should be "enabled" or "disabled" to indicate that
	either MT7530 is the part on multi-chip module belong to MT7623A has
	or the remotely standalone chip as the function MT7623N reference board
	provided for.
- core-supply: Phandle to the regulator node necessary for the core power.
- io-supply: Phandle to the regulator node necessary for the I/O power
	See Documentation/devicetree/bindings/regulator/mt6323-regulator.txt
	for details for the regulator setup on these boards.
- mediatek,reset-pin: Phandle to the pinctrl node used for the reset. Which
	must be required if the property mediatek,mcm of specified as
	"disabled". See
	Documentation/devicetree/bindings/pinctrl/pinctrl-mt65xx.txt for
	the mediatek pintcrl setting for the details.

Each port children node within ports container must have the following
mandatory properties:
- reg			: Port address described must be 6 for CPU port
			and from 0 to 5 for user ports.

See Documentation/devicetree/bindings/dsa/dsa.txt for a list of additional
required, optional properties and how the integrated switch subnodes must
be specified.

Example:

	&mdio0 {
		switch@0 {
			compatible = "mediatek,mt7530";
			#address-cells = <1>;
			#size-cells = <0>;
			reg = <0>;

			mediatek,ethsys = <&ethsys>;
			mediatek,ethernet = <&eth>;
			mediatek,mcm = "enabled";
			core-supply = <&mt6323_vpa_reg>;
			io-supply = <&mt6323_vemc3v3_reg>;

			ports {
				#address-cells = <1>;
				#size-cells = <0>;
				reg = <0>;
				port@0 {
					reg = <0>;
					label = "lan0";
				};

				port@1 {
					reg = <1>;
					label = "lan1";
				};

				port@2 {
					reg = <2>;
					label = "lan2";
				};

				port@3 {
					reg = <3>;
					label = "lan3";
				};

				port@4 {
					reg = <4>;
					label = "wan";
				};

				port@6 {
					reg = <6>;
					label = "cpu";
					ethernet = <&eth>;
					phy-mode = "trgmii";
					fixed-link {
						speed = <1000>;
						full-duplex;
					};
				};
			};
		};
	};
```

## Documentation/devicetree/bindings/net/dsa/qca8k.txt
```
* Qualcomm Atheros QCA8xxx switch family

Required properties:

- compatible: should be "qca,qca8337"
- #size-cells: must be 0
- #address-cells: must be 1

Subnodes:

The integrated switch subnode should be specified according to the binding
described in dsa/dsa.txt.

Example:

	&mdio0 {
		switch@0 {
			compatible = "qca,qca8337";

			#address-cells = <1>;
			#size-cells = <0>;
			reg = <30>;

			ports {
				port@0 {
					reg = <11>;
					label = "cpu";
					ethernet = <&gmac1>;
					phy-mode = "rgmii";
				};

				port@1 {
					reg = <0>;
					label = "lan1";
				};

				port@2 {
					reg = <1>;
					label = "lan2";
				};

				port@3 {
					reg = <2>;
					label = "lan3";
				};

				port@4 {
					reg = <3>;
					label = "lan4";
				};
			}
		};
	};
```

## Documentation/devicetree/bindings/net/dsa/realtek-smi.txt
```
Realtek SMI-based Switches
==========================

The SMI "Simple Management Interface" is a two-wire protocol using
bit-banged GPIO that while it reuses the MDIO lines MCK and MDIO does
not use the MDIO protocol. This binding defines how to specify the
SMI-based Realtek devices.

Required properties:

- compatible: must be exactly one of:
      "realtek,rtl8366"
      "realtek,rtl8369"
      "realtek,rtl8366rb"
      "realtek,rtl8366s"
      "realtek,rtl8367"
      "realtek,rtl8367b"

Required subnode:

- interrupt-controller

  This defines an interrupt controller with an IRQ line (typically
  a GPIO) that will demultiplex and handle the interrupt from the single
  interrupt line coming out of one of the SMI-based chips. It most
  importantly provides link up/down interrupts to the PHY blocks inside
  the ASIC.

Required properties of interrupt-controller:

- interrupt: parent interrupt, see interrupt-controller/interrupts.txt
- interrupt-controller: see interrupt-controller/interrupts.txt
- #address-cells: should be <0>
- #interrupt-cells: should be <1>

See net/dsa/dsa.txt for a list of additional required and optional properties
and subnodes.


Examples:

switch {
	compatible = "realtek,rtl8366rb";
	reg = <0>;
	/* 22 = MDIO (has input reads), 21 = MDC (clock, output only) */
	mdc-gpios = <&gpio0 21 GPIO_ACTIVE_HIGH>;
	mdio-gpios = <&gpio0 22 GPIO_ACTIVE_HIGH>;
	reset-gpios = <&gpio0 14 GPIO_ACTIVE_LOW>;

	switch_intc: interrupt-controller {
		/* GPIO 15 provides the interrupt */
		interrupt-parent = <&gpio0>;
		interrupts = <15 IRQ_TYPE_LEVEL_LOW>;
		interrupt-controller;
		#address-cells = <0>;
		#interrupt-cells = <1>;
	};

	ports {
		#address-cells = <1>;
		#size-cells = <0>;
		reg = <0>;
		port@0 {
			reg = <0>;
			label = "lan0";
			interrupt-parent = <&switch_intc>;
			interrupts = <0>;
		};
		port@1 {
			reg = <1>;
			label = "lan1";
			interrupt-parent = <&switch_intc>;
			interrupts = <1>;
		};
		port@2 {
			reg = <2>;
			label = "lan2";
			interrupt-parent = <&switch_intc>;
			interrupts = <2>;
		};
		port@3 {
			reg = <3>;
			label = "lan3";
			interrupt-parent = <&switch_intc>;
			interrupts = <3>;
		};
		port@4 {
			reg = <4>;
			label = "wan";
			interrupt-parent = <&switch_intc>;
			interrupts = <4>;
		};
		phy0: port@5 {
			reg = <5>;
			label = "cpu";
			ethernet = <&gmac0>;
			phy-mode = "rgmii";
			fixed-link {
				speed = <1000>;
				full-duplex;
			};
		};
	};
};
```

## Documentation/devicetree/bindings/net/hisilicon-femac.txt
```
Hisilicon Fast Ethernet MAC controller

Required properties:
- compatible: should be "hisilicon,hisi-femac" and one of the following:
	* "hisilicon,hisi-femac-v1"
	* "hisilicon,hisi-femac-v2"
- reg: specifies base physical address(s) and size of the device registers.
  The first region is the MAC core register base and size.
  The second region is the global MAC control register.
- interrupts: should contain the MAC interrupt.
- clocks: clock phandle and specifier pair.
- resets: should contain the phandle to the MAC reset signal(required) and
	the PHY reset signal(optional).
- reset-names: should contain the reset signal name "mac_reset"(required)
	and "phy_reset"(optional).
- mac-address: see ethernet.txt [1].
- phy-mode: see ethernet.txt [1].
- phy-handle: see ethernet.txt [1].
- hisilicon,phy-reset-delays: triplet of delays if PHY reset signal given.
	The 1st cell is reset pre-delay in micro seconds.
	The 2nd cell is reset pulse in micro seconds.
	The 3rd cell is reset post-delay in micro seconds.

[1] Documentation/devicetree/bindings/net/ethernet.txt

Example:
	hisi_femac: ethernet@10090000 {
		compatible = "hisilicon,hisi-femac-v2", "hisilicon,hisi-femac";
		reg = <0x10090000 0x1000>,<0x10091300 0x200>;
		interrupts = <12>;
		clocks = <&crg HI3518EV200_ETH_CLK>;
		resets = <&crg 0xec 0>,
				<&crg 0xec 3>;
		reset-names = "mac_reset",
				"phy_reset";
		mac-address = [00 00 00 00 00 00];
		phy-mode = "mii";
		phy-handle = <&phy0>;
		hisilicon,phy-reset-delays = <10000 20000 20000>;
	};
```
