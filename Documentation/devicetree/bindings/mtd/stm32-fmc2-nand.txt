## Documentation/devicetree/bindings/net/hisilicon-hix5hd2-gmac.txt
```
Hisilicon hix5hd2 gmac controller

Required properties:
- compatible: should contain one of the following version strings:
	* "hisilicon,hisi-gemac-v1"
	* "hisilicon,hisi-gemac-v2"
	and one of the following SoC string:
	* "hisilicon,hix5hd2-gemac"
	* "hisilicon,hi3798cv200-gemac"
- reg: specifies base physical address(s) and size of the device registers.
  The first region is the MAC register base and size.
  The second region is external interface control register.
- interrupts: should contain the MAC interrupt.
- #address-cells: must be <1>.
- #size-cells: must be <0>.
- phy-mode: see ethernet.txt [1].
- phy-handle: see ethernet.txt [1].
- mac-address: see ethernet.txt [1].
- clocks: clock phandle and specifier pair.
- clock-names: contain the clock name "mac_core" and "mac_ifc".
- resets: should contain the phandle to the MAC core reset signal(required),
	the MAC interface reset signal(required)
	and the PHY reset signal(optional).
- reset-names: contain the reset signal name "mac_core"(required),
	"mac_ifc"(required) and "phy"(optional).
- hisilicon,phy-reset-delays-us: triplet of delays if PHY reset signal given.
	The 1st cell is reset pre-delay in micro seconds.
	The 2nd cell is reset pulse in micro seconds.
	The 3rd cell is reset post-delay in micro seconds.

- PHY subnode: inherits from phy binding [2]

[1] Documentation/devicetree/bindings/net/ethernet.txt
[2] Documentation/devicetree/bindings/net/phy.txt

Example:
	gmac0: ethernet@f9840000 {
		compatible = "hisilicon,hix5hd2-gemac", "hisilicon,hisi-gemac-v1";
		reg = <0xf9840000 0x1000>,<0xf984300c 0x4>;
		interrupts = <0 71 4>;
		#address-cells = <1>;
		#size-cells = <0>;
		phy-mode = "mii";
		phy-handle = <&phy2>;
		mac-address = [00 00 00 00 00 00];
		clocks = <&clock HIX5HD2_MAC0_CLK>, <&clock HIX5HD2_MAC_IFC0_CLK>;
		clock-names = "mac_core", "mac_ifc";
		resets = <&clock 0xcc 8>, <&clock 0xcc 10>, <&clock 0x120 4>;
		reset-names = "mac_core", "mac_ifc", "phy";
		hisilicon,phy-reset-delays-us = <10000 10000 30000>;

		phy2: ethernet-phy@2 {
			reg = <2>;
		};
	};
```

## Documentation/devicetree/bindings/net/hisilicon-hns-mdio.txt
```
Hisilicon MDIO bus controller

Properties:
- compatible: can be one of "hisilicon,hns-mdio","hisilicon,mdio",
  for hip04 board, please use "hisilicon,mdio",
  other boards, "hisilicon,hns-mdio" is OK.
- reg: The base address of the MDIO bus controller register bank.
- #address-cells: Must be <1>.
- #size-cells: Must be <0>.  MDIO addresses have no size component.

Typically an MDIO bus might have several children.

Example:
         mdio@803c0000 {
                   #address-cells = <1>;
                   #size-cells = <0>;
                   compatible = "hisilicon,hns-mdio","hisilicon,mdio";
                   reg = <0x0 0x803c0000 0x0 0x10000>;

                   ethernet-phy@0 {
                            ...
                            reg = <0>;
                   };
         };
```

## Documentation/devicetree/bindings/net/macb-mdio.txt
```
* Cadence MACB MDIO controller

Required properties:
- compatible: Should be "cdns,macb-mdio"
- reg: Address and length of the register set of MAC to be used
- clock-names: Tuple listing input clock names.
	Required elements: 'pclk', 'hclk'
	Optional elements: 'tx_clk'
- clocks: Phandles to input clocks.

Examples:

	mdio {
		compatible = "cdns,macb-mdio";
		reg = <0x0 0xff0b0000 0x0 0x1000>;
		clocks = <&clk125>, <&clk125>, <&clk125>;
		clock-names = "pclk", "hclk", "tx_clk";
		ethernet_phyC: ethernet-phy@C {
			reg = <C>;
		};
		ethernet_phy7: ethernet-phy@7 {
			reg = <7>;
		};
		ethernet_phy3: ethernet-phy@3 {
			reg = <3>;
		};
		ethernet_phy8: ethernet-phy@8 {
			reg = <8>;
		};
	};
```

## Documentation/devicetree/bindings/net/macb.txt
```
* Cadence MACB/GEM Ethernet controller

Required properties:
- compatible: Should be "cdns,[<chip>-]{macb|gem}"
  Use "cdns,at91sam9260-macb" for Atmel at91sam9 SoCs or the 10/100Mbit IP
  available on sama5d3 SoCs.
  Use "cdns,at32ap7000-macb" for other 10/100 usage or use the generic form: "cdns,macb".
  Use "cdns,pc302-gem" for Picochip picoXcell pc302 and later devices based on
  the Cadence GEM, or the generic form: "cdns,gem".
  Use "atmel,sama5d2-gem" for the GEM IP (10/100) available on Atmel sama5d2 SoCs.
  Use "atmel,sama5d3-gem" for the Gigabit IP available on Atmel sama5d3 SoCs.
  Use "atmel,sama5d4-gem" for the GEM IP (10/100) available on Atmel sama5d4 SoCs.
  Use "cdns,zynqmp-gem" for Zynq Ultrascale+ MPSoC.
- reg: Address and length of the register set for the device
- interrupts: Should contain macb interrupt
- phy-mode: See ethernet.txt file in the same directory.
- clock-names: Tuple listing input clock names.
	Required elements: 'pclk', 'hclk'
	Optional elements: 'tx_clk'
- clocks: Phandles to input clocks.

Optional properties:
- cdns,usrio-has-clken: Boolean; The USRIO register has an clock-enable bit.
- cdns,usrio-default-mii: Boolean; The USRIO register defaults to MII mode.
- cdns,usrio-disabled: Boolean; The USRIO register is not implemented.
- cdns,no-gigabit-half: Boolean; The MAC does not support 1000/Half link mode.
- cdns,gem-sg-disabled: Boolean; The MAC does not support Scatter-Gather mode.
- cdns,gem-has-gigabit: Boolean; The MAC supports Gigabit Ethernet.
- cdns,dma-burst-length: Should countain the DMA burst length.
- cdns,jumbo-max-length: Should countain the maximum Jumbo frame length.

Examples:

	macb0: ethernet@fffc4000 {
		compatible = "cdns,at32ap7000-macb";
		reg = <0xfffc4000 0x4000>;
		interrupts = <21>;
		phy-mode = "rmii";
		local-mac-address = [3a 0e 03 04 05 06];
		clock-names = "pclk", "hclk", "tx_clk";
		clocks = <&clkc 30>, <&clkc 30>, <&clkc 13>;
	};
```

## Documentation/devicetree/bindings/net/mchp9352.txt
```
* Microchip LAN9352 Controller

Required properties:
- compatible : Should be "microchip,lan9352"
- reg : Address and length of the io space for Microchip LAN
- interrupts : Should contain Microchip LAN interrupt line
- interrupt-parent : Should be the phandle for the interrupt controller
  that services interrupts for this device
- phy-mode : See ethernet.txt file in the same directory

Optional properties:
- reg-shift : Specify the quantity to shift the register offsets by
- reg-io-width : Specify the size (in bytes) of the IO accesses that
  should be performed on the device.  Valid value for Microchip LAN is
  2 or 4.  If it's omitted or invalid, the size would be 2.
- microchip,irq-active-high : Indicates the IRQ polarity is active-high
- microchip,irq-push-pull : Indicates the IRQ type is push-pull
- microchip,save-mac-address : Indicates that mac address needs to be saved
  before resetting the controller

Examples:

lan9220@f4000000 {
	compatible = "microchip,lan9352";
	reg = <0xf4000000 0x2000000>;
	phy-mode = "mii";
	interrupt-parent = <&gpio1>;
	interrupts = <31>;
	reg-io-width = <4>;
	microchip,irq-push-pull;
};
```

## Documentation/devicetree/bindings/net/mdio-mux-regmap.txt
```
Properties for an MDIO bus multiplexer controlled by a regmap

This is a special case of a MDIO bus multiplexer.  A regmap device,
like an FPGA, is used to control which child bus is connected.  The mdio-mux
node must be a child of the device that is controlled by a regmap.
The driver currently only supports devices with upto 32-bit registers.

Required properties in addition to the generic multiplexer properties:

- reg : integer, contains the offset of the register that controls the bus
	multiplexer. it can be 32 bit number.

- mux-mask : integer, contains an 32 bit mask that specifies which
	bits in the register control the actual bus multiplexer.  The
	'reg' property of each child mdio-mux node must be constrained by
	this mask.

Example 1:

The FPGA node defines a i2c connected FPGA with a register space of 0x30 bytes.
For the "EMI2" MDIO bus, register 0x54 (BRDCFG4) controls the mux on that bus.
A bitmask of 0x07 means that bits 0, 1 and 2 (bit 0 is lsb) are the bits on
BRDCFG4 that control the actual mux.

i2c@2000000 {
	compatible = "fsl,vf610-i2c";
	#address-cells = <1>;
	#size-cells = <0>;
	reg = <0x0 0x2000000 0x0 0x10000>;
	interrupts = <0 34 0x4>; // Level high type
	clock-names = "i2c";
	clocks = <&clockgen 4 7>;
	fsl-scl-gpio = <&gpio2 15 0>;
	status = "okay";

	/* The FPGA node */
	fpga@66 {
		compatible = "fsl,lx2160aqds-fpga", "fsl,fpga-qixis-i2c";
		reg = <0x66>; // fpga device address on i2c bus
		#address-cells = <1>;
		#size-cells = <0>;

		mdio-mux-2@54 {
			mdio-parent-bus = <&emdio2>; /* MDIO bus */
			reg = <0x54>;	    /* BRDCFG4 */
			mux-mask = <0x07>;      /* EMI2_MDIO */
			#address-cells=<1>;
			#size-cells = <0>;

			mdio@0 {   // Slot 1
				reg = <0x00>;
				#address-cells = <1>;
				#size-cells = <0>;

				ethernet-phy@@1 {
					reg = <1>;
					compatible = "ethernet-phy-id0210.7441";
				};

				ethernet-phy@@0 {
					reg = <0>;
					compatible = "ethernet-phy-id0210.7441";
				};
			};

			mdio@1 {   // Slot 2
				reg = <0x01>;
				#address-cells = <1>;
				#size-cells = <0>;

			};

			mdio@2 {   // Slot 3
				reg = <0x02>;
				#address-cells = <1>;
				#size-cells = <0>;

			};
		};
	};
};

/* The parent MDIO bus. */
emdio2: mdio@0x8B97000 {
	compatible = "fsl,fman-memac-mdio";
	reg = <0x0 0x8B97000 0x0 0x1000>;
	#address-cells = <1>;
	#size-cells = <0>;
	little-endian;
};

Example 2:

The FPGA node defines a memory mapped FPGA with a register space of 0x100 bytes.
For the "EMI1" MDIO bus, register 0x54 (BRDCFG4) controls the mux on that bus.
A bitmask of 0xe0 means that bits 5, 6 and 7 (bit 0 is lsb) are the bits on
BRDCFG4 that control the actual mux.

ifc: ifc@1530000 {
	compatible = "fsl,ifc", "simple-bus";
	reg = <0x0 0x1530000 0x0 0x10000>;
	interrupts = <GIC_SPI 75 IRQ_TYPE_LEVEL_HIGH>;
	#address-cells = <2>;
	#size-cells = <1>;
	/* NOR, NAND Flashes and FPGA on board */
	ranges = <0x0 0x0 0x0 0x60000000 0x08000000
		  0x2 0x0 0x0 0x7e800000 0x00010000
		  0x3 0x0 0x0 0x7fb00000 0x00000100>;
	status = "okay";

	/* The FPGA node */
	fpga: board-control@3,0 {
		compatible = "fsl,ls1021aqds-fpga", "fsl,fpga-qixis";
		reg = <0x3 0x0 0x0000100>;
		#address-cells = <1>;
		#size-cells = <0>;

		mdio-mux-1@54 {
			mdio-parent-bus = <&emdio1>; /* MDIO bus */
			reg = <0x54>;	    /* BRDCFG4 */
			mux-mask = <0xe0>;      /* EMI1_MDIO */
			#address-cells=<1>;
			#size-cells = <0>;

			mdio@0 {   // Onboard PHYs rgmii_phy1
				reg = <0x00>;
				#address-cells = <1>;
				#size-cells = <0>;

				ethernet-phy@@1 {
					reg = <1>;
					compatible = "ethernet-phy-ieee802.3-c22";
				};
			};

			mdio@20 {   // Onboard PHYs rgmii_phy2
				reg = <0x20>;
				#address-cells = <1>;
				#size-cells = <0>;
				ethernet-phy@2 {
					reg = <0x2>;
					compatible = "ethernet-phy-ieee802.3-c22";
				};
			};

			mdio@40 {   // Onboard PHYs rgmii_phy3
				reg = <0x40>;
				#address-cells = <1>;
				#size-cells = <0>;
				ethernet-phy@3 {
					reg = <0x3>;
					compatible = "ethernet-phy-ieee802.3-c22";
				};
			};
		};
	};
};

/* The parent MDIO bus. */
emdio1: mdio@2d24000 {
	compatible = "gianfar";
	device_type = "mdio";
	#address-cells = <1>;
	#size-cells = <0>;
	reg = <0x0 0x2d24000 0x0 0x4000>,
	      <0x0 0x2d10030 0x0 0x4>;
};
```
