## Documentation/devicetree/bindings/iio/light/tsl2772.txt
```
* AMS/TAOS ALS and proximity sensor

Required properties:

  - compatible: Should be one of
		"amstaos,tsl2571"
		"amstaos,tsl2671"
		"amstaos,tmd2671"
		"amstaos,tsl2771"
		"amstaos,tmd2771"
		"amstaos,tsl2572"
		"amstaos,tsl2672"
		"amstaos,tmd2672"
		"amstaos,tsl2772"
		"amstaos,tmd2772"
  - reg: the I2C address of the device

Optional properties:

  - amstaos,prox_diode - must be TSL2772_DIODE0, TSL2772_DIODE1, or
                         TSL2772_DIODE_BOTH.
  - amstaos,prox_power - must be TSL2772_100_mA, TSL2772_50_mA, TSL2772_25_mA,
                         or TSL2772_13_mA.
  - vdd-supply: phandle to the regulator that provides power to the sensor.
  - vddio-supply: phandle to the regulator that provides power to the bus.
  - interrupt-parent: should be the phandle for the interrupt controller
  - interrupts: the sole interrupt generated by the device

  Refer to interrupt-controller/interrupts.txt for generic interrupt client
  node bindings.

Example:

#include <dt-bindings/iio/amstaos,tsl2772.h>

tsl2772@39 {
	compatible = "amstaos,tsl2772";
	reg = <0x39>;
	interrupts-extended = <&msmgpio 61 IRQ_TYPE_EDGE_FALLING>;
	vdd-supply = <&pm8941_l17>;
	vddio-supply = <&pm8941_lvs1>;
	amstaos,prox_diode = <TSL2772_DIODE0>;
};
```

## Documentation/devicetree/bindings/iio/magnetometer/pni,rm3100.txt
```
* PNI RM3100 9-axis magnetometer sensor

I2C Bus:

Required properties:

- compatible : should be "pni,rm3100-i2c"
- reg : the I2C address of the magnetometer

Optional properties:

- interrupts: data ready (DRDY) from the chip.
  The interrupts can be triggered on rising edges.

	Refer to interrupt-controller/interrupts.txt for generic
	interrupt client node bindings.

- pinctrl-*: pinctrl setup for DRDY line.

Example:

rm3100: rm3100@20 {
	pinctrl-names = "default";
	pinctrl-0 = <&rm3100_pins>;

	compatible = "pni,rm3100-i2c";
	reg = <0x20>;
	interrupt-parent = <&gpio0>;
	interrupts = <4 IRQ_TYPE_EDGE_RISING>;
};

SPI Bus:

Required properties:

- compatible : should be "pni,rm3100-spi"
- reg : address of sensor, usually 0 or 1.

Optional properties:

- interrupts: data ready (DRDY) from the chip.
  The interrupts can be triggered on rising edges.

	Refer to interrupt-controller/interrupts.txt for generic
	interrupt client node bindings.

- pinctrl-*: pinctrl setup for DRDY line, depands on archtechture.

Example:

rm3100: rm3100@0{
	compatible = "pni,rm3100-spi";
	reg = <0>;

	interrupt-parent = <&gpio0>;
	interrupts = <4 IRQ_TYPE_EDGE_RISING>;
};
```

## Documentation/devicetree/bindings/iio/misc/iio-regulator.txt
```
Industrial IO regulator device driver
-------------------------------------

This document describes the bindings for the iio-regulator - a dummy device
driver representing a physical regulator within the iio framework.

Required properties:

- compatible: must be "iio-regulator"
- vcc-supply: phandle of the regulator this device represents

Example
-------

iio_regulator {
	compatible = "iio-regulator";
	vcc-supply = <&vcc0>;
};
```

## Documentation/devicetree/bindings/iio/multiplexer/iio-mux.txt
```
IIO multiplexer bindings

If a multiplexer is used to select which hardware signal is fed to
e.g. an ADC channel, these bindings describe that situation.

Required properties:
- compatible : "iio-mux"
- io-channels : Channel node of the parent channel that has multiplexed
		input.
- io-channel-names : Should be "parent".
- #address-cells = <1>;
- #size-cells = <0>;
- mux-controls : Mux controller node to use for operating the mux
- channels : List of strings, labeling the mux controller states.

The multiplexer state as described in ../misc/mux-controller.txt

For each non-empty string in the channels property, an iio channel will
be created. The number of this iio channel is the same as the index into
the list of strings in the channels property, and also matches the mux
controller state.

Example:
	mux: mux-controller {
		compatible = "mux-gpio";
		#mux-control-cells = <0>;

		mux-gpios = <&pioA 0 GPIO_ACTIVE_HIGH>,
			    <&pioA 1 GPIO_ACTIVE_HIGH>;
	};

	adc-mux {
		compatible = "iio-mux";
		io-channels = <&adc 0>;
		io-channel-names = "parent";

		mux-controls = <&mux>;

		channels = "sync", "in", system-regulator";
	};
```

## Documentation/devicetree/bindings/iio/potentiometer/mcp41xx.txt
```
* Microchip MCP414X/416X/424X/426X Digital Potentiometer driver

The node for this driver must be a child node of a SPI controller, hence
all mandatory properties described in

        Documentation/devicetree/bindings/spi/spi-bus.txt

must be specified.

Required properties:
	- compatible:  	Must be one of the following, depending on the
			model:
			"microchip,mcp4113x-502"
			"microchip,mcp4113x-103"
			"microchip,mcp4113x-503"
			"microchip,mcp4113x-104"
			"microchip,mcp4114x-502"
			"microchip,mcp4114x-103"
			"microchip,mcp4114x-503"
			"microchip,mcp4114x-104"
			"microchip,mcp4115x-502"
			"microchip,mcp4115x-103"
			"microchip,mcp4115x-503"
			"microchip,mcp4115x-104"
			"microchip,mcp4116x-502"
			"microchip,mcp4116x-103"
			"microchip,mcp4116x-503"
			"microchip,mcp4116x-104"
			"microchip,mcp4123x-502"
			"microchip,mcp4123x-103"
			"microchip,mcp4123x-503"
			"microchip,mcp4123x-104"
			"microchip,mcp4124x-502"
			"microchip,mcp4124x-103"
			"microchip,mcp4124x-503"
			"microchip,mcp4124x-104"
			"microchip,mcp4125x-502"
			"microchip,mcp4125x-103"
			"microchip,mcp4125x-503"
			"microchip,mcp4125x-104"
			"microchip,mcp4126x-502"
			"microchip,mcp4126x-103"
			"microchip,mcp4126x-503"
			"microchip,mcp4126x-104"

Example:
mcp41xx: mcp41xx@0 {
	compatible = "mcp416x-502";
	reg = <0>;
	spi-max-frequency = <500000>;
};
```

## Documentation/devicetree/bindings/iio/potentiometer/mcp4531.txt
```
* Microchip MCP453X/454X/455X/456X/463X/464X/465X/466X Digital Potentiometer
  driver

The node for this driver must be a child node of a I2C controller, hence
all mandatory properties for your controller must be specified. See directory:

        Documentation/devicetree/bindings/i2c

for more details.

Required properties:
	- compatible:  	Must be one of the following, depending on the
			model:
			"microchip,mcp4531-502"
			"microchip,mcp4531-103"
			"microchip,mcp4531-503"
			"microchip,mcp4531-104"
			"microchip,mcp4532-502"
			"microchip,mcp4532-103"
			"microchip,mcp4532-503"
			"microchip,mcp4532-104"
			"microchip,mcp4541-502"
			"microchip,mcp4541-103"
			"microchip,mcp4541-503"
			"microchip,mcp4541-104"
			"microchip,mcp4542-502"
			"microchip,mcp4542-103"
			"microchip,mcp4542-503"
			"microchip,mcp4542-104"
			"microchip,mcp4551-502"
			"microchip,mcp4551-103"
			"microchip,mcp4551-503"
			"microchip,mcp4551-104"
			"microchip,mcp4552-502"
			"microchip,mcp4552-103"
			"microchip,mcp4552-503"
			"microchip,mcp4552-104"
			"microchip,mcp4561-502"
			"microchip,mcp4561-103"
			"microchip,mcp4561-503"
			"microchip,mcp4561-104"
			"microchip,mcp4562-502"
			"microchip,mcp4562-103"
			"microchip,mcp4562-503"
			"microchip,mcp4562-104"
			"microchip,mcp4631-502"
			"microchip,mcp4631-103"
			"microchip,mcp4631-503"
			"microchip,mcp4631-104"
			"microchip,mcp4632-502"
			"microchip,mcp4632-103"
			"microchip,mcp4632-503"
			"microchip,mcp4632-104"
			"microchip,mcp4641-502"
			"microchip,mcp4641-103"
			"microchip,mcp4641-503"
			"microchip,mcp4641-104"
			"microchip,mcp4642-502"
			"microchip,mcp4642-103"
			"microchip,mcp4642-503"
			"microchip,mcp4642-104"
			"microchip,mcp4651-502"
			"microchip,mcp4651-103"
			"microchip,mcp4651-503"
			"microchip,mcp4651-104"
			"microchip,mcp4652-502"
			"microchip,mcp4652-103"
			"microchip,mcp4652-503"
			"microchip,mcp4652-104"
			"microchip,mcp4661-502"
			"microchip,mcp4661-103"
			"microchip,mcp4661-503"
			"microchip,mcp4661-104"
			"microchip,mcp4662-502"
			"microchip,mcp4662-103"
			"microchip,mcp4662-503"
			"microchip,mcp4662-104"
	-reg: Slave I2C address of the potentiometer

Example:
mcp4561: mcp4561@2e {
	compatible = "microchip,mcp4561-103";
	reg = <0x2e>;
};
```

## Documentation/devicetree/bindings/iio/pressure/hsc_spi.txt
```
Honeywell HSC Series of Pressure Sensors

Pressure sensors from Honeywell with analog, I2C and SPI interfaces

Required properties:
- compatible: selects the sensor model; must be one of the following
	"honeywell,hsc001baa"
	"honeywell,hsc001bab"
	"honeywell,hsc001bac"
	"honeywell,hsc001baf"
	"honeywell,hsc1_6baa"
	"honeywell,hsc1_6bab"
	"honeywell,hsc1_6bac"
	"honeywell,hsc1_6baf"
	"honeywell,hsc2_5baa"
	"honeywell,hsc2_5bab"
	"honeywell,hsc2_5bac"
	"honeywell,hsc2_5baf"
	"honeywell,hsc004baa"
	"honeywell,hsc004bab"
	"honeywell,hsc004bac"
	"honeywell,hsc004baf"
	"honeywell,hsc006baa"
	"honeywell,hsc006bab"
	"honeywell,hsc006bac"
	"honeywell,hsc006baf"
	"honeywell,hsc010baa"
	"honeywell,hsc010bab"
	"honeywell,hsc010bac"
	"honeywell,hsc010baf"
	"honeywell,hsc100kaa"
	"honeywell,hsc100kab"
	"honeywell,hsc100kac"
	"honeywell,hsc100kaf"
	"honeywell,hsc160kaa"
	"honeywell,hsc160kab"
	"honeywell,hsc160kac"
	"honeywell,hsc160kaf"
	"honeywell,hsc250kaa"
	"honeywell,hsc250kab"
	"honeywell,hsc250kac"
	"honeywell,hsc250kaf"
	"honeywell,hsc400kaa"
	"honeywell,hsc400kab"
	"honeywell,hsc400kac"
	"honeywell,hsc400kaf"
	"honeywell,hsc600kaa"
	"honeywell,hsc600kab"
	"honeywell,hsc600kac"
	"honeywell,hsc600kaf"
	"honeywell,hsc001gaa"
	"honeywell,hsc001gab"
	"honeywell,hsc001gac"
	"honeywell,hsc001gaf"
	"honeywell,hsc015paa"
	"honeywell,hsc015pab"
	"honeywell,hsc015pac"
	"honeywell,hsc015paf"
	"honeywell,hsc030paa"
	"honeywell,hsc030pab"
	"honeywell,hsc030pac"
	"honeywell,hsc030paf"
	"honeywell,hsc060paa"
	"honeywell,hsc060pab"
	"honeywell,hsc060pac"
	"honeywell,hsc060paf"
	"honeywell,hsc100paa"
	"honeywell,hsc100pab"
	"honeywell,hsc100pac"
	"honeywell,hsc100paf"
	"honeywell,hsc150paa"
	"honeywell,hsc150pab"
	"honeywell,hsc150pac"
	"honeywell,hsc150paf"
- reg: the SPI chip select number used by the sensor.
- spi-max-frequency: maximum clock frequency (Hz) used for the SPI bus.
  The maximum value supported by the sensors is 400000.

Example:

	hsc_spi0: hsc@0 {
		compatible = "honeywell,hsc010baa";
		reg = <0>;
		spi-max-frequency = <400000>;
	};
```

## Documentation/devicetree/bindings/iio/proximity/devantech-srf04.txt
```
* Devantech SRF04 ultrasonic range finder
  Bit-banging driver

Required properties:
 - compatible:	Should be "devantech,srf04"
 - trig-gpios:	Definition of the GPIO for the triggering input
 - echo-gpios:	Definition of the GPIO for the echo
		needs to be an interrupt input
		See Documentation/devicetree/bindings/gpio/gpio.txt

Example:
srf04@0 {
	compatible = "devantech,srf04";
	trig-gpios = <&gpio1 15 GPIO_ACTIVE_HIGH>;
	echo-gpios = <&gpio2  6 GPIO_ACTIVE_HIGH>;
};
```

## Documentation/devicetree/bindings/iio/proximity/vl53l0x.txt
```
ST VL53L0X ToF ranging sensor

Required properties:
	- compatible: must be "st,vl53l0x-i2c"
	- reg: i2c address where to find the device

Example:

vl53l0x@29 {
	compatible = "st,vl53l0x-i2c";
	reg = <0x29>;
};
```

## Documentation/devicetree/bindings/iio/timer/stm32-iio-timer.txt
```
timer IIO trigger bindings for STM32

Must be a sub-node of STM32 general purpose timer driver

Required parameters:
- compatible:		must be "st,stm32-iio-timer"
- interrupts:		Interrupt for this device
			See ../interrupt-controller/st,stm32-exti.txt

Optional parameters:
- st,input-triggers-names:	List of the possible input triggers for
				the device
- st,output-triggers-names:	List of the possible output triggers for
				the device

Possible triggers are defined in include/dt-bindings/iio/timer/st,stm32-iio-timer.h

Example:
	gptimer1: gptimer1@40010000 {
		compatible = "st,stm32-gptimer";
		reg = <0x40010000 0x400>;
		clocks = <&rcc 0 160>;
		clock-names = "clk_int";

		pwm1@0 {
			compatible = "st,stm32-pwm";
			st,pwm-num-chan = <4>;
			st,breakinput;
			st,complementary;
		};

		iiotimer1@0 {
			compatible = "st,stm32-iio-timer";
			interrupts = <27>;
			st,input-triggers-names = TIM5_TRGO,
						  TIM2_TRGO,
						  TIM4_TRGO,
						  TIM3_TRGO;
			st,output-triggers-names = TIM1_TRGO;
		};
	};
```

## Documentation/devicetree/bindings/iio/timer/stm32-lptimer-trigger.txt
```
STMicroelectronics STM32 Low Power Timer trigger

STM32 LP Timer provides trigger source (LPTIM output) that can be used
by STM32 internal ADC and/or DAC.

Must be a sub-node of an STM32 LP Timer device tree node.
See ../mfd/stm32-lptimer.txt for details about the parent node.

Required properties:
- compatible: Must be "st,stm32-lptimer-trigger".
- reg: Identify trigger hardware block.

Example:
	lptimer1: lptimer@0x40002400 {
		compatible = "st,stm32-lptimer";
		...
		trigger@0 {
			compatible = "st,stm32-lptimer-trigger";
			reg = <0>;
		};
	};
```

## Documentation/devicetree/bindings/iio/timer/stm32-timer-trigger.txt
```
STMicroelectronics STM32 General Purpose Timer IIO timer bindings

Must be a sub-node of an STM32 General Purpose Timer device tree node.
See ../mfd/stm32-general-purpose-timer.txt for details about the parent node.

Required parameters:
- compatible:	Must be "st,stm32-timer-trigger".
- reg:		Define triggers configuration of the hardware IP.

Example:
	timers@40010000 {
		#address-cells = <1>;
		#size-cells = <0>;
		compatible = "st,stm32-gptimer";
		reg = <0x40010000 0x400>;
		clocks = <&rcc 0 160>;
		clock-names = "clk_int";

		timer@0 {
			compatible = "st,stm32-timer-trigger";
			reg = <0>;
		};
	};
```

## Documentation/devicetree/bindings/iio/trigger/iio-trig-gpio.txt
```
Industrial I/O - GPIO based trigger

GPIOs may be used as IIO trigger provider, when trigger is connected to
GPIO lines.

Required properties:
- compatible: Should be "iio-gpio-trigger"
- gpios: Should specify one GPIO line used as trigger source.
  See Documentation/devicetree/bindings/gpio/gpio.txt
- #io-trigger-cells: Should be 0, as simple trigger provider.
  See Documentation/devicetree/bindings/iio/iio-bindings.txt

Optional properties:
- label: String to specifiy trigger name.
- gpio-trigger-rising-edge: A rising edge on GPIO will trigger.
- gpio-trigger-falling-edge: A falling edge on GPIO will trigger.
  Note: Both rising and falling edge may be used. In case none of
  rising or falling edge is selected, rising edge is selected by
  default.

Example:
	gpiotrig0: iio-gpio-trigger0 {
		#io-trigger-cells = <0>;
		compatible = "iio-gpio-trigger";
		gpios = <&gpioa 11 0>;
	}
```

## Documentation/devicetree/bindings/iio/trigger/iio-trig-interrupt.txt
```
Interrupt based trigger

Any internal or external interrupt may be used as trigger source for
devices like sensors, ADCs... As an example, external signal can be
routed to a GPIO, and turned into an interrupt driven trigger.

Required properties:
- compatible: Should be "interrupt-trigger"
- interrupts: The interrupt used as trigger. Generic interrupt client node as
  described in ../../interrupt-controller/interrupts.txt

Optional properties:
- #io-trigger-cells = <0>; See the IIO bindings, IIO trigger providers
  and consumers sections in ../iio-bindings.txt

Example:
	trig0: interrupt-trigger0 {
		#io-trigger-cells = <0>;
		compatible = "interrupt-trigger";
		interrupts = <11 0>;
		interrupt-parent = <&gpioa>;
	}
```
