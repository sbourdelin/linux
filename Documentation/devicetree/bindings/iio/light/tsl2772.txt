## Documentation/devicetree/bindings/infiniband/hisilicon-hns-roce.txt
```
HiSilicon RoCE DT description

HiSilicon RoCE engine is a part of network subsystem.
It works depending on other part of network wubsytem, such as, gmac and
dsa fabric.

Additional properties are described here:

Required properties:
- compatible: Should contain "hisilicon,hns-roce-v1".
- reg: Physical base address of the roce driver and
length of memory mapped region.
- eth-handle: phandle, specifies a reference to a node
representing a ethernet device.
- dsaf-handle: phandle, specifies a reference to a node
representing a dsaf device.
- #address-cells: must be 2
- #size-cells: must be 2
Optional properties:
- dma-coherent: Present if DMA operations are coherent.
- interrupt-parent: the interrupt parent of this device.
- interrupts: should contain 32 completion event irq,1 async event irq
and 1 event overflow irq.
- interrupt-names:should be one of 34 irqs for roce device
  - roce_ce0_irq ~ roce_ce31_irq: 32 complete event irq
  - roce_ae_irq: 1 async event irq
  - roce_common_irq: named common exception warning irq
Example:
	infiniband@c4000000 {
			compatible = "hisilicon,hns-roce-v1";
			reg = <0x0 0xc4000000 0x0 0x100000>;
			dma-coherent;
			eth-handle = <&eth2 &eth3 &eth4 &eth5 &eth6 &eth7>;
			dsaf-handle = <&soc0_dsa>;
			#address-cells = <2>;
			#size-cells = <2>;
			interrupt-parent = <&mbigen_dsa>;
			interrupts = <722 1>,
					<723 1>,
					<724 1>,
					<725 1>,
					<726 1>,
					<727 1>,
					<728 1>,
					<729 1>,
					<730 1>,
					<731 1>,
					<732 1>,
					<733 1>,
					<734 1>,
					<735 1>,
					<736 1>,
					<737 1>,
					<738 1>,
					<739 1>,
					<740 1>,
					<741 1>,
					<742 1>,
					<743 1>,
					<744 1>,
					<745 1>,
					<746 1>,
					<747 1>,
					<748 1>,
					<749 1>,
					<750 1>,
					<751 1>,
					<752 1>,
					<753 1>,
					<785 1>,
					<754 4>;

			interrupt-names = "roce_ce0_irq",
					"roce_ce1_irq",
					"roce_ce2_irq",
					"roce_ce3_irq",
					"roce_ce4_irq",
					"roce_ce5_irq",
					"roce_ce6_irq",
					"roce_ce7_irq",
					"roce_ce8_irq",
					"roce_ce9_irq",
					"roce_ce10_irq",
					"roce_ce11_irq",
					"roce_ce12_irq",
					"roce_ce13_irq",
					"roce_ce14_irq",
					"roce_ce15_irq",
					"roce_ce16_irq",
					"roce_ce17_irq",
					"roce_ce18_irq",
					"roce_ce19_irq",
					"roce_ce20_irq",
					"roce_ce21_irq",
					"roce_ce22_irq",
					"roce_ce23_irq",
					"roce_ce24_irq",
					"roce_ce25_irq",
					"roce_ce26_irq",
					"roce_ce27_irq",
					"roce_ce28_irq",
					"roce_ce29_irq",
					"roce_ce30_irq",
					"roce_ce31_irq",
					"roce_ae_irq",
					"roce_common_irq";
		};
```

## Documentation/devicetree/bindings/input/adc-keys.txt
```
ADC attached resistor ladder buttons
------------------------------------

Required properties:
 - compatible: "adc-keys"
 - io-channels: Phandle to an ADC channel
 - io-channel-names = "buttons";
 - keyup-threshold-mvolt: Voltage at which all the keys are considered up.

Each key is represented as a sub-node of "adc-keys":

Required subnode-properties:
	- label: Descriptive name of the key.
	- linux,code: Keycode to emit.
	- press-threshold-mvolt: Voltage adc input when this key is pressed.

Example:

#include <dt-bindings/input/input.h>

	adc-keys {
		compatible = "adc-keys";
		io-channels = <&lradc 0>;
		io-channel-names = "buttons";
		keyup-threshold-mvolt = <2000>;

		button@1500 {
			label = "Volume Up";
			linux,code = <KEY_VOLUMEUP>;
			press-threshold-mvolt = <1500>;
		};

		button@1000 {
			label = "Volume Down";
			linux,code = <KEY_VOLUMEDOWN>;
			press-threshold-mvolt = <1000>;
		};

		button@500 {
			label = "Enter";
			linux,code = <KEY_ENTER>;
			press-threshold-mvolt = <500>;
		};
	};
```

## Documentation/devicetree/bindings/input/arizona-haptics.txt
```
Cirrus Logic Arizona class audio SoCs

This document lists haptics bindings for these codecs.
Also see the primary binding document:
  ../mfd/arizona.txt

Optional properties:
  - wlf,hap-act : Single value defining the actuator type, as per the HAP_ACT
    register field. See the codec datasheet for the available HAP_ACT values
    and their meaning.
```

## Documentation/devicetree/bindings/input/cypress,cy8cmbr3102.txt
```
Device tree bindings for Cypress CY8CMBR3102 CapSense Express controller.

The node for this device must be a child of a I2C controller node, as the
device communicates via I2C.

Required properties:

	compatible:	Must be "cypress,cy8cmbr3102".
	reg:		The I2C slave address of the device.
	linux,keycodes:	Specifies an array of numeric keycode values to
			be used for reporting button presses. The array can
			contain up to two entries.

Optional properties:

	autorepeat:	Enables the Linux input system's autorepeat
			feature on the input device.

Example:

	&i2c1 {
		/* ... */

		touchb_tn: cy8cmbr3102@37 {
			compatible = "cypress,cy8cmbr3102";
			reg = <0x37>;
			linux,keycodes = <BTN_0>, <BTN_1>;
			autorepeat;
		};

		/* ... */
	};
```

## Documentation/devicetree/bindings/input/da9062-onkey.txt
```
* Dialog DA9061/62/63 OnKey Module

This module is part of the DA9061/DA9062/DA9063. For more details about entire
DA9062 and DA9061 chips see Documentation/devicetree/bindings/mfd/da9062.txt
For DA9063 see Documentation/devicetree/bindings/mfd/da9063.txt

This module provides the KEY_POWER event.

Required properties:

- compatible: should be one of:
	dlg,da9061-onkey
	dlg,da9062-onkey
	dlg,da9063-onkey

Optional properties:

- dlg,disable-key-power : Disable power-down using a long key-press. If this
    entry exists the OnKey driver will remove support for the KEY_POWER key
    press when triggered using a long press of the OnKey.

Example:

	pmic0: da9063@58 {

		onkey {
			compatible = "dlg,da9063-onkey";
			dlg,disable-key-power;
		};

	};
```

## Documentation/devicetree/bindings/input/dlg,da7280.txt
```
Dialog Semiconductor DA7280 Haptics bindings

Required properties:
- compatible: Should be "dlg,da7280".
- reg: Specifies the I2C slave address.

- interrupt-parent : Specifies the phandle of the interrupt controller to
  which the IRQs from DA7280 are delivered to.

- dlg,vib-mode:
  "LRA-MODE" - Linear Resonance Actuator mode.
  "ERM-BAR" - Bar type Eccentric Rotating Mass mode.
  "ERM-COIN" - Coin type Eccentric Rotating Mass mode.

- dlg,op-mode: Haptic operation mode.
  Possible values:
	1 - Direct register override mode triggered by i2c(default),
	2 - PWM data source mode setting duty to 0 - 0xffff(0% - 100%),
	3 - Register triggered waveform memory mode, the pattern assigned
	    to the PS_SEQ_ID played as much times as PS_SEQ_LOOP,
	4 - Edge triggered waveform memory mode, external GPI(N) condtrol
	    are required to enable/disable and it needs to keep
	    device enabled by sending magnitude (X > 0),
	    the pattern is assigned to the GPI(N)_SEQUENCE_ID below
	    For more details, please see the datasheet.

- dlg,nom-microvolt: Nominal actuator voltage rating.
  Valid values: 0 - 6000000.
- dlg,abs-max-microvolt: Absolute actuator maximum voltage rating.
  Valid values: 0 - 6000000.
- dlg,imax-microamp: Actuator max current rating.
  Valid values: 0 - 252000.
  Default: 130000.
- dlg,impd-micro-ohms: the impedance of the actuator in micro ohm,
  as read from its datasheet.
  Valid values: 0 - 1500000000.

Optional properties:
- pwms : phandle to the physical PWM(Pulse Width Modulation) device.
  PWM properties should be named "pwms". And number of cell is different
  for each pwm device.
  (See Documentation/devicetree/bindings/pwm/pwm.txt
   for further information relating to pwm properties)

- dlg,ps-seq-id: the PS_SEQ_ID(pattern ID in waveform memory inside chip)
  to play back when RTWM-MODE is enabled.
  Valid range: 0 - 15.
- dlg,ps-seq-loop: the PS_SEQ_LOOP, Number of times the pre-stored sequence
  pointed to by PS_SEQ_ID or GPI(N)_SEQUENCE_ID is repeated.
  Valid range: 0 - 15.
- dlg,gpiN-seq-id: the GPI(N)_SEQUENCE_ID, pattern to play
  when gpi0 is triggered, 'N' must be 0 - 2.
  Valid range: 0 - 15.
- dlg,gpiN-mode: the pattern mode which can select either
  "Single-pattern" or "Multi-pattern", 'N' must be 0 - 2.
- dlg,gpiN-polarity: gpiN polarity which can be chosen among
  "Rising-edge", "Falling-edge" and "Both-edge",
  'N' must be 0 - 2
  Haptic will work by this edge option in case of ETWM-MODE.

- dlg,resonant-freq-hz: use in case of LRA-MODE.
  the frequency range: 50 - 300.
  Default: 205.

- dlg,bemf-sens-enable: Enable for internal loop computations.
- dlg,freq-track-enable: Enable for resonant frequency tracking.
- dlg,acc-enable: Enable for active acceleration.
- dlg,rapid-stop-enable: Enable for rapid stop.
- dlg,amp-pid-enable: Enable for the amplitude PID.
- dlg,mem-array: use in case that memory registers should be updated,
  Please fill the whole buffers(100 bytes) to avoid any error in driver.
  For example,
	dlg,mem-array = <
		0x01 0x02 0x03 0x04 0x05 0x06 0x07 0x08 0x09 0x0A
		...
		0x71 0x72 0x73 0x74 0x75 0x76 0x77 0x78 0x79 0x7A
		0x00 0x00 0x00 0x00 0x00 0x00 0x00 0x00 0x00 0x00
		0x00 0x00 0x00 0x00 0x00 0x00 0x00 0x00 0x00 0x00
	>;

For further information, see device datasheet.

======

Example:

	haptics: da7280-haptics@4a {
		compatible = "dlg,da7280";
		reg = <0x4a>;
		interrupt-parent = <&gpio6>;
		interrupts = <11 IRQ_TYPE_LEVEL_LOW>;
		dlg,vib-mode = "LRA-MODE";
		dlg,op-mode = <1>;
		dlg,nom-microvolt = <2000000>;
		dlg,abs-max-microvolt = <2000000>;
		dlg,imax-microamp = <170000>;
		dlg,resonant-freq-hz = <180>;
		dlg,impd-micro-ohms = <10500000>;
		dlg,freq-track-enable;
		dlg,rapid-stop-enable;
	};
```

## Documentation/devicetree/bindings/input/elan_i2c.txt
```
Elantech I2C Touchpad

Required properties:
- compatible: must be "elan,ekth3000".
- reg: I2C address of the chip.
- interrupt-parent: a phandle for the interrupt controller (see interrupt
  binding[0]).
- interrupts: interrupt to which the chip is connected (see interrupt
  binding[0]).

Optional properties:
- wakeup-source: touchpad can be used as a wakeup source.
- pinctrl-names: should be "default" (see pinctrl binding [1]).
- pinctrl-0: a phandle pointing to the pin settings for the device (see
  pinctrl binding [1]).
- vcc-supply: a phandle for the regulator supplying 3.3V power.
- elan,trackpoint: touchpad can support a trackpoint (boolean)
- elan,clickpad: touchpad is a clickpad (the entire surface is a button)
- elan,max_x: the maximum reported value on the X axis
- elan,max_y: the maximum reported value on the Y axis
- elan,min_x: the minimum reported value on the X axis
- elan,min_y: the minimum reported value on the Y axis
- elan,x_res: the resolution of the X axis (in units per mm)
- elan,y_res: the resolution of the Y axis (in units per mm)
- elan,width: max reported width of a blob

[0]: Documentation/devicetree/bindings/interrupt-controller/interrupts.txt
[1]: Documentation/devicetree/bindings/pinctrl/pinctrl-bindings.txt

Example:
	&i2c1 {
		/* ... */

		touchpad@15 {
			compatible = "elan,ekth3000";
			reg = <0x15>;
			interrupt-parent = <&gpio4>;
			interrupts = <0x0 IRQ_TYPE_EDGE_FALLING>;
			wakeup-source;
		};

		/* ... */
	};
```

## Documentation/devicetree/bindings/input/hisilicon,hi6552-powerkey.txt
```
HiSilicon hi6552 PMIC Power Key

PROPERTIES

- compatible:
	Usage: required
	Value type: <string>
	Definition: must be one of:
		    "hisilicon,hi6552-powerkey"

- interrupt-parent
	Usage: (required if interrupt property is defined)
	Value type: <phandle>
	Definition: A single <phandle> value that points to the interrupt
		    parent to which the child domain is being mapped.

- interrupts:
	Usage: required
	Value type: <prop-encoded-array>
	Definition: The first interrupt specifies the key release interrupt
		    and the second interrupt specifies the key press interrupt,
		    the third defines the timed key-hold interrupt.
		    The format of the specifier is defined by the binding
		    document describing the node's interrupt parent.

- interrupt-names:
	Usage: required
	Value type: "down", "up", "hold 4s"
	Definition: String names for the press, release and timed hold
		    interrupts.


EXAMPLE

	powerkey:powerkey@b1{
		compatible = "hisilicon,hi6552-powerkey";
		interrupt-parent = <&pmic>;
		interrupts = <6 0>, <5 0>, <4 0>;
		interrupt-names = "down", "up", "hold 4s";
	};
```

## Documentation/devicetree/bindings/input/max77650-onkey.txt
```
Onkey driver for MAX77650 PMIC from Maxim Integrated.

This module is part of the MAX77650 MFD device. For more details
see Documentation/devicetree/bindings/mfd/max77650.txt.

The onkey controller is represented as a sub-node of the PMIC node on
the device tree.

Required properties:
--------------------
- compatible:		Must be "maxim,max77650-onkey".

Optional properties:
- linux,code:		The key-code to be reported when the key is pressed.
			Defaults to KEY_POWER.
- maxim,onkey-mode:	Must be "push" or "slide" depending on the type of
			button used by the system. Defaults to "push".

Example:
--------

	onkey {
		compatible = "maxim,max77650-onkey";
		linux,code = <KEY_END>;
		maxim,onkey-mode = "slide";
	};
```

## Documentation/devicetree/bindings/input/mtk-pmic-keys.txt
```
MediaTek MT6397/MT6323 PMIC Keys Device Driver

There are two key functions provided by MT6397/MT6323 PMIC, pwrkey
and homekey. The key functions are defined as the subnode of the function
node provided by MT6397/MT6323 PMIC that is being defined as one kind
of Muti-Function Device (MFD)

For MT6397/MT6323 MFD bindings see:
Documentation/devicetree/bindings/mfd/mt6397.txt

Required properties:
- compatible: "mediatek,mt6397-keys" or "mediatek,mt6323-keys"
- linux,keycodes: Specifies the numeric keycode values to
	be used for reporting keys presses. The array can
	contain up to 2 entries.

Optional Properties:
- mediatek,wakeup-keys: Specifies each key can be used as a wakeup source
	or not. This can be customized depends on board design.
- wakeup-source: PMIC keys can be used as wakeup sources.
- mediatek,long-press-mode: Long press key shutdown setting, 1 for
	pwrkey only, 2 for pwrkey/homekey together, others for disabled.
- debounce-interval: Long press key shutdown debouncing interval time
	in seconds. 0/1/2/3 for 8/11/14/5 seconds. If not specified defaults to 0.

Example:

	pmic: mt6397 {
		compatible = "mediatek,mt6397";

		...

		mt6397keys: mt6397keys {
			compatible = "mediatek,mt6397-keys";
			linux,keycodes = <116>, <114>;
			mediatek,wakeup-keys = <1>, <0>;
			wakeup-source;
			mediatek,long-press-mode = <1>;
			debounce-interval = <0>;
		};
	};
```

## Documentation/devicetree/bindings/input/pwm-beeper.txt
```
* PWM beeper device tree bindings

Registers a PWM device as beeper.

Required properties:
- compatible: should be "pwm-beeper"
- pwms: phandle to the physical PWM device

Optional properties:
- volume-levels: Array of PWM duty cycle values that correspond to
      linear volume levels. These need to be in the range of 0 to 500,
      while 0 means 0% duty cycle (mute) and 500 means 50% duty cycle
      (max volume).
      Please note that the actual volume of most beepers is highly
      non-linear, which means that low volume levels are probably somewhere
      in the range of 1 to 30 (0.1-3% duty cycle).
- default-volume-level: the default volume level (index into the
      array defined by the "volume-levels" property)

Example:

	pwm-beeper {
		compatible = "pwm-beeper";
		pwms = <&pwm4 0 5000>;
		volume-levels = <0 8 20 40 500>;
		default-volume-level = <4>;
	};
```
