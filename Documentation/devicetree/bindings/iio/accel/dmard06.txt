## Documentation/devicetree/bindings/iio/adc/xilinx-ams.txt
~~~~
Xilinx AMS controller
`````````````````````
The AMS includes an ADC as well as on-chip sensors that can be used to
sample external voltages and monitor on-die operating conditions, such as
temperature and supply voltage levels.
The AMS has two SYSMON blocks which are PL (Programmable Logic) SYSMON and
PS (Processing System) SYSMON.
All designs should have AMS registers, but PS and PL are optional. The
AMS controller can work with only PS, only PL and both PS and PL
configurations. Please specify registers according to your design. Devicetree
should always have AMS module property. Providing PS & PL module is optional.

Required properties:
	- compatible: Should be "xlnx,zynqmp-ams"
	- reg: Should specify AMS register space
	- interrupts: Interrupt number for the AMS control interface
	- interrupt-names: Interrupt name, must be "ams-irq"
	- clocks: Should contain a clock specifier for the device
	- ranges: keep the property empty to map child address space
	          (for PS and/or PL) nodes 1:1 onto the parent address
	          space

	AMS sub-nodes:
		- ams_ps : Used as PS-SYSMON node
		- ams_pl : Used as PL-SYSMON node



AMS PS-SYSMON
`````````````
PS (Processing System) SYSMON is memory mapped to PS. This block has built-in
alarm generation logic that is used to interrupt the processor based on
condition set.

Required properties:
	- compatible: Should be "xlnx,zynqmp-ams-ps"
	- reg: Register space for PS-SYSMON



AMS PL-SYSMON
`````````````
PL-SYSMON is capable of monitoring off chip voltage and temperature. PL-SYSMON
block has DRP, JTAG and I2C interface to enable monitoring from external master.
Out of this interface currently only DRP is supported. This block has alarm
generation logic that is used to interrupt the processor based on condition set.

Required properties:
	- compatible: Should be "xlnx,zynqmp-ams-pl"
	- reg: Register space for PL-SYSMON

PL-SYSMON optional sub-nodes:
	- xlnx,ext-channels: List of external channels that are connected to the
	                     AMS PL module.

	  The child nodes of PL-SYSMON represent the external channels which are
	  connected to this Module. If the property is not present
	  no external channels will be assumed to be connected.

	  Each child node represents one channel and has the following
	  properties:

	Required properties:
		* reg: Pair of pins the channel is connected to.

		    'reg' value		Channel Name		Channel Number
		    -----------		------------		--------------
			 0		VP/VN			      30
			 1		VUSER0			      31
			 2		VUSER1			      32
			 3		VUSER3			      33
			 4		VUSER4			      34
			 5		VAUXP[0]/VAUXN[0]	      35
			 6		VAUXP[1]/VAUXN[1]	      36
			...
			20		VAUXP[15]/VAUXN[15]	      50

		Each channel number should only be used at most once. For
		more details on channels, refer to the table given at the end.

	Optional properties:
		* xlnx,bipolar: If set the channel is used in bipolar
		  mode.


Example:
	xilinx_ams: ams@ffa50000 {
		compatible = "xlnx,zynqmp-ams";
		interrupt-parent = <&gic>;
		interrupts = <0 56 4>;
		interrupt-names = "ams-irq";
		reg = <0x0 0xffa50000 0x0 0x800>;
		reg-names = "ams-base";
		#address-cells = <1>;
		#size-cells = <1>;
		#io-channel-cells = <1>;
		ranges = <0 0 0xffa50800 0x400
			  1 0 0xffa50c00 0x400>;

		ams_ps: ams_ps@0,0 {
			compatible = "xlnx,zynqmp-ams-ps";
			reg = <0 0x400>;
		};

		ams_pl: ams_pl@1,0 {
			compatible = "xlnx,zynqmp-ams-pl";
			reg = <0 0x400>;
			xlnx,ext-channels {
				channel@0 {
					reg = <0>;
					xlnx,bipolar;
				};
				channel@1 {
					reg = <1>;
				};
				channel@8 {
					reg = <8>;
					xlnx,bipolar;
				};
			};
		};
	};


AMS Channel Details
```````````````````
Sysmon Block	|Channel|			Details					|Measurement
		|Number	|							 	|Type
---------------------------------------------------------------------------------------------------------
AMS CTRL	|0	|System PLLs voltage measurement, VCC_PSPLL.			|Voltage
		|1	|Battery voltage measurement, VCC_PSBATT.			|Voltage
		|2	|PL Internal voltage measurement, VCCINT.			|Voltage
		|3	|Block RAM voltage measurement, VCCBRAM.			|Voltage
		|4	|PL Aux voltage measurement, VCCAUX.				|Voltage
		|5	|Voltage measurement for six DDR I/O PLLs, VCC_PSDDR_PLL.	|Voltage
		|6	|VCC_PSINTFP_DDR voltage measurement.				|Voltage
---------------------------------------------------------------------------------------------------------
PS Sysmon	|7	|LPD temperature measurement.					|Temperature
		|8	|FPD temperature measurement (REMOTE).				|Temperature
		|9	|VCC PS LPD voltage measurement (supply1).			|Voltage
		|10	|VCC PS FPD voltage measurement (supply2).			|Voltage
		|11	|PS Aux voltage reference (supply3).				|Voltage
		|12	|DDR I/O VCC voltage measurement.				|Voltage
		|13	|PS IO Bank 503 voltage measurement (supply5).			|Voltage
		|14	|PS IO Bank 500 voltage measurement (supply6).			|Voltage
		|15	|VCCO_PSIO1 voltage measurement.				|Voltage
		|16	|VCCO_PSIO2 voltage measurement.				|Voltage
		|17	|VCC_PS_GTR voltage measurement (VPS_MGTRAVCC).			|Voltage
		|18	|VTT_PS_GTR voltage measurement (VPS_MGTRAVTT).			|Voltage
		|19	|VCC_PSADC voltage measurement.					|Voltage
---------------------------------------------------------------------------------------------------------
PL Sysmon	|20	|PL temperature measurement.					|Temperature
		|21	|PL Internal voltage measurement, VCCINT.			|Voltage
		|22	|PL Auxiliary voltage measurement, VCCAUX.			|Voltage
		|23	|ADC Reference P+ voltage measurement.				|Voltage
		|24	|ADC Reference N- voltage measurement.				|Voltage
		|25	|PL Block RAM voltage measurement, VCCBRAM.			|Voltage
		|26	|LPD Internal voltage measurement, VCC_PSINTLP (supply4).	|Voltage
		|27	|FPD Internal voltage measurement, VCC_PSINTFP (supply5).	|Voltage
		|28	|PS Auxiliary voltage measurement (supply6).			|Voltage
		|29	|PL VCCADC voltage measurement (vccams).			|Voltage
		|30	|Differential analog input signal voltage measurment.		|Voltage
		|31	|VUser0 voltage measurement (supply7).				|Voltage
		|32	|VUser1 voltage measurement (supply8).				|Voltage
		|33	|VUser2 voltage measurement (supply9).				|Voltage
		|34	|VUser3 voltage measurement (supply10).				|Voltage
		|35	|Auxiliary ch 0 voltage measurement (VAux0).			|Voltage
		|36	|Auxiliary ch 1 voltage measurement (VAux1).			|Voltage
		|37	|Auxiliary ch 2 voltage measurement (VAux2).			|Voltage
		|38	|Auxiliary ch 3 voltage measurement (VAux3).			|Voltage
		|39	|Auxiliary ch 4 voltage measurement (VAux4).			|Voltage
		|40	|Auxiliary ch 5 voltage measurement (VAux5).			|Voltage
		|41	|Auxiliary ch 6 voltage measurement (VAux6).			|Voltage
		|42	|Auxiliary ch 7 voltage measurement (VAux7).			|Voltage
		|43	|Auxiliary ch 8 voltage measurement (VAux8).			|Voltage
		|44	|Auxiliary ch 9 voltage measurement (VAux9).			|Voltage
		|45	|Auxiliary ch 10 voltage measurement (VAux10).			|Voltage
		|46	|Auxiliary ch 11 voltage measurement (VAux11).			|Voltage
		|47	|Auxiliary ch 12 voltage measurement (VAux12).			|Voltage
		|48	|Auxiliary ch 13 voltage measurement (VAux13).			|Voltage
		|49	|Auxiliary ch 14 voltage measurement (VAux14).			|Voltage
		|50	|Auxiliary ch 15 voltage measurement (VAux15).			|Voltage
---------------------------------------------------------------------------------------------------------
~~~~

## Documentation/devicetree/bindings/iio/chemical/bme680.txt
```
Bosch Sensortec BME680 pressure/temperature/humidity/voc sensors

Required properties:
- compatible: must be "bosch,bme680"

Example:

bme680@77 {
          compatible = "bosch,bme680";
          reg = <0x77>;
};
```

## Documentation/devicetree/bindings/iio/chemical/dsm501.txt
```
* DSM501 particle sensor

Required properties:

- compatible: should be one of:
	      "samyoung,dsm501"
	      "shinyei,ppd42ns"
- gpios: should specify the GPIO connected to the sensor's data line, see
  	 "gpios property" in Documentation/devicetree/bindings/gpio/gpio.txt

Example:

dsm501 {
	compatible = "samyoung,dsm501";
	gpios = <&gpio1 28 0>;
};
```

## Documentation/devicetree/bindings/iio/counter/stm32-lptimer-cnt.txt
```
STMicroelectronics STM32 Low Power Timer quadrature encoder and counter

STM32 LP Timer provides several counter modes. It can be used as:
- quadrature encoder to detect angular position and direction of rotary
  elements, from IN1 and IN2 input signals.
- simple counter from IN1 input signal.

Must be a sub-node of an STM32 LP Timer device tree node.
See ../mfd/stm32-lptimer.txt for details about the parent node.

Required properties:
- compatible: Must be "st,stm32-lptimer-counter".
- A pinctrl state named "default" can be defined to set IN1/IN2 pins in mode
  of operation for LP Timer input signals on external pin.

Example:
	lptimer1: lptimer@0x40002400 {
		compatible = "st,stm32-lptimer";
		...
		counter {
			compatible = "st,stm32-lptimer-counter";
			pinctrl-names = "default";
			pinctrl-0 = <&lptim1_in_pins>;
		};
	};
```

## Documentation/devicetree/bindings/iio/dac/ad5592r.txt
```
Analog Devices AD5592R/AD5593R DAC/ADC device driver

Required properties for the AD5592R:
	- compatible: Must be "adi,ad5592r"
	- reg: SPI chip select number for the device
	- spi-max-frequency: Max SPI frequency to use (< 30000000)
	- spi-cpol: The AD5592R requires inverse clock polarity (CPOL) mode

Required properties for the AD5593R:
	- compatible: Must be "adi,ad5593r"
	- reg: I2C address of the device

Required properties for all supported chips:
	- channel-modes: An array of eight 8-bit values (one per channel)
	  describing the mode of each channel. Macros specifying the valid values
	  can be found in <dt-bindings/iio/adi,ad5592r.h>.
	  The following values are currently supported:
		* CH_MODE_UNUSED (the pin is pulled down)
		* CH_MODE_DAC
		* CH_MODE_ADC
		* CH_MODE_GPIO_TRISTATE

Example:

	#include <dt-bindings/iio/adi,ad5592r.h>

	ad5592r@0 {
		compatible = "adi,ad5592r";
		reg = <0>;
		spi-max-frequency = <1000000>;
		spi-cpol;

		channel-modes = /bits/ 8 <
			CH_MODE_DAC
			CH_MODE_ADC
			CH_MODE_ADC
			CH_MODE_UNUSED
			CH_MODE_UNUSED
			CH_MODE_UNUSED
			CH_MODE_UNUSED
			CH_MODE_UNUSED
		>;
	};
```

## Documentation/devicetree/bindings/iio/dac/ds4424.txt
```
Maxim Integrated DS4422/DS4424 7-bit Sink/Source Current DAC Device Driver

Datasheet publicly available at:
https://datasheets.maximintegrated.com/en/ds/DS4422-DS4424.pdf

Required properties:
	- compatible: Must be "maxim,ds4422" or "maxim,ds4424"
	- reg: Should contain the DAC I2C address
	- maxim,rfs-resistors-ohms: Should contain reference resistor

Optional properties:
	- vcc-supply: Power supply is optional. If not defined, driver will ignore it.

Example:
	ds4224@10 {
		compatible = "maxim,ds4424";
		reg = <0x10>; /* When A0, A1 pins are ground */
		vcc-supply = "dac_vcc_3v3";
		maxim,rfs-resistors-ohms = <400 800 1000 1600>;
	};
```

## Documentation/devicetree/bindings/iio/dac/ti-lmp92001-dac.txt
```
* Texas Instruments' LMP92001 DACs

Required properties:
 - compatible: Must be set to "ti,lmp92001-dac".
 - reg: i2c chip address for the device.
 - ti,lmp92001-dac-hiz: hi-impedance control,
        1 = Forces all OUT[1:12] outputs to hi-z, 0 = normal
 - ti,lmp92001-dac-outx:
        Cy = 0, 1 = will force associated OUTx outputs to VDD
        Cy = 0, 0 = will force associated OUTx outputs to GND
 - ti,lmp92001-dac-gang: What group of Cy is governed to.
        -----------------------------------------
        |  Cy   | CDAC:GANG = 0 | CDAC:GANG = 1 |
        -----------------------------------------
        |  C1   |   OUT[1:4]    |    OUT[1:3]   |
        -----------------------------------------
        |  C2   |   OUT[5:6]    |    OUT[4:6]   |
        -----------------------------------------
        |  C3   |   OUT[7:8]    |    OUT[7:9]   |
        -----------------------------------------
        |  C4   |   OUT[9:12]   |    OUT[10:12] |
        -----------------------------------------

Example:
lmp92001@20 {
        compatible = "ti,lmp92001";
        reg = <0x20>;

        lmp92001-dac {
                compatible = "ti,lmp92001-dac";
                ti,lmp92001-dac-hiz  = /bits/ 8 <0>;
                ti,lmp92001-dac-outx = /bits/ 8 <0>;
                ti,lmp92001-dac-gang = /bits/ 8 <0>;
        };
};
```

## Documentation/devicetree/bindings/iio/gyroscope/fsl,fxas21002c.txt
```
* Freescale FXAS21002C Digital Angular Rate Gyroscope

Required properties:

  - compatible: must be "fsl,fxas21002c"
  - reg : the I2C address of the sensor

Optional properties:

  - interrupt-parent	: phandle to the parent interrupt controller.
			  see interrupt-controller/interrupts.txt
  - interrupts		: The first interrupt listed must be the one
			  connected to the INT1 pin, the second interrupt
			  listed must be the one connected to the INT2 pin.
			  The interrupts can be triggered on rising or falling
			  edges alike.
			  see interrupt-controller/interrupts.txt
  - vdd-supply 		: The main voltage regulator
  - iovdd-supply 	: The IO voltage regulator
			  see regulator/regulator.txt
  - reset-gpios		: GPIO used to reset the device.
			  see gpio/gpio.txt.
  - mount-matrix	: see iio/mount-matrix.txt

Example:
gyroscope@20 {
	compatible = "fsl,fxas21002c";
	reg = <0x20>;
	reset-gpios = <&gpio0 2 0>;
	vdd-supply = <&vref>;
	iovdd-supply = <&vref2>;
	interrupt-parent = <&foo>;
	interrupts = <0 IRQ_TYPE_EDGE_RISING>,
		     <1 (IRQ_TYPE_EDGE_RISING | IRQ_TYPE_EDGE_FALLING)>;
};
```

## Documentation/devicetree/bindings/iio/humidity/hdc100x.txt
```
* HDC100x temperature + humidity sensors

Required properties:
  - compatible: Should contain one of the following:
	ti,hdc100x
	ti,hdc1010
	ti,hdc1050
	ti,hdc1080
  - reg: i2c address of the sensor

Example:

hdc100x@40 {
	compatible = "ti,hdc100x";
	reg = <0x40>;
};
```

## Documentation/devicetree/bindings/iio/impedance-analyzer/ad5933.txt
```
Analog Devices AD5933/AD5934 Impedance Converter, Network Analyzer

https://www.analog.com/media/en/technical-documentation/data-sheets/AD5933.pdf
https://www.analog.com/media/en/technical-documentation/data-sheets/AD5934.pdf

Required properties:
 - compatible : should be one of
		"adi,ad5933"
		"adi,ad5934"
 - reg : the I2C address
 - vdd-supply : supply reference for the device.

Optional properties:
 - vref_mv : default voltage reference.
 - ext_clk_hz : external master clock for the system.

Example:

	impedance-analyzer@0d {
		compatible = "adi,ad5933";
		reg = <0x0d>;
		vdd-supply = <&vdd_supply>;
	};
```
