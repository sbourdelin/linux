## Documentation/devicetree/bindings/iio/imu/inv_mpu6050.txt
```
InvenSense MPU-6050 Six-Axis (Gyro + Accelerometer) MEMS MotionTracking Device

Required properties:
 - compatible : should be "invensense,mpuXXXX"
 - reg : the I2C or SPI address of the sensor
 - interrupt-parent : should be the phandle for the interrupt controller
 - interrupts : interrupt mapping for GPIO IRQ

Valid compatible strings:
 - mpu6000
 - mpu6050
 - mpu6500
 - mpu9150

It is possible to attach auxiliary sensors to the MPU and have them be handled
by linux. Those auxiliary sensors are describes as an i2c bus.

Devices connected in "bypass" mode must be listed behind i2c@0 with the address 0

Devices connected in "master" mode must be listed behind i2c-aux-master.

Example:
	mpu6050@68 {
		compatible = "invensense,mpu6050";
		reg = <0x68>;
		interrupt-parent = <&gpio1>;
		interrupts = <18 1>;
	};

Example describing mpu9150 (which includes an ak9875 on chip):
	mpu9150@68 {
		compatible = "invensense,mpu9150";
		reg = <0x68>;
		interrupt-parent = <&gpio1>;
		interrupts = <18 1>;

		#address-cells = <1>;
		#size-cells = <0>;
		i2c@0 {
			reg = <0>;
			#address-cells = <1>;
			#size-cells = <0>;

			ak8975@0c {
				compatible = "ak,ak8975";
				reg = <0x0c>;
			};
		};
	};

Example describing a mpu6500 via SPI with an hmc5883l on auxiliary i2c:
	mpu6500@0 {
		compatible = "inv,mpu6500";
		reg = <0x0>;
		spi-max-frequency = <1000000>;
		interrupt-parent = <&gpio1>;
		interrupts = <31 1>;

		i2c-aux-master {
			#address-cells = <1>;
			#size-cells = <0>;

			hmc5883l@1e {
				compatible = "honeywell,hmc5883l";
				reg = <0x1e>;
			};
		};
	};
```

## Documentation/devicetree/bindings/iio/light/cm36672.txt
```
* Vishay Capella CM36672 I2C Proximity sensor

Required properties:
- compatible: must be capella,cm36672"
- reg: the I2C slave address, usually 0x60
- interrupts: interrupt mapping for GPIO IRQ

Optional properties:
- interrupt-parent: interrupt controller
- interrupts: interrupt mapping for GPIO IRQ
- cm36672,prx_led_current: LED current, must be one of the following values:
    - 0: 50mA
    - 1: 75mA
    - 2: 100mA
    - 3: 120mA
    - 4: 140mA
    - 5: 160mA
    - 6: 180mA
    - 7: 200mA
- cm36672,prx_hd: width of proximity sensor output data, must be one of the
  following values:
    - 0: 12-bit
    - 1: 16-bit

Example:

    cm36672@60 {
        compatible = "capella,cm36672";
        reg = <0x60>;
        interrupt-parent = <&gpio0>;
        interrupts = <30 0>;

        /* cm36672-specific properties */
        cm36672,prx_led_current = <2>;
        cm36672,prx_hd = <1>;
    };
```

## Documentation/devicetree/bindings/iio/light/isl29018.txt
```
* ISL 29018/29023/29035 I2C ALS, Proximity, and Infrared sensor

Required properties:

  - compatible: Should be one of
		"isil,isl29018"
		"isil,isl29023"
		"isil,isl29035"
  - reg: the I2C address of the device

Optional properties:

  - interrupts: the sole interrupt generated by the device

  Refer to interrupt-controller/interrupts.txt for generic interrupt client
  node bindings.

  - vdd-supply: phandle to the regulator that provides vdd power to the sensor.

  - vdda-supply: phandle to the regulator that provides vdda power to the sensor.

Example:

isl29018@44 {
	compatible = "isil,isl29018";
	reg = <0x44>;
	interrupt-parent = <&gpio>;
	interrupts = <TEGRA_GPIO(Z, 2) IRQ_TYPE_LEVEL_HIGH>;
};
```

## Documentation/devicetree/bindings/iio/light/isl29033.txt
```
Intersil ISL29033 Ultra-Low Lux, Low Power, Integrated Digital Ambient Light Sensor

Required properties:
  - compatible : Must be "isil,isl29033".
  - reg: the I2C address of the device

Optional properties:
  - isil,rext-kohms: External resistor nominal in kOhms used for ADC
    reference. If not specified, 499 kOhm value will be used.

Example:

        als_sensor@44 {
            compatible = "isil,isl29033";
            reg = <0x44>;
            isil,rext-kohms = <1000>;
        };
```

## Documentation/devicetree/bindings/iio/light/stk3310.txt
```
* Sensortek STK331X I2C Light&Proximity sensor

Required properties:
- compatible: should be "sensortek,STK3310" or "sensortek,STK3311"
- reg: the I2C address of the device
- interrupt-parent: phandle to the parent interrupt controller
- interrupts: interrupt mapping for GPIO IRQ

Example:
	&i2c1 {
		/* ... */

		stk3310@48 {
			compatible = "sensortek,STK3310";
			reg = <0x48>;
			interrupt-parent = <&gpio1>;
			interrupts = <5 IRQ_TYPE_LEVEL_LOW>;
		};

		/* ... */
	};
```
