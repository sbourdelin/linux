## Documentation/devicetree/bindings/iio/accel/dmard06.txt
```
Device tree bindings for Domintech DMARD06 acceletometer

Required properties:
 - compatible		: Should be "domintech,dmard06"
 - reg			: I2C address of the chip. Should be 0x1c

Example:
	&i2c1 {
		/* ... */

		accelerometer@1c {
			compatible = "domintech,dmard06";
			reg = <0x1c>;
		};

		/* ... */
	};
```

## Documentation/devicetree/bindings/iio/adc/adi,ad7606.txt
```
Analog Devices AD7606 Simultaneous Sampling ADC

Required properties for the AD7606:

 - compatible: Must be one of "adi,ad7605-4", "adi,ad7606-8", "adi,ad7606-6" or
 	       "adi,ad7606-4".
 - reg: SPI chip select number for the device
 - spi-max-frequency: Max SPI frequency to use
 	see: Documentation/devicetree/bindings/spi/spi-bus.txt
 - spi-cpha: See Documentation/devicetree/bindings/spi/spi-bus.txt
 - avcc-supply: phandle to the Avcc power supply
 - interrupts: IRQ line for the ADC
 	see: Documentation/devicetree/bindings/interrupt-controller/interrupts.txt
 - conversion-start-gpio: must be the device tree identifier of the CONVST pin.
			  This logic input is used to initiate conversions on
			  the analog input channels.

Optional properties:

 - reset-gpio: must be the device tree identifier of the RESET pin. If specified,
 	       it will be asserted during driver probe.
 - first-data-gpio: must be the device tree identifier of the FRSTDATA pin.
 		    The FRSTDATA output indicates when the first channel, V1, is
		    being read back on either the parallel, byte or serial interface.
- standby-gpio: must be the device tree identifier of the STBY pin. This pin is used
		to place the AD7606 into one of two power-down modes, Standby mode or
		Shutdown mode.
- range-gpio: must be the device tree identifier of the RANGE pin. The polarity on
	      this pin determines the input range of the analog input channels. If
	      this pin is tied to a logic high, the analog input range is ±10V for
	      allchannels. If this pin is tied to a logic low, the analog input range
	      is ±5V for all channels.

Example:

	adc@0 {
		compatible = "adi,ad7606-8";
		reg = <0>;
		spi-max-frequency = <1000000>;
		spi-cpol;

		avcc-supply = <&adc_vref>;

		interrupts = <25 IRQ_TYPE_EDGE_FALLING>;
		interrupt-parent = <&gpio>;

		conversion-start-gpio = <&gpio 17 0>;
		reset-gpio = <&gpio 27 0>;
		first-data-gpio = <&gpio 22 0>;
		standby-gpio = <&gpio 24 0>;
	};
```

## Documentation/devicetree/bindings/iio/adc/at91-sama5d2_adc.txt
```
* AT91 SAMA5D2 Analog to Digital Converter (ADC)

Required properties:
  - compatible: Should be "atmel,sama5d2-adc".
  - reg: Should contain ADC registers location and length.
  - interrupts: Should contain the IRQ line for the ADC.
  - clocks: phandle to device clock.
  - clock-names: Must be "adc_clk".
  - vref-supply: Supply used as reference for conversions.
  - vddana-supply: Supply for the adc device.
  - atmel,min-sample-rate-hz: Minimum sampling rate, it depends on SoC.
  - atmel,max-sample-rate-hz: Maximum sampling rate, it depends on SoC.
  - atmel,startup-time-ms: Startup time expressed in ms, it depends on SoC.
  - atmel,trigger-edge-type: phandle to one of the adtrg possible edge types

Required adtrg node:
  - Required edge nodes:
	For each possible edge type for the ADTRG hardware trigger pin,
	 a specific sub node. The driver recognises only the three possible
	 edge types: external_rising, external_falling, external_any.

Example:

adc: adc@fc030000 {
	compatible = "atmel,sama5d2-adc";
	reg = <0xfc030000 0x100>;
	interrupts = <40 IRQ_TYPE_LEVEL_HIGH 7>;
	clocks = <&adc_clk>;
	clock-names = "adc_clk";
	atmel,min-sample-rate-hz = <200000>;
	atmel,max-sample-rate-hz = <20000000>;
	atmel,startup-time-ms = <4>;
	vddana-supply = <&vdd_3v3_lp_reg>;
	vref-supply = <&vdd_3v3_lp_reg>;
	atmel,trigger-edge-type = <&external_rising>;

	adtrg: adtrg {
		external_rising: external_rising {
		};
		external_falling: external_falling {
		};
		external_any: external_any {
		};
	};
}
```

## Documentation/devicetree/bindings/iio/adc/avia-hx711.txt
```
* AVIA HX711 ADC chip for weight cells
  Bit-banging driver

Required properties:
 - compatible:	Should be "avia,hx711"
 - sck-gpios:	Definition of the GPIO for the clock
 - dout-gpios:	Definition of the GPIO for data-out
		See Documentation/devicetree/bindings/gpio/gpio.txt
 - avdd-supply:	Definition of the regulator used as analog supply

Optional properties:
 - clock-frequency:	Frequency of PD_SCK
			This setting affects the duration of the high value
			phase of the clock (PD_SCK). The low value phase is
			not affected since it is not relevant for the
			measurement.
			Minimum value allowed is 20 kHz because of maximum
			high time of 50 microseconds.

Example:
weight@0 {
	compatible = "avia,hx711";
	sck-gpios = <&gpio3 10 GPIO_ACTIVE_HIGH>;
	dout-gpios = <&gpio0 7 GPIO_ACTIVE_HIGH>;
	avdd-suppy = <&avdd>;
	clock-frequency = <100000>;
};
```

## Documentation/devicetree/bindings/iio/adc/envelope-detector.txt
```
Bindings for ADC envelope detector using a DAC and a comparator

The DAC is used to find the peak level of an alternating voltage input
signal by a binary search using the output of a comparator wired to
an interrupt pin. Like so:
                          _
                         | \
    input +------>-------|+ \
                         |   \
           .-------.     |    }---.
           |       |     |   /    |
           |    dac|-->--|- /     |
           |       |     |_/      |
           |       |              |
           |       |              |
           |    irq|------<-------'
           |       |
           '-------'

Required properties:
- compatible: Should be "envelope-detector"
- io-channels: Channel node of the dac to be used for comparator input.
- io-channel-names: Should be "dac".
- interrupt specification for one client interrupt,
  see ../../interrupt-controller/interrupts.txt for details.
- interrupt-names: Should be "comp".
- envelope-detector,dac-max: The maximum raw input value for the dac.
- envelope-detector,comp-interval-ms: How long to wait for the comparator
  to trigger before moving on to another DAC level. This interval needs to
  relate to the lowest possible frequency of the above input signal.

Optional properties:
- envelope-detector,inverted: If the input signal is centered around the
  dac-max voltage (instead of zero), this property causes the detector to
  search for the lowest DAC value that does not triggers the comparator
  (instead of the highest). The result is also inverted so that a lower DAC
  reading yields a higher voltage value.


Example:

	&spi {
		dac: ad7303@4 {
			compatible = "adi,ad7303";
			reg = <4>;
			spi-max-frequency = <10000000>;
			Vdd-supply = <&vdd_supply>;
			adi,use-external-reference;
			REF-supply = <&vref_supply>;
			#io-channel-cells = <1>;
		};
	};

	envelope-detector {
		compatible = "envelope-detector";
		io-channels = <&dac 0>;
		io-channel-names = "dac";

		interrupt-parent = <&gpio>;
		interrupts = <3 IRQ_TYPE_EDGE_FALLING>;
		interrupt-names = "comp";

		envelope-detector,dac-max = <255>;
		envelope-detector,comp-interval-ms = <50>;
	};
```

## Documentation/devicetree/bindings/iio/adc/hibvt-lsadc.txt
```
Hisilicon BVT Low Speed (LS) A/D Converter bindings

Required properties:
- compatible: should be "hisilicon,<name>-lsadc"
   - "hisilicon,hi3516cv300-lsadc": for hi3516cv300

- reg: physical base address of the controller and length of memory mapped 
	   region.
- interrupts: The interrupt number for the ADC device. 

Optional properties:
- resets: Must contain an entry for each entry in reset-names if need support
		  this option. See ../../reset/reset.txt for details.
- reset-names: Must include the name "lsadc-crg".

Example:
	adc: adc@120e0000 {
			compatible = "hisilicon,hi3516cv300-lsadc";
			reg = <0x120e0000 0x1000>;
			interrupts = <19>;
			resets = <&crg 0x7c 3>;
			reset-names = "lsadc-crg";
	};
```

## Documentation/devicetree/bindings/iio/adc/mcp3911.txt
```
* Microchip MCP3911 Dual channel analog front end (ADC)

Required properties:
 - compatible: Should be "microchip,mcp3911"
 - reg: SPI chip select number for the device

Recommended properties:
 - spi-max-frequency: Definition as per
	 Documentation/devicetree/bindings/spi/spi-bus.txt.
	 Max frequency for this chip is 20MHz.

Optional properties:
 - device-addr: Device address when multiple MCP3911 chips are present on the
	same SPI bus. Valid values are 0-3. Defaults to 0.
 - external-clock: Use external clock instead of crystal oscillator.
 - external-vref: Use external voltage reference
 - vref-supply:	Phandle to the external reference voltage supply. (only valid in combination with `external-vref`)
 - ch0-width: width for channel0. Valid widths are 16 and 24bits.
 - ch1-width: width for channel1. Valid widths are 16 and 24bits.


Example:
adc@0 {
	compatible = "microchip,mcp3911";
	reg = <0>;
	spi-max-frequency = <20000000>;
	device-addr = <0>;
	ch0-width = <16>;
	ch1-width = <24>;
	external-clock;
	external-vref;
	vref-supply = <&vref_reg>;
};
```

## Documentation/devicetree/bindings/iio/adc/simple_sd_adc.txt
```
Device-Tree bindings for simple sigma delta adc

Required properties:
- compatible: should be "sd-modulator".
- #io-channel-cells = <1>: See the IIO bindings section "IIO consumers".

Example node:

	ads1202: simple_sd_adc@0 {
		compatible = "sd-modulator";
		#io-channel-cells = <1>;
		status = "okay";
	};
```

## Documentation/devicetree/bindings/iio/adc/st,stm32-dfsdm-adc.txt
```
STMicroelectronics STM32 DFSDM ADC device driver


STM32 DFSDM ADC is a sigma delta analog-to-digital converter dedicted to
interface external sigma delta modulators to stm32 micro controlers.
it is mainly targeted for:
- Sigma delta modulators ( motor control, metering...)
- PDM microphones ( audio digital microphone)

It featured with up to 8 serial digital interface (SPI or Manchester) and
up to 4 filters.

Each instance of the sub-drivers uses one filter instance.

Contents of a stm32 dfsdmc root node:
-------------------------------------
Required properties:
- compatible: Should be "st,stm32-dfsdm-adc".
- reg: Offset and length of the DFSDM block register set.
- clocks: IP and serial interfaces clocking. Should be set according
		to rcc clock ID and "clock-names".
- clock-names: Input clock name "dfsdm" must be defined,
		"audio" is optional. If defined CLKOUT is based on the audio
		clock, else "dfsdm" is used.
- clocks: Clock for the analog circuitry (common to all ADCs).
- clock-names: Must be "adc".

Optional properties:
- st,clkout-freq: needed for SPI master mode
		  SPI clock OUT frequency (Hz).This clock must be set according
		  to "clock" property. Frequency must be a multiple of the rcc
		  clock frequency. If not, clkout frequency will not be
		  accurate.

Contents of a stm32 DFSDM child nodes:
----------------------------------------

Required properties:
- compatible: Must be:
	"st,stm32-dfsdm-adc" for sigma delta ADCs
	"st,stm32-dfsdm-pdm" for audio digital microphone.
- reg: Specifies the DFSDM filter instance.
- interrupts: IRQ lines connected to each DFSDM filter instance.
- st,adc-channels:	List of single-ended channels muxed for this ADC.
- st,adc-channel-names:	List of single-ended channels Name.
- st,dai-filter-order:  SinC filter order from 0 to 5.
			0: FastSinC
			[1-5]: order 1 to 5.
			For audio purpose it is recommended to use order 3 to 5.

Required properties for "st,stm32-dfsdm-adc" compatibility:
- #io-channel-cells = <1>: See the IIO bindings section "IIO consumers".
- io-channels: from common iio binding. use to pipe external sigma delta
		modulator or internal ADC output to dfsdm channel.

Required properties for "st,stm32-dfsdm-pdm" compatibility:
- #sound-dai-cells: must be set to 0.
- dma: DMA controller phandle and DMA request line associated to the
		filter instance ( specified by the field "reg")
- dma-names: must be "rx"

Optional properties:
- st,adc-channel-types:	Single-ended channel input type. Default value is 0.
			- "SPI_R": SPI with data on rising edge (default)
			- "SPI_F": SPI with data on falling edge
			- "MANCH_R": manchester codec, rising edge = logic 0
			- "MANCH_F": manchester codec, falling edge = logic 1
- st,adc-channel-clk-src: Conversion clock source. default value is 1.
			  - "CLKIN": External SPI clock (CLKIN x)
			  - "CLKOUT": internal SPI clock (CLKOUT) (default)
			  - "CLKOUT_F": internal SPI clock divided by 2 (falling edge).
			  - "CLKOUT_R": internal SPI clock divided by 2 (rising edge).

- st,adc-alt-channel: Must be defined if Two sigma delta modulator are
			  connected on same SPI input.
			  If not set channel n is connected to SPI input n.
			  If set channel n is connected to SPI input n + 1.

- st,filter0-sync: Set to 1 to synchronize with DFSDM filter instance 0.
		   to used for multi microphone synchronization.

Example of a sigma delta adc purpose:
	ads1202: simple_sd_adc@0 {
		compatible = "sd-modulator";
		#io-channel-cells = <1>;
		status = "okay";
	};
	dfsdm: dfsdm@40017000 {
		compatible = "st,stm32h7-dfsdm";
		reg = <0x40017000 0x400>;
		clocks = <&timer_clk>;
		clock-names = "dfsdm";

		dfsdm_adc0: dfsdm-adc0@0 {
			compatible = "st,stm32-dfsdm-adc";
			#io-channel-cells = <1>;
			reg = <0>;
			interrupts = <110>;
			st,adc-channels = <0>;
			st,adc-channel-names = "in0";
			st,adc-channel-types = "SPI_R";
			st,adc-channel-clk-src = "CLKOUT";
			io-channels = <&ads1202 0>;
	};

Example of a pdm microphone purpose:
	dfsdm: dfsdm@40017000 {
		compatible = "st,stm32h7-dfsdm";
		reg = <0x40017000 0x400>;
		clocks = <&timer_clk>;
		clock-names = "dfsdm";

		dfsdm_pdm0: dfsdm-pdm@0 {
			compatible = "st,stm32-dfsdm-pdm";
			#sound-dai-cells = <0>;
			reg = <0>;
			interrupts = <110>;
			dmas = <&dmamux1 102 0x400 0x00>;
			dma-names = "rx";
			st,adc-channels = <0>;
			st,adc-channel-names = "pdm1";
			st,adc-channel-types = "SPI_R";
			st,adc-channel-clk-src = "CLKOUT";
		};
	}
```

## Documentation/devicetree/bindings/iio/adc/ti-lmp92001-adc.txt
```
* Texas Instruments' LMP92001 ADCs

Required properties:
 - compatible: Must be set to "ti,lmp92001-adc".
 - reg: i2c chip address for the device.
 - ti,lmp92001-adc-mode: adc operation, either continuous or single-shot.
 - ti,lmp92001-adc-mask: bit mask for which channel is enable.
        0 = Off
        1 = On

Example:
lmp92001@20 {
        compatible = "ti,lmp92001";
        reg = <0x20>;

        lmp92001-adc {
                compatible = "ti,lmp92001-adc";
                ti,lmp92001-adc-mode = "continuous";
                ti,lmp92001-adc-mask = <0x00000079>;
        };
};
```
