## Documentation/devicetree/bindings/power/supply/battery.txt
```
Battery Characteristics

Required Properties:
 - compatible: Must be "fixed-battery"

Optional Properties:
 - voltage-min-design-microvolt: drained battery voltage
 - voltage-max-design-microvolt: charged battery voltage
 - energy-full-design-microwatt-hours: battery design energy
 - charge-full-design-microamp-hours: battery design capacity

Future Properties must be named for the corresponding elements in
enum power_supply_property, defined in include/linux/power_supply.h.

Batteries must be referenced by chargers and/or fuel-gauges
using a phandle. The phandle's property should be named
"monitored-battery".

Example:

	bat: battery {
		compatible = "fixed-battery";
		voltage-min-design-microvolt = <3200000>;
		voltage-max-design-microvolt = <4200000>;
		energy-full-design-microwatt-hours = <5290000>;
		charge-full-design-microamp-hours = <1430000>;
	};

	charger: charger@0 {
		....
		monitored-battery = <&bat>;
		...
	};

	fuel_gauge: fuel_gauge@0 {
		....
		monitored-battery = <&bat>;
		...
	};
```

## Documentation/devicetree/bindings/power/supply/bq2416x.txt
```
Binding for TI bq2416x Li-Ion Charger

Required properties:
====================
- compatible: one of the following:
 * "ti,bq24160"
 * "ti,bq24160a"
 * "ti,bq24161"
 * "ti,bq24161b"
 * "ti,bq24163"
 * "ti,bq24168"

- reg:			I2C address of the device.
- interrupt-parent:	The IRQ controller (phandle) connected to the INT pin of
			the bq2416x
- interrupts:		The IRQ number assigned for INT pin.

Optional properties:
====================

- ti,in-current-limit-microamp:	IN source current limit.
	Possible values: 1500000 (default), 2500000

- ti,usb-current-limit-microamp: USB source current limit.
	If not specified, auto detection of USB (D+/D- based) is used (for
	BQ24160/0A/3 only) or settings of default mode are kept (BQ24161/1B/8).
	Both pre-select only 100 mA or 1500 mA (refer to datasheet).
	Possible values: 100000, 150000, 500000, 800000, 90000, 1500000

- ti,usb-dpm-voltage-microvolt:	USB threshold for dynamic power path management.
	Configures the threshold input voltage (usb input) for the dynamic power
	path management. If not specified a default of 4,200,000 (= 4.2V) is
	used.

- ti,in-dpm-voltage-microvolt: IN threshold for dynamic power path management.
	Configures the threshold input voltage (in input) for the dynamic power
	path management. If not specified a default of 4,200,000 (= 4.2V) is
	used.

- monitored-battery: phandle of battery information devicetree node
	If not specified, no battery is assumed (charge disable, nobat operation
	mode, no NTC check of battery), Vsys output voltage is set to 4.2V. The
	charger uses the following battery properties:
	+ constant_charge_current_max_microamp: maximum current in fast charge
	  mode
	+ constant_charge_voltage_max_microvolt: maximum constant charging
	  voltage / output voltage (refer to datasheet)
	+ charge-term-current-microamp: a charge cycle terminates when the
	  battery voltage is above recharge threshold, and the current is below
	  this setting (typically 10% of battery capacity). If not specified,
	  termination of current detection is disabled (refer to datasheet).

Example:
========

bat: battery {
		compatible = "simple-battery";
		charge-term-current-microamp = <128000>;
		constant-charge-current-max-microamp = <900000>;
		constant-charge-voltage-max-microvolt = <4200000>;
	};

bq24160@6b {
	compatible = "ti,bq24160";
	reg = <0x6b>;

	interrupt-parent = <&gpio5>;
	interrupts = <31 IRQ_TYPE_EDGE_RISING>;

	monitored-battery = <&bat>;
	ti,in-current-limit-microamp = <1500000>;
	ti,usb-current-limit-microamp = <500000>;
	ti,usb-dpm-voltage-microvolt = <4300000>;
	ti,in-dpm-voltage-microvolt = <4300000>;
};
```

## Documentation/devicetree/bindings/power/supply/cpcap-charger.txt
```
Motorola CPCAP PMIC battery charger binding

Required properties:
- compatible: Shall be "motorola,cpcap-charger" or
	      "motorola,mapphone-cpcap-charger"
- interrupts: Interrupts used on the CPCAP PMIC
- interrupt-names: Names of the interrupts
- io-channels: IIO ADC channels used by the charger
- io-channel-names: Names of the IIO ADC channels

Optional properties:
- mode-gpios: Optionally CPCAP charger can have a companion wireless
	      charge controller that is controlled with two GPIOs

Example:

cpcap_charger: charger {
	compatible = "motorola,mapphone-cpcap-charger";
	interrupts-extended = <
		&cpcap 13 0 &cpcap 12 0 &cpcap 29 0 &cpcap 28 0
		&cpcap 22 0 &cpcap 20 0 &cpcap 19 0 &cpcap 54 0
	>;
	interrupt-names =
		"chrg_det", "rvrs_chrg", "chrg_se1b", "se0conn",
		"rvrs_mode", "chrgcurr1", "vbusvld", "battdetb";
	mode-gpios = <&gpio3 29 GPIO_ACTIVE_LOW
		      &gpio3 23 GPIO_ACTIVE_LOW>;
	io-channels = <&cpcap_adc 0 &cpcap_adc 1
		       &cpcap_adc 2 &cpcap_adc 5
		       &cpcap_adc 6>;
	io-channel-names = "battdetb", "battp",
			   "vbus", "chg_isense",
			   "batti";
};
```

## Documentation/devicetree/bindings/power/supply/gpio-charger.txt
```
gpio-charger

Required properties :
 - compatible : "gpio-charger"
 - gpios : GPIO indicating the charger presence.
   See GPIO binding in bindings/gpio/gpio.txt .
 - charger-type : power supply type, one of
     unknown
     battery
     ups
     mains
     usb-sdp (USB standard downstream port)
     usb-dcp (USB dedicated charging port)
     usb-cdp (USB charging downstream port)
     usb-aca (USB accessory charger adapter)

Optional properties:
 - status-gpios: GPIO indicating the charger status

Example:

	usb_charger: charger {
		compatible = "gpio-charger";
		charger-type = "usb-sdp";
		gpios = <&gpf0 2 0 0 0>;
		status-gpios = <&gpf0 3 0 0 0>;
	}

	battery {
		power-supplies = <&usb_charger>;
	};
```

## Documentation/devicetree/bindings/power/supply/ltc3651-charger.txt
```
ltc3651-charger

Required properties:
 - compatible: "lltc,ltc3651-charger"
 - acpr-gpios: Connect to ACPR output. See remark below.

Optional properties:
 - fault-gpios: Connect to FAULT output. See remark below.
 - chrg-gpios: Connect to CHRG output. See remark below.

The ltc3651 outputs are open-drain type and active low. The driver assumes the
GPIO reports "active" when the output is asserted, so if the pins have been
connected directly, the GPIO flags should be set to active low also.

The driver will attempt to aquire interrupts for all GPIOs. If the system is
not capabale of providing that, the driver cannot report changes and userspace
will need to periodically read the sysfs attributes to detect changes.

Example:

	charger: battery-charger {
		compatible = "lltc,ltc3651-charger";
		acpr-gpios = <&gpio0 68 GPIO_ACTIVE_LOW>;
		fault-gpios = <&gpio0 64 GPIO_ACTIVE_LOW>;
		chrg-gpios = <&gpio0 63 GPIO_ACTIVE_LOW>;
	};
```

## Documentation/devicetree/bindings/power/supply/sc2731_charger.txt
```
Spreadtrum SC2731 PMIC battery charger binding

Required properties:
 - compatible: Should be "sprd,sc2731-charger".
 - reg: Address offset of charger register.
 - phys: Contains a phandle to the USB phy.

Example:

	charger@0 {
		compatible = "sprd,sc2731-charger";
		reg = <0x0>;
		phys = <&ssphy>;
	};
```

## Documentation/devicetree/bindings/power/supply/smb347_charger.txt
```
smb347_charger bindings
~~~~~~~~~~~~~~~~~~~~~~~~

[Required porperties]
- compatible : "summit,smb345"
	       "summit,smb347"
- reg : Slave address for i2c interface
# At least one of following should be set
  - enable-usb-charging
  - enable-otg-charging
  - enable-mains-charging

[Optional properties]
- interrupt-parent : The phandle for the interrupt controller
- interrupts : Interrupt line index for mapping
- en-gpio : Enable charging control
	  : If this is not specified it will use SW (i2c interface)

# Charging constraints
- max-chg-curr : microamps for charging Maximum current
- max-chg-volt : microvolts for charging Maximum voltage
- pre-chg-curr : microamps for Pre-charging current
- term-curr : microamps for Charging cycle termination current
- fast-volt-thershold : microvolts for Voltage threshold to transit to fast charge mode
- mains-curr-limit : micromaps for Maximum input current from AC/DC input
- usb-curr-limit : microamps for Maximum input current from USB input

# Related thermometer monitoring (Degrees Celsius)
- chip-temp-threshold : Chip temperature for thermal regulaton.   <100, 130>
- soft-cold-temp-limit : Cold battery temperature for soft alarm. <0, 15>*
- soft-hot-temp-limit : Hot battery temperature for soft alarm.   <40, 55>
- hard-cold-temp-limit : Cold battery temperature for hard alarm. <0, 15>*
- hard-hot-temp-limit : Hot battery temperature for hard alarm.   <55, 65>
(* The written temperature has +5'C offset. 0'C -> -5'C, 15'C -> 10'C)
- soft-comp-method : Soft temperature limit compensation method
	(Not defined) : Use default setting
		<0> : Compensation none
		<1> : Charge current compensation
		<2> : Voltage compensation

Example:
	smb345@6a {
		compatible = "summit,smb345";
		reg = <0x6a>;
		status = "okay";
		interrupt-parent = <&tlmm_pinmux>;
		interrupts = <23 IRQ_TYPE_EDGE_BOTH>;

		max-chg-curr = <1800000>;
		usb-curr-limit = <450000>;

		chip-temp-thershold = <110>; /* celsius */

		enable-usb-charging;
		enable-otg-charging;
	};

	smb347@7f {
		compatible = "summit,smb347";
		reg = <0x7f>;
		status = "okay";

		max-chg-curr = <1800000>;
		mains-curr-limit = <2000000>;
		usb-curr-limit = <450000>;

		chip-temp-thershold = <110>; /* celsius */

		en-gpios = <&tlmm_pinmux 54 GPIO_ACTIVE_HIGH>;

		enable-usb-charging;
		enable-mains-charging;
	};
```

## Documentation/devicetree/bindings/power/supply/tps65217_charger.txt
```
TPS65217 Charger

Required Properties:
-compatible: "ti,tps65217-charger"
-interrupts: TPS65217 interrupt numbers for the AC and USB charger input change.
             Should be <0> for the USB charger and <1> for the AC adapter.
-interrupt-names: Should be "USB" and "AC"

Optional properties:
-charge-voltage-microvolt: set the charge voltage. The value can be: 4100000,
	4150000, 4200000, 4250000; default: 4100000

-charge-current-microamp: set the charging current. The value can be: 300000,
	400000, 500000, 700000; default: 500000

-ti,ntc-type: set the NTC type for battery temperature measurement. The value
	must be 0 or 1, where:
	  0 – 100k (curve 1, B = 3960)
	  1 – 10k  (curve 2, B = 3480) (default)

This node is a subnode of the tps65217 PMIC.

Example:

	tps65217-charger {
		compatible = "ti,tps65217-charger";
		interrupts = <0>, <1>;
		interrupt-names = "USB", "AC";
		charge-voltage-microvolt = <4100000>;
		charge-current-microamp = <500000>;
		ti,ntc-type = <1>;
	};
```

## Documentation/devicetree/bindings/power/supply/xmega16d4-battery.txt
```
Binding for the Toby Churchill SBS battery monitor

Required properties :
 - compatible : "tcl,xmega16d4-battery"

Example:

	battery: smart-battery@0 {
		compatible = "tcl,xmega16d4-battery";
		reg = <0>;
		spi-max-frequency = <100000>;
	};
```

## Documentation/devicetree/bindings/power/ucs1002.txt
```
UCS1002-2 Programmable USB Port Power Controller with Charger Emulation bindings

Required properties:
- compatible: "microchip,ucs1002"
- reg: integer, the I2C address of the device.

Optional properties:
- interrupt-parent: the phandle of the interrupt controller that services
    interrupts for this device.
- interrupts: interrupt specifiers for two interrupt sources.
    - First interrupt specifier is for A_DET interrupt.
    - Second interrupt specifier is for ALERT interrupt.
- microchip,limit-microamps: integer, maximum current in microamps. Note that the
    default value is based on the resistor on the COMM_SEL/ILIM pin and this
    value cannot be changed to be higher than hardware set value. Accepted
    values are: 500000, 900000, 1000000, 1200000, 1500000, 1800000, 2000000 and
    2500000 (microamps).
- control-gpios = list of gpios used as pin states when determining the active mode
    selection and power state. Must provide EM_EN, M1, M2 and PWR_EN gpio mapping.
    If this property is not set it uses I2C for configuration.

Example (polling):

	ucs1002: ucs1002@57 {
		compatible = "microchip,ucs1002";
		reg = <0x57>;
		microchip,limit-microamps = <2000000>;
	};

Example (interrupts + control gpios):

	ucs1002: ucs1002@57 {
		compatible = "microchip,ucs1002";
		reg = <0x57>;
		interrupt-parent = <&gpio0>;
		interrupts = <30 0>, <31 0>;
		control-gpios = <&gpio0 2 GPIO_ACTIVE_HIGH>,	/* EM_EN */
				<&gpio0 3 GPIO_ACTIVE_HIGH>,	/* M1 */
				<&gpio1 17 GPIO_ACTIVE_HIGH>,	/* M2 */
				<&gpio1 19 0>;			/* PWR_EN */
	};
```

## Documentation/devicetree/bindings/power_supply/axp20x_ac_power.txt
```
AXP20x AC power supply

Required Properties:
-compatible: "x-powers,axp202-ac-power-supply"

This node is a subnode of the axp20x PMIC.

Example:

axp209: pmic@34 {

	ac-power-supply: ac-power-supply {
		compatible = "x-powers,axp202-ac-power-supply";
	};

	...
};
```

## Documentation/devicetree/bindings/power_supply/qcom-reboot-mode.txt
```
Qualcomm Reboot Mode Driver

Qualcomm reboot mode driver based on reboot mode framework to update
SPMI specific bits.

Required Properties:
-compatible: "qcom,reboot-mode"
-offset: offset of the SPMI reboot mode register

Optional Properties:
-mask: mask of reboot mode
-mode-xxx: magic of reboot mode

Example:
	qcom,reboot-mode@88f {
		compatible = "qcom,reboot-mode";
		offset = <0x88f>;
		mode-normal = <0x00>;
		mode-recovery = <0x04>;
		mode-bootloader = <0x08>;
		mode-rtc = <0x0C>;
	};
```
