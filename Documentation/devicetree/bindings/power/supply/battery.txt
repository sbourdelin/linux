## Documentation/devicetree/bindings/powerpc/cpufeatures.txt
```
powerpc cpu features binding
============================

The device tree describes supported CPU features as nodes containing
compatibility and enablement information as properties.

The binding specifies features common to all CPUs in the system.
Heterogeneous CPU features are not supported at present (such could be added
by providing nodes with additional features and linking those to particular
CPUs).

This binding is intended to provide fine grained control of CPU features at
all levels of the stack (firmware, hypervisor, OS, userspace), with the
ability for new CPU features to be used by some components without all
components being upgraded (e.g., a new floating point instruction could be
used by userspace math library without upgrading kernel and hypervisor).

The binding is passed to the hypervisor by firmware. The hypervisor must
remove any features that require hypervisor enablement but that it does not
enable. It must remove any features that depend on removed features. It may
pass remaining features usable to the OS and PR to guests, depending on
configuration policy (not specified here).

The modified binding is passed to the guest by hypervisor, with HV bit
cleared from the usable-mask and the hv-support and hfscr-bit properties
removed. The guest must similarly rmeove features that require OS enablement
that it does not enable. The OS may pass PR usable features to userspace via
ELF AUX vectors AT_HWCAP, AT_HWCAP2, AT_HWCAP3, etc., or use some other
method (outside the scope of this specification).

The binding will specify a "base" level of features that will be present
when the cpu features binding exists. Additional features will be explicitly
specified.

/cpus/features node binding
---------------------------

Node: features

Description: Container of CPU feature nodes.

The node name must be "features" and it must be a child of the node "/cpus".

The node is optional but should be provided by new firmware.

Each child node of cpufeatures represents an architected CPU feature (e.g.,
a new set of vector instructions) or an important CPU performance
characteristic (e.g., fast unaligned memory operations). The specification
of each feature (instructions, registers, exceptions, etc.) will be
documented with device tree bindings.

As a rough guide, features should be based on functional groups of changes,
those that share common enablement requirements, that share particular
registers or functionality. For example, "POWER9" would be too general, and
a new feature for every instruction would be too specific. The "summary of
changes" preface in Power ISA specification is a good guideline for the
architected features.

Features should be "positive" where possible. For example the presence of a
feature node should indicate the presence of a new CPU feature (e.g., a
new instruction or register). An errata workaround for example would then
remove that feature from the device tree to disable it. "Negative" features
may be unavoidable in some cases.

Properties:

- device_type
  Usage: required
  Value type: string
  Definition: "cpu-features"

- isa
  Usage: required
  Value type: <u32>
  Definition:

  isa that the CPU is currently running in. This provides instruction set
  compatibility, less the individual feature nodes. For example, an ISA v3.0
  implementation that lacks the "transactional-memory" cpufeature node
  should not use transactional memory facilities.

  Value corresponds to the "Power ISA Version" multiplied by 1000.
  For example, <3000> corresponds to Version 3.0, <2070> to Version 2.07.
  The minor digit is available for revisions.

/cpus/features/feature node bindings
------------------------------------

Node: A string describing an architected CPU feature, e.g., "vsx".

Description: An architected feature supported by the CPUs.

The name of the node will follow a convention such that software will
match known features by a string comparison with the node name. Presence
of the node indicates the feature is available to use (XXX: could
advertise all supported by hardware, with disabled/enabled status
property).

The name of the child node corresponds to the name of the feature.
Software will detect known features by string matching.

Properties:

- isa
  Usage: required
  Value type: <u32>
  Definition:

  First level of the Power ISA that the feature appears in.
  Software should filter out features when constraining the
  environment to a particular ISA version.

  Value is defined similarly to /cpus/features/isa

- usable-mask
  Usage: required
  Value type: <u32> bit mask
  Definition:
              Bit numbers are LSB0
              bit 0 - PR (problem state / user mode)
              bit 1 - OS (privileged state)
              bit 2 - HV (hypervisor state)
              All other bits reserved and should be zero.

  This property describes the privilege levels and/or software components
  that can use the feature.

  If bit 0 is set, then the hwcap-bit-nr property will exist.

  Reserved bits must be treated as the feature being unsupported.

- hv-support
  Usage: optional
  Value type: <u32>
  Definition:
              1 -  Custom
              2 -  HFSCR
              Other values reserved.

  This property describes the HV privilege state support required to
  enable the feature. If the property does not exist then no support is
  required.

  If the value of this property is 1, then the hypervisor must have
  explicit support for this feature.

  If the value of this property is 2, then the hfscr-bit-nr property
  will exist.

  Reserved values must be treated as the feature being unsupported.

- os-support
  Usage: optional
  Value type: <u32>
  Definition:
              1 -  Custom
              2 -  FSCR
              Other values reserved.

  This property describes the OS privilege state support required to
  enable the feature. If the property does not exist then no support is
  required.

  If the value of this property is 1, then the operating system must
  have explicit support for this feature.

  If the value of this property is 2, then the fscr-bit-nr property will
  exist.

  Reserved values must be treated as the feature being unsupported.

- hfscr-bit-nr
  Usage: optional
  Value type: <u32>
  Definition: HFSCR bit position (LSB0)

  This property exists when the hv-support property value is 2. This
  property describes the bit number in the HFSCR register that the
  hypervisor must set in order to enable this feature.

- fscr-bit-nr
  Usage: optional
  Value type: <u32>
  Definition: FSCR bit position (LSB0)

  This property exists when the os-support property value is 2. This
  property describes the bit number in the FSCR register that the
  operating system must set in order to enable this feature.

- hwcap-bit-nr
  Usage: optional
  Value type: <u32>
  Definition: AUX vector bit position (LSB0)

  This property may exist when the usable-mask property value has bit 0
  (PR) set. This property describes the bit number that should be set in
  the ELF AUX hardware capability vectors in order to advertise this
  feature to userspace. Bits 0-31 correspond to bits 0-31 in AT_HWCAP
  vector. Bits 32-63 correspond to 0-31 in AT_HWCAP2 vector, and so on.
  Missing AT_HWCAPx vectors implies that the feature is not enabled or
  can not be advertised. Operating systems may provide a number of
  unassigned hardware capability bits to allow for new features to be
  advertised.

  Some properties representing features created before this binding are
  advertised to userspace without a one-to-one hwcap bit number may not
  specify this bit. Operating system will handle those bits specifically.
  All new features usable by userspace will have a hwcap-bit-nr property.

- dependencies
  Usage: optional
  Value type: <prop-encoded-array>
  Definition:

  If this property exists then it is a list of phandles to cpu feature
  nodes that must be enabled for this feature to be enabled.


Example
-------

	/cpus/features {
		device_type = "cpu-features";

		isa = <3020>;

		darn {
			isa = <3000>;
			usable-mask = <1 | 2 | 4>;
			hwcap-bit-nr = <xx>;
		};

		scv {
			isa = <3000>;
			usable-mask = <1 | 2>;
			os-support = <1>;
			hwcap-bit-nr = <xx>;
		};

		stop {
			isa = <3000>;
			usable-mask = <2 | 4>;
			hv-support = <1>;
			os-support = <1>;
		};

		vsx2 (hypothetical) {
			isa = <3010>;
			usable-mask = <1 | 2 | 4>;
			hv-support = <1>;
			os-support = <1>;
			hwcap-bit-nr = <xx>;
		};

		vsx2-newinsns {
			isa = <3020>;
			usable-mask = <1 | 2 | 4>;
			os-support = <2>;
			fscr-bit-nr = <xx>;
			hwcap-bit-nr = <xx>;
			dependencies = <&vsx2>;
		};

	};
```

## Documentation/devicetree/bindings/powerpc/opal/hotplug-aperture.txt
```
Designated hotplug memory
-------------------------

This binding describes a region of hotplug memory which is not present at boot,
allowing its eventual NUMA associativity to be prespecified.

Required properties:

- compatible
	"ibm,hotplug-aperture"

- reg
	base address and size of the region (standard definition)

- ibm,associativity
	NUMA associativity (standard definition)

Example:

A 2 GiB aperture at 0x100000000, to be part of nid 3 when hotplugged:

	hotplug-memory@100000000 {
		compatible = "ibm,hotplug-aperture";
		reg = <0x0 0x100000000 0x0 0x80000000>;
		ibm,associativity = <0x4 0x0 0x0 0x0 0x3>;
	};
```

## Documentation/devicetree/bindings/powerpc/opal/power-mgt.txt
```
IBM Power-Management Bindings
=============================

Linux running on baremetal POWER machines has access to the processor
idle states. The description of these idle states is exposed via the
node @power-mgt in the device-tree by the firmware.

Definitions:
----------------
Typically each idle state has the following associated properties:

- name: The name of the idle state as defined by the firmware.

- flags: indicating some aspects of this idle states such as the
         extent of state-loss, whether timebase is stopped on this
         idle states and so on. The flag bits are as follows:

- exit-latency: The latency involved in transitioning the state of the
		CPU from idle to running.

- target-residency: The minimum time that the CPU needs to reside in
		    this idle state in order to accrue power-savings
		    benefit.

Properties
----------------
The following properties provide details about the idle states. These
properties are optional unless mentioned otherwise below.

- ibm,cpu-idle-state-names:
	Array of strings containing the names of the idle states.

- ibm,cpu-idle-state-flags:
	Array of unsigned 32-bit values containing the values of the
	flags associated with the the aforementioned idle-states. This
	property is required on POWER9 whenever
	ibm,cpu-idle-state-names is defined and the length of this
	property array should be the same as
	ibm,-cpu-idle-state-names.The flag bits are as follows:
		0x00000001 /* Decrementer would stop */
		0x00000002 /* Needs timebase restore */
		0x00001000 /* Restore GPRs like nap */
		0x00002000 /* Restore hypervisor resource from PACA pointer */
		0x00004000 /* Program PORE to restore PACA pointer */
		0x00010000 /* This is a nap state */
		0x00020000 /* This is a fast-sleep state */
		0x00040000 /* This is a winkle state */
		0x00080000 /* This is a fast-sleep state which requires a */
			   /* software workaround for restoring the timebase*/
		0x00800000 /* This state uses SPR PMICR instruction */
		0x00100000 /* This is a fast stop state */
		0x00200000 /* This is a deep-stop state */

- ibm,cpu-idle-state-latencies-ns:
	Array of unsigned 32-bit values containing the values of the
	exit-latencies (in ns) for the idle states in
	ibm,cpu-idle-state-names. This property is required whenever
	ibm,cpu-idle-state-names is defined and the length of this
	property array should be the same as
	ibm,-cpu-idle-state-names.

- ibm,cpu-idle-state-residency-ns:
	Array of unsigned 32-bit values containing the values of the
	target-residency (in ns) for the idle states in
	ibm,cpu-idle-state-names. On POWER8 this is an optional
	property. If the property is absent, the target residency for
	the "Nap", "FastSleep" are defined to 10000 and 300000000
	respectively. On POWER9 this property must be defined if
	ibm,cpu-idle-state-names is defined and the length should be
	same as that of ibm,cpu-idle-state-names.

- ibm,cpu-idle-state-psscr:
	Array of unsigned 64-bit values containing the values for the
	PSSCR for each of the idle states in ibm,cpu-idle-state-names.
	This property is required on POWER9 whenever
	ibm,cpu-idle-state-names is defined and the length of this
	property array should be the same as
	ibm,-cpu-idle-state-names.

- ibm,cpu-idle-state-psscr-mask:
	Array of unsigned 64-bit values containing the masks
	indicating which psscr fields are set in the corresponding
	entries of ibm,cpu-idle-state-psscr.  This property is
	required on POWER9 whenever ibm,cpu-idle-state-names is
	defined and the length of this property array should be the
	same as ibm,cpu-idle-state-names.

	Whenever the firmware sets an entry in
	ibm,cpu-idle-state-psscr-mask value to 0xf, it implies that
	only the Requested Level (RL) field of the corresponding entry
	in ibm,cpu-idle-state-psscr should be considered by the
	kernel. For such idle states, the kernel would set the
	remaining fields of the psscr to the following sane-default
	values.

		- ESL and EC bits are to 1. So wakeup from any stop
		  state will be at vector 0x100.

		- MTL and PSLL are set to the maximum allowed value as
		  per the ISA, i.e. 15.

		- The Transition Rate, TR is set to the Maximum value
                  3.

	For all the other values of the entry in
	ibm,cpu-idle-state-psscr-mask, the Kernel expects all the
	psscr fields of the corresponding entry in
	ibm,cpu-idle-state-psscr to be correctly set by the firmware.

- ibm,cpu-idle-state-pmicr:
	Array of unsigned 64-bit values containing the pmicr values
	for the idle states in ibm,cpu-idle-state-names. This is an
	optional property on POWER8 and is absent on POWER9. When
	present on POWER8, the length of this property array should be
	the same as ibm,cpu-idle=state-names.

- ibm,cpu-idle-state-pmicr:
	Array of unsigned 64-bit values containing the mask indicating
	which of the fields of the PMICR are set in the corresponding
	entries in ibm,cpu-idle-state-pmicr. This is an optional
	property on POWER8 and is absent on POWER9. When present on
	POWER8, the length of this property array should be the same
	as ibm,cpu-idle=state-names.
```

## Documentation/devicetree/bindings/pwm/atmel-lcdc-pwm.txt
```
Device-Tree bindings for Atmel's LCDC (LCD Controller) PWM driver

The Atmel LCDC PWM is subdevice of the LCDC MFD device.
See ../mfd/atmel-lcdc.txt for more details.

Required properties:
 - compatible: value should be one of the following:
   "atmel,lcdc-pwm"
 - pinctr-names: the pin control state names. Should contain "default".
 - pinctrl-0: should contain the pinctrl states described by pinctrl
   default.
 - #pwm-cells: should be set to 3. This PWM chip use the default 3 cells
   bindings defined in pwm.txt in this directory.

Example:
	lcdc0: lcdc@700000 {
		compatible = "atmel,at91sam9263-lcdc-mfd";
		reg = <0x700000 0x1000>;
		interrupts = <26 IRQ_TYPE_LEVEL_HIGH 3>;
		clocks = <&lcd_clk>, <&lcd_clk>;
		clock-names = "lcdc_clk", "hclk";

		lcdc_pwm: lcdc-pwm {
			compatible = "atmel,lcdc-pwm";
			pinctrl-names = "default";
			pinctrl-0 = <&pinctrl_lcdc_pwm>;
			#pwm-cells = <3>;
		};

	};
```
