## Documentation/devicetree/bindings/pwm/imx-pwm.txt
```
Freescale i.MX PWM controller

Required properties:
- compatible : should be "fsl,<soc>-pwm" and one of the following
   compatible strings:
  - "fsl,imx1-pwm" for PWM compatible with the one integrated on i.MX1
  - "fsl,imx27-pwm" for PWM compatible with the one integrated on i.MX27
- reg: physical base address and length of the controller's registers
- #pwm-cells: 2 for i.MX1 and 3 for i.MX27 and newer SoCs. See pwm.txt
  in this directory for a description of the cells format.
- clocks : Clock specifiers for both ipg and per clocks.
- clock-names : Clock names should include both "ipg" and "per"
See the clock consumer binding,
	Documentation/devicetree/bindings/clock/clock-bindings.txt
- interrupts: The interrupt for the pwm controller

Optional properties:
- pinctrl: For i.MX27 and newer SoCs. Add extra pinctrl to configure the PWM
  pin to gpio function.  It allows control over the pin output level when the
  PWM block is disabled. This is meant to be used if inverted polarity of the
  PWM signal is required. See "Inverted PWM output" section bellow.

Example:

pwm1: pwm@53fb4000 {
	#pwm-cells = <3>;
	compatible = "fsl,imx53-pwm", "fsl,imx27-pwm";
	reg = <0x53fb4000 0x4000>;
	clocks = <&clks IMX5_CLK_PWM1_IPG_GATE>,
		 <&clks IMX5_CLK_PWM1_HF_GATE>;
	clock-names = "ipg", "per";
	interrupts = <61>;
};

Inverted PWM output
-------------------

The i.MX SoC has such limitation that whenever a pad is configured as a PWM
output, the output level is always zero volts when the PWM block is disabled.
The zero output level is actively driven by the output stage of the PWM block
and can not be overridden by pull-up. It also does not matter what PWM polarity
a PWM client (e.g. backlight) requested.

To gain control of the PWM output level in disabled state two pinctrl states
can be used. The "default" state and the "pwm" state. In the default state the
PWM output is configured as a GPIO with pull-up. In the "pwm" state the output
is configured as a PWM output. This setup assures that the PWM output is at
the required level that corresponds to duty cycle = 0 when PWM is disabled.
E.g. at boot.

Example:

&pwm1 {
	pinctrl-names = "default", "pwm";
	pinctrl-0 = <&pinctrl_backlight_gpio>;
	pinctrl-1 = <&pinctrl_backlight_pwm>;
}

pinctrl_backlight_gpio: pwm1grp-gpio {
	fsl,pins = <
		/* GPIO with 22kOhm pull-up */
		MX6QDL_PAD_GPIO_9__GPIO1_IO09	0xF008
	>;
};

pinctrl_backlight_pwm: pwm1grp-pwm {
	fsl,pins = <
		/* PWM output */
		MX6QDL_PAD_GPIO_9__PWM1_OUT	0x8
	>;
};
```

## Documentation/devicetree/bindings/pwm/nvidia,tegra20-pwm.txt
```
Tegra SoC PWFM controller

Required properties:
- compatible: Must be:
  - "nvidia,tegra20-pwm": for Tegra20
  - "nvidia,tegra30-pwm", "nvidia,tegra20-pwm": for Tegra30
  - "nvidia,tegra114-pwm", "nvidia,tegra20-pwm": for Tegra114
  - "nvidia,tegra124-pwm", "nvidia,tegra20-pwm": for Tegra124
  - "nvidia,tegra132-pwm", "nvidia,tegra20-pwm": for Tegra132
  - "nvidia,tegra210-pwm", "nvidia,tegra20-pwm": for Tegra210
  - "nvidia,tegra186-pwm": for Tegra186
- reg: physical base address and length of the controller's registers
- #pwm-cells: should be 2. See pwm.txt in this directory for a description of
  the cells format.
- clocks: Must contain one entry, for the module clock.
  See ../clocks/clock-bindings.txt for details.
- resets: Must contain an entry for each entry in reset-names.
  See ../reset/reset.txt for details.
- reset-names: Must include the following entries:
  - pwm

Optional properties:
============================
In some of the interface like PWM based regualator device, it is required
to configure the pins diffrently in different states, specially in suspend
state of the system. The configuration of pin is provided via the pinctrl
DT node as detailed in the pinctrl DT binding document
	Documentation/devicetree/bindings/pinctrl/pinctrl-bindings.txt

The PWM node will have following optional properties.
pinctrl-names:	Pin state names. Must be "suspend" and "resume".
pinctrl-0:	Node handle of the suspend state configuration of pins.
pinctrl-1:	Node handle of the resume state configuration of pins.

Example:

	pwm: pwm@7000a000 {
		compatible = "nvidia,tegra20-pwm";
		reg = <0x7000a000 0x100>;
		#pwm-cells = <2>;
		clocks = <&tegra_car 17>;
		resets = <&tegra_car 17>;
		reset-names = "pwm";
	};


Example with the pin configuration for suspend and resume:
=========================================================
Here Pin PE7 is used as PWM.

#include <dt-bindings/pinctrl/pinctrl-tegra.h>

	pinmux@70000868 {
		pwm_suspend: pwm_suspend_state {
                        pe7 {
                                nvidia,pins = "pe7";
                                nvidia,tristate = <TEGRA_PIN_DISABLE>;
			};
		};

		pwm_resume: pwm_resume_state {
                        pe7 {
                                nvidia,pins = "pe7";
                                nvidia,tristate = <TEGRA_PIN_DISABLE>;
			};
		};
	};

	pwm@7000a000 {
		/* Mandatory pwm properties */
		pinctrl-names = "suspend", "resume";
		pinctrl-0 = <&pwm_suspend>;
		pinctrl-1 = <&pwm_resume>;
	};
```

## Documentation/devicetree/bindings/pwm/pwm-hibvt.txt
```
Hisilicon PWM controller

Required properties:
 - compatible: should be "hisilicon,hibvt-pwm" and one of the following:
			"hisilicon,hi3516cv300-pwm".
 - reg: physical base address and length of the controller's registers.
 - clocks: phandle and clock specifier of the PWM reference clock.
 - resets: offset address and offset bit for reset or unreset of the controller.
 - pwm-nums: pwm number of the controller.

Example:
	pwm: pwm@12130000 {                                                                                                                                     
		compatible = "hisilicon,hibvt-pwm";
		reg = <0x12130000 0x10000>;
		clocks = <&crg_ctrl HI3516CV300_PWM_CLK>;
		resets = <&crg_ctrl 0x38 0>;
		pwm-nums = <4>;
	};
```

## Documentation/devicetree/bindings/pwm/pwm-omap-dmtimer.txt
```
* OMAP PWM for dual-mode timers

Required properties:
- compatible: Shall contain "ti,omap-dmtimer-pwm".
- ti,timers: phandle to PWM capable OMAP timer. See arm/omap/timer.txt for info
  about these timers.
- #pwm-cells: Should be 3. See pwm.txt in this directory for a description of
  the cells format.

Optiomal properties:
- ti,prescaler: Should be a value between 0 and 7, see the timers datasheet

Example:
	pwm: omap-pwm {
		compatible = "ti,omap-pwm";
		ti,timers = <&timer9>;
		#pwm-cells = <3>;
	};
```

## Documentation/devicetree/bindings/pwm/pwm-qti-lpg.txt
```
Qualcomm Technologies, Inc. LPG driver specific bindings

This binding document describes the properties of LPG (Light Pulse Generator)
device module in Qualcomm Technologies, Inc. PMIC chips.

- compatible:
	Usage: required
	Value type: <string>
	Definition: Must be "qcom,pwm-lpg".

- reg:
	Usage: required
	Value type: <prop-encoded-array>
	Definition: Register base and length for LPG modules. The length
		      varies based on the number of channels available in
		      the PMIC chips.

- reg-names:
	Usage: required
	Value type: <string>
	Definition: The name of the register defined in the reg property.
		      It must be "lpg-base".

- #pwm-cells:
	Usage: required
	Value type: <u32>
	Definition: The number of cells in "pwms" property specified in
		      PWM user nodes. It should be 2. The first cell is
		      the PWM channel ID indexed from 0, and the second
		      cell is the PWM default period in nanoseconds.

Example:

	pmi8998_lpg: lpg@b100 {
		compatible = "qcom,pwm-lpg";
		reg = <0xb100 0x600>;
		reg-names = "lpg-base";
		#pwm-cells = <2>;
	};
```

## Documentation/devicetree/bindings/pwm/pwm-sifive.txt
```
SiFive PWM controller

Unlike most other PWM controllers, the SiFive PWM controller currently only
supports one period for all channels in the PWM. This is set globally in DTS.
The period also has significant restrictions on the values it can achieve,
which the driver rounds to the nearest achievable frequency.
PWM RTL that corresponds to the IP block version numbers can be found
here:

https://github.com/sifive/sifive-blocks/tree/master/src/main/scala/devices/pwm

Required properties:
- compatible: Should be "sifive,$socname-pwm" and "sifive,pwmX".
  Please refer to sifive-blocks-ip-versioning.txt for details.
- reg: physical base address and length of the controller's registers
- clocks: Should contain a clock identifier for the PWM's parent clock.
- #pwm-cells: Should be 2.
  The first cell is the PWM channel number
  The second cell is the PWM polarity
- sifive,period-ns: the driver will get as close to this period as it can
- interrupts: one interrupt per PWM channel

Examples:

pwm:  pwm@10020000 {
	compatible = "sifive,fu540-c000-pwm", "sifive,pwm0";
	reg = <0x0 0x10020000 0x0 0x1000>;
	clocks = <&tlclk>;
	interrupt-parent = <&plic>;
	interrupts = <42 43 44 45>;
	#pwm-cells = <2>;
	sifive,period-ns = <1000000>;
};
```

## Documentation/devicetree/bindings/pwm/pwm-stm32-lp.txt
```
STMicroelectronics STM32 Low Power Timer PWM

STM32 LP Timer provides single channel PWM.

Must be a sub-node of an STM32 LP Timer device tree node.
See ../mfd/stm32-lptimer.txt for details about the parent node.

Required parameters:
- compatible: Must be "st,stm32-pwm-lp".

Optional properties:
- A pinctrl state named "default" can be defined to set a pin in mode of
  operation for PWM output on external pin.

Example:
	lptimer1: lptimer@0x40002400 {
		compatible = "st,stm32-lptimer";
		...
		pwm {
			compatible = "st,stm32-pwm-lp";
			pinctrl-names = "default";
			pinctrl-0 = <&lppwm1_pins>;
		};
	};
```

## Documentation/devicetree/bindings/pwm/pwm-stm32.txt
```
STMicroelectronics STM32 General Purpose Timer PWM bindings

Must be a sub-node of an STM32 General Purpose Timer device tree node.
See ../mfd/stm32-general-purpose-timer.txt for details about the parent node.

Required parameters:
- compatible:		Must be "st,stm32-pwm".
- pinctrl-names: 	Set to "default".
- pinctrl-0: 		List of phandles pointing to pin configuration nodes for PWM module.
			For Pinctrl properties see ../pinctrl/pinctrl-bindings.txt

Optional parameters:
- st,breakinput-polarity: If present, a break input is available
            for the channel. In that case the property value denotes the
            polarity of the break input:
            - 0: active low
            - 1: active high

Example:
	timers@40010000 {
		#address-cells = <1>;
		#size-cells = <0>;
		compatible = "st,stm32-gptimer";
		reg = <0x40010000 0x400>;
		clocks = <&rcc 0 160>;
		clock-names = "clk_int";

		pwm@0 {
			compatible = "st,stm32-pwm";
			pinctrl-0	= <&pwm1_pins>;
			pinctrl-names	= "default";
		};
	};
```

## Documentation/devicetree/bindings/pwm/pwm-tegra-tachometer.txt
```
Bindings for a PWM based Tachometer driver

Required properties:
- compatible: Must be "nvidia,tegra186-pwm-tachometer"
- reg: physical base addresses of the controller and length of
  memory mapped region.
- #pwm-cells: should be 2. See pwm.txt in this directory for a
  description of the cells format.
- clocks: phandle list of tachometer clocks
- clock-names: should be "tachometer". See clock-bindings.txt in documentations
- resets: phandle to the reset controller for the Tachometer IP
- reset-names: should be "tachometer". See reset.txt in documentations
- nvidia,pulse-per-rev: Integer, pulses per revolution of a Fan. This value
  obtained from Fan specification document.
- nvidia,capture-window-len: Integer, window of the Fan Tach monitor, it indicates
  that how many period of the input fan tach signal will the FAN TACH logic
  monitor. Valid values are 1, 2, 4 and 8 only.

Example:
	tegra_tachometer: tachometer@39c0000 {
		compatible = "nvidia,tegra186-pwm-tachometer";
		reg = <0x0 0x039c0000 0x0 0x10>;
		#pwm-cells = <2>;
		clocks = <&tegra_car TEGRA186_CLK_TACH>;
		clock-names = "tachometer";
		resets = <&tegra_car TEGRA186_RESET_TACH>;
		reset-names = "tachometer";
		nvidia,pulse-per-rev = <2>;
		nvidia,capture-window-len = <2>;
		status = "disabled";
	};
```
