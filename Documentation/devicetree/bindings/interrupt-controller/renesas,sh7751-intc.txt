## Documentation/devicetree/bindings/leds/leds-qcom-lpg.txt
```
Binding for Qualcomm Light Pulse Generator

The Qualcomm Light Pulse Generator consists of three different hardware blocks;
a ramp generator with lookup table, the light pulse generator and a three
channel current sink. These blocks are found in a wide range of Qualcomm PMICs.
Each of these are described individually below.

= Lookup Table (LUT)

- compatible:
	Usage: required
	Value type: <stringlist>
	Definition: must be "qcom,spmi-lpg-lut"

- reg:
	Usage: required
	Value type: <prop-encoded-array>
	Definition: base address of the LUT block

- qcom,lut-size:
	Usage: required
	Value type: <u32>
	Definition: number of elements available in the lookup table

= Light Pulse Generator (LPG)
The Light Pulse Generator can operate either as a standard PWM controller or in
a more advanced lookup-table based mode. These are described separately below.

- compatible:
	Usage: required
	Value type: <stringlist>
	Definition: must be "qcom,spmi-lpg"

- reg:
	Usage: required
	Value type: <prop-encoded-array>
	Definition: base address of the LPG block

== PWM mode

- #pwm-cells:
	Usage: required
	Value type: <u32>
	Definition: must be 1

== Lookup-table mode

- cell-index:
	Usage: required, when referencing a LUT
	Value type: <u32>
	Definition: id of the LPG, used to associate the LPG with a particular
		    ramp generator in the LUT block

- default-state:
	Usage: optional
	Value type: <string>
	Definition: default state, as defined in common.txt

- label:
	Usage: optional
	Value type: <string>
	Definition: label of the LED, as defined in common.txt

- linux,default-trigger:
	Usage: optional
	Value type: <string>
	Definition: default trigger, as defined in common.txt

- qcom,tri-led:
	Usage: optional
	Value type: <prop-encoded-array>
	Definition: a phandle of a TRILED node and a single u32 denoting which
		    output channel to control

- qcom,lut:
	Usage: optional
	Value type: <prop-encoded-array>
	Definition: phandle of a LUT node

- qcom,dtest:
	Usage: optional
	Value type: <prop-encoded-array>
	Definition: configures the output into an internal test line of the
		    pmic. A first u32 defines which test line to use and the
		    second cell configures how the value should be outputed
		    (available lines and configuration differs between PMICs)

- qcom,pattern:
	Usage: optional
	Value type: <u16-list>
	Definition: list of 16 bit duty cycle values to make up the pattern to
		    be programmed into the LUT. Values should be in the range
		    [0,512).

- qcom,pattern-length-ms:
	Usage: optional
	Value type: <u32>
	Definition: duration, in milliseconds, of the ramp generator running
		    one pass over the defined pattern

- qcom,pattern-pause-lo-ms:
	Usage: optional
	Value type: <u32>
	Definition: duration, in milliseconds, for the ramp generator to pause
		    before iterating over the pattern

- qcom,pattern-pause-hi-ms:
	Usage: optional
	Value type: <u32>
	Definition: duration, in milliseconds, for the ramp generator to pause
		    after iterating over the pattern

- qcom,pattern-ping-pong:
	Usage: optional
	Value type: <boolean>
	Definition: denotes that the ramp generator should reverse direction
		    when reaching the end of the pattern, instead of wrapping
		    to the beginning

- qcom,pattern-oneshot:
	Usage: optional
	Value type: <boolean>
	Definition: denotes that the ramp generator should stop after a single
		    pass over the pattern

- qcom,pattern-reverse:
	Usage: optional
	Value type: <boolean>
	Definition: denotes that the ramp generator should operate backwards
		    over the pattern

= LED Current Sink (TRILED)

- compatible:
	Usage: required
	Value type: <stringlist>
	Definition: must be "qcom,spmi-tri-led"

- reg:
	Usage: required
	Value type: <prop-encoded-array>
	Definition: base address of the TRILED block

- qcom,power-source:
	Usage: required
	Value type: <u32>
	Definition: power-source used to drive the output, as defined in the
		    datasheet

= EXAMPLE:
The following example defines a single output of the PMI8994, sinking current
into a LED in a natural pulsating pattern:

&spmi_bus {
	pmic@3 {
		compatible = "qcom,pmi8994", "qcom,spmi-pmic";
		reg = <0x3 SPMI_USID>;
		#address-cells = <1>;
		#size-cells = <0>;

		pmi8994_lpg_lut: lpg-lut@b000 {
			compatible = "qcom,spmi-lpg-lut";
			reg = <0xb000>;

			qcom,lut-size = <24>;
		};

		lpg@b200 {
			compatible = "qcom,spmi-lpg";
			reg = <0xb200>;

			cell-index = <2>;

			label = "lpg:green:user0";

			qcom,tri-led = <&pmi8994_tri_led 1>;
			qcom,lut = <&pmi8994_lpg_lut>;

			qcom,pattern = /bits/ 16 <9 20 42 86 158 256 353
						  425 469 491 502 507>;
			qcom,pattern-length-ms = <1337>;
			qcom,pattern-ping-pong;

			default-state = "on";
		};

		pmi8994_tri_led: tri-led@d000 {
			compatible = "qcom,spmi-tri-led";
			reg = <0xd000>;

			qcom,power-source = <1>;
		};
	};
};
```

## Documentation/devicetree/bindings/leds/leds-qti-rgb.txt
```
Qualcomm Technologies, Inc. TRI_LED driver specific bindings

This binding document describes the properties of TRI_LED module in
Qualcomm Technologies, Inc. PMIC chips.

- compatible:
	Usage: required
	Value type: <string>
	Definition: Must be "qcom,leds-rgb".

- reg:
	Usage: required
	Value type: <prop-encoded-array>
	Definition: Register base of the TRI_LED module and length.

- pwm-names:
	Usage: required
	Value type: <stringlist>
	Definition: A list of string to label the PWM devices defined in pwms
		property which are using for controlling LEDs.
		It must be: "blue", "green", "red".

- pwms:
	Usage: required
	Value type: <prop-encoded-array>
	Definition: A list of the PWM devices (phandles) used for controlling
		LEDs.

- qcom,support-blink:
	Usage: optional
	Value type: <prop-encoded-array>
	Definition: An array of integer values to indicate if "blue", "green", "red"
		LEDs support blink control. The values are listed as the fixed
		order for "blue", "green", "red" LEDs.

- qcom,on-ms:
	Usage: optional
	Value type: <prop-encoded-array>
	Definition: An array of time values (milli-seconds) to represent the
		on duration for "blue", "green", "red" LEDs. The values are
		listed as the fixed order for "blue", "green", "red" LEDs.
		This property has to be defined if "qcom,support-blink" is
		present.

- qcom,off-ms:
	Usage: optional
	Value type: <prop-encoded-array>
	Definition: An array of time values (milli-seconds) to represent the
		off duration for "blue", "green", "red" LEDs. The values are
		listed as the fixed order for "blue", "green", "red" LEDs.
		This property has to be defined if "qcom,support-blink" is
		present.

Example:

	pmi8998_rgb: rgb@d000{
		compatible = "qcom,leds-rgb";
		reg = <0xd000 0x100>;
		pwm-names = "blue", "green", "red";
		pwms =  <&pmi8998_pwm_3 0 1000000>,
			<&pmi8998_pwm_4 0 1000000>,
			<&pmi8998_pwm_5 0 1000000>;
		qcom,support-blink = <1 1 1>;
		qcom,on-ms = <500 500 500>;
		qcom,off-ms = <500 500 500>;
	};
```

## Documentation/devicetree/bindings/leds/leds-rt5033.txt
```
* Richtek Technology Corporation - RT5033 Flash LED Driver

The RT5033 Flash LED Circuit is designed for one or two LEDs driving
for torch and strobe applications, it provides an I2C software command
to trigger the torch and strobe operation.

Required properties:
- compatible : Must be "richtek,rt5033-led".

A discrete LED element connected to the device must be represented by a child
node - see Documentation/devicetree/bindings/leds/common.txt.

Required properties of the LED child node:
  See Documentation/devicetree/bindings/leds/common.txt
- led-max-microamp : Minimum Threshold for Timer protection
  is defined internally (Maximum 200mA).
- flash-max-microamp : Flash LED maximum current
- flash-max-timeout-us : Flash LED maximum timeout

Optional properties of the LED child node:
- label : see Documentation/devicetree/bindings/leds/common.txt

Example:

rt5033 {
	compatible = "richtek,rt5033";

	led {
		compatible = "richtek,rt5033-led";

		flash-led {
			label = "rt5033-flash";
			led-max-microamp = <200000>;
			flash-max-microamp = <800000>;
			flash-max-timeout-us = <1216000>;
		};
	};
}
```

## Documentation/devicetree/bindings/leds/leds-sn3218.txt
```
* Si-En Technology - SN3218 18-Channel LED Driver

Required properties:
- compatible :
	"si-en,sn3218"
- address-cells : must be 1
- size-cells : must be 0
- reg : I2C slave address, typically 0x54

Each led is represented as a sub-node of the si-en,sn3218 device.

LED sub-node properties:
- label : (optional) see Documentation/devicetree/bindings/leds/common.txt
- reg : number of LED line (could be from 0 to 17)
- linux,default-trigger : (optional)
   see Documentation/devicetree/bindings/leds/common.txt

Example:

sn3218@54 {
	compatible = "si-en,sn3218";
	#address-cells = <1>;
	#size-cells = <0>;
	reg = <0x54>;

	led1@0 {
		label = "led1";
		reg = <0x0>;
	};

	led2@1 {
		label = "led2";
		reg = <0x1>;
	};

	led3@2 {
		label = "led3";
		reg = <0x2>;
	};
};
```

## Documentation/devicetree/bindings/mailbox/arm-mhu.txt
```
ARM MHU Mailbox Driver
======================

The ARM's Message-Handling-Unit (MHU) is a mailbox controller that has
3 independent channels/links to communicate with remote processor(s).
MHU links are hardwired on a platform. A link raises interrupt for any
received data. However, there is no specified way of knowing if the sent
data has been read by the remote. This driver assumes the sender polls
STAT register and the remote clears it after having read the data.
The last channel is specified to be a 'Secure' resource, hence can't be
used by Linux running NS.

The latest MHUv2 is now a distributed IP with different peripheral views
(registers) for the sender and receiver. Also, the peripheral views
(registers) for Secure & Non-Secure have been separated out into two
different register map where there is only one Secure channel but two
Non-Secure channels viz. High Priority & Low Priority.

Another difference is that MHUv1 duplex channels are now split into
simplex/half duplex in MHUv2. MHUv2 has a configurable number of
communication channels. There is a capability register (MSG_NO_CAP) to
find out how many channels are available in a system for a specific
register map (secure/non-secure).

Mailbox Device Node:
====================

Required properties:
--------------------
- compatible:		Shall be "arm,mhu" & "arm,primecell"
- reg:			Contains the mailbox register address range (base
			address and length)
			Shall have two set of register address range in
			which case, the first one will be receive base
			& second will be transmit base. (transmit base is
			required for MHUv2)
- #mbox-cells		Shall be 1 - the index of the channel needed.
- interrupts:		Contains the interrupt information corresponding to
			each of the 3 links of MHU.

Example:
--------

1. Older controller which doesn't have different transmit & receive channel

	mhu: mailbox@2b1f0000 {
		#mbox-cells = <1>;
		compatible = "arm,mhu", "arm,primecell";
		reg = <0 0x2b1f0000 0x1000>;
		interrupts = <0 36 4>, /* LP-NonSecure */
			     <0 35 4>, /* HP-NonSecure */
			     <0 37 4>; /* Secure */
		clocks = <&clock 0 2 1>;
		clock-names = "apb_pclk";
	};

	mhu_client: scb@2e000000 {
		compatible = "fujitsu,mb86s70-scb-1.0";
		reg = <0 0x2e000000 0x4000>;
		mboxes = <&mhu 1>; /* HP-NonSecure */
	};

2. Latest MHUv2 controller which have different transmit & receive channel

        mhuv2: mailbox@2b1c0000 {
                #mbox-cells = <1>;
                compatible = "arm,mhu", "arm,primecell";
                reg = <0x0 0x2b1c0000 0x0 0x1000>,
                      <0x0 0x2b1d0000 0x0 0x1000>;
                interrupts = <0 36 4>, /* LP-NonSecure */
                             <0 35 4>; /* HP-NonSecure */
                interrupt-names = "mhu_lpri_rx",
                                  "mhu_hpri_rx";
                clocks = <&clock 0 2 1>;
                clock-names = "apb_pclk";
        };
```

## Documentation/devicetree/bindings/mailbox/nvidia,tegra186-hsp.txt
```
NVIDIA Tegra Hardware Synchronization Primitives (HSP)

The HSP modules are used for the processors to share resources and communicate
together. It provides a set of hardware synchronization primitives for
interprocessor communication. So the interprocessor communication (IPC)
protocols can use hardware synchronization primitives, when operating between
two processors not in an SMP relationship.

The features that HSP supported are shared mailboxes, shared semaphores,
arbitrated semaphores and doorbells.

Required properties:
- name : Should be hsp
- compatible : Should be "nvidia,tegra<chip>-hsp"
- reg : Offset and length of the register set for the device
- interrupts : Should contain the HSP interrupts
- interrupt-names: Should contain the names of the HSP interrupts that the
		   client are using.
		   "doorbell"
- nvidia,hsp-function : Specifies one of the HSP functions that the HSP unit
			will be supported. The function ID can be found in the
			header file <dt-bindings/mailbox/tegra-hsp.h>.
- #mbox-cells : Should be 1. Specifies the HSP master that will be enabled of
		the HSP client. The master ID constants can be found in the
		header file <dt-bindings/mailbox/tegra-hsp.h>.

Example:

hsp_top: hsp@3c00000 {
	compatible = "nvidia,tegra186-hsp";
	reg = <0x0 0x03c00000 0x0 0xa0000>;
	interrupts = <GIC_SPI 176 IRQ_TYPE_LEVEL_HIGH>;
	interrupt-names = "doorbell";
	nvidia,hsp-function = <HSP_DOORBELL>;
	#mbox-cells = <1>;
};

bpmp@d0000000 {
	...
	mboxes = <&hsp_top HSP_DB_MASTER_BPMP>;
	...
};
```

## Documentation/devicetree/bindings/media/allegro.txt
```
Device-tree bindings for the Allegro DVT video IP codecs present in the Xilinx
ZynqMP SoC. The IP core may either be a H.264/H.265 encoder or H.264/H.265
decoder ip core.

Each actual codec engines is controlled by a microcontroller (MCU). Host
software uses a provided mailbox interface to communicate with the MCU. The
MCU share an interrupt.

Required properties:
  - compatible: value should be one of the following
    "allegro,al5e-1.1", "allegro,al5e": encoder IP core
    "allegro,al5d-1.1", "allegro,al5d": decoder IP core
  - reg: base and length of the memory mapped register region and base and
    length of the memory mapped sram
  - reg-names: must include "regs" and "sram"
  - interrupts: shared interrupt from the MCUs to the processing system
  - interrupt-names: "vcu_host_interrupt"

Example:
	al5e: al5e@a0009000 {
		compatible = "allegro,al5e";
		reg = <0 0xa0009000 0 0x1000>,
		      <0 0xa0000000 0 0x8000>;
		reg-names = "regs", "sram";
		interrupt-names = "vcu_host_interrupt";
		interrupts = <0 96 4>;
	};
	al5d: al5d@a0029000 {
		compatible = "allegro,al5d";
		reg = <0 0xa0029000 0 0x1000>,
		      <0 0xa0020000 0 0x8000>;
		reg-names = "regs", "sram";
		interrupt-names = "vcu_host_interrupt";
		interrupts = <0 96 4>;
	};
```
