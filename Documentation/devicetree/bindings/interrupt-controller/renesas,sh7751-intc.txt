## Documentation/devicetree/bindings/leds/leds-lm3632.txt
```
* Texas Instruments - lm3632 Single-Chip Backlight and 1.5-A Flash LED Driver

The LM3632A integrates LED drivers for both
the backlight of the LCD panel and the camera flash
along with the bias power for the LCD panel into one
device.

Required properties:
	- compatible : Can be one of the following
		"ti,lm3632"
	- reg : I2C slave address
	- #address-cells : 1
	- #size-cells : 0

Required child properties:
	- reg : 0 - Indicates a backlight mode
		1 - Indicates a Torch/Strobe (white LED) mode

Required properties for flash LED child nodes:
	See Documentation/devicetree/bindings/leds/common.txt
	- flash-max-microamp : Range from 100mA - 1.5A
	- flash-max-timeout-us : Range from 32ms - 1024ms
	- led-max-microamp : Range from 25mA - 375mA

Optional child properties:
	- label : see Documentation/devicetree/bindings/leds/common.txt
	- linux,default-trigger :
	   see Documentation/devicetree/bindings/leds/common.txt

Example:
led-controller@11 {
	compatible = "ti,lm3632";
	#address-cells = <1>;
	#size-cells = <0>;
	reg = <0x11>;

	led@0 {
		reg = <0>;
		label = "white:backlight";
		linux,default-trigger = "backlight";
	};

	led@1 {
		reg = <1>;
		label = "white:torch";
		led-max-microamp = <375000>;
		flash-max-microamp = <1500000>;
		flash-max-timeout-us = <1000000>;
	};
}

For more product information please see the links below:
http://www.ti.com/product/LM3632
```

## Documentation/devicetree/bindings/leds/leds-lm3633.txt
```
* Texas Instruments - LM3633 Lighting Power Solution for Smartphone Handsets

The LM3633 is a complete power source for
backlight, keypad, and indicator LEDs in smartphone
handsets.

This device is suitable for display and keypad Lighting

Required properties:
	- compatible:
		"ti,lm3633"
	- reg :  I2C slave address
	- #address-cells : 1
	- #size-cells : 0

Optional properties:
	- enable-gpios : GPIO pin to enable/disable the device
	- vled-supply : LED supply

Required child properties:
	- reg : 0 - HVLED is Controlled by bank A
		1 - HVLED is Controlled by bank B
		2,3,4 - LVLED1, 2 and 3 are Controlled by bank C, D and E
		5,6,7 - LVLED4, 5 and 6 are Controlled by bank F, G and H
	- led-sources : Indicates which LED string is associated to which
			control bank.
			0 - LED is not active in this control bank
			1 - LED string is controlled by this control bank

Optional child properties:
	- runtime-ramp-up-msec: Current ramping from one brightness level to
				the a higher brightness level.
				Range from 2048 us - 117.44 s
	- runtime-ramp-down-msec: Current ramping from one brightness level to
				  the a lower brightness level.
				  Range from 2048 us - 117.44 s
	- label : see Documentation/devicetree/bindings/leds/common.txt
	- linux,default-trigger :
	   see Documentation/devicetree/bindings/leds/common.txt

Example:
Control bank C output to 3 LVLEDs and Control F, G and H have independent
controls of the LVLEDs.

led-controller@36 {
	compatible = "ti,lm3633";
	reg = <0x36>;
	#address-cells = <1>;
	#size-cells = <0>;

	enable-gpios = <&gpio1 28 GPIO_ACTIVE_HIGH>;
	led@0 {
		reg = <0>;
		led-sources = < 1 0 1 >;
		label = "white:backlight";
		ramp-up-ms = <100000>;
		ramp-down-ms = <1000>;
		linux,default-trigger = "backlight";
	};

	led@1 {
		reg = <1>;
		led-sources = < 0 1 0 >;
		label = "white:light";
		ramp-up-ms = <100000>;
		ramp-down-ms = <1000>;
	};

	led@2 {
		reg = <2>;
		led-sources = <1>;
		ramp-up-ms = <100000>;
		ramp-down-ms = <1000>;
		label = "white:indicator1";
	};

	led@5 {
		reg = <5>;
		led-sources = <1>;
		ramp-up-ms = <100000>;
		ramp-down-ms = <1000>;
		label = "red:light";
	};

	led@6 {
		reg = <6>;
		led-sources = <1>;
		ramp-up-ms = <41940>;
		ramp-down-ms = <1000>;
		label = "green:light";
	};

	led@7 {
		reg = <7>;
		led-sources = <1>;
		ramp-up-ms = <100000>;
		ramp-down-ms = <1000>;
		label = "blue:light";
	};
};
For more product information please see the link below:
http://www.ti.com/lit/ds/symlink/lm3633.pdf
```

## Documentation/devicetree/bindings/leds/leds-lm3697.txt
```
* Texas Instruments - LM3697 Highly Efficient White LED Driver

The LM3697 11-bit LED driver provides high-
performance backlight dimming for 1, 2, or 3 series
LED strings while delivering up to 90% efficiency.

This device is suitable for display and keypad Lighting

Required properties:
	- compatible:
		"ti,lm3697"
	- reg :  I2C slave address
	- #address-cells : 1
	- #size-cells : 0

Optional properties:
	- enable-gpios : GPIO pin to enable/disable the device
	- vled-supply : LED supply

Required child properties:
	- reg : 0 - LED is Controlled by bank A
		1 - LED is Controlled by bank B
	- led-sources : Indicates which HVLED string is associated to which
			control bank.  Each element in the array is associated
			with a specific HVLED string.  Element 0 is HVLED1,
			element 1 is HVLED2 and element 2 HVLED3.
			Additional information is contained
			in Documentation/devicetree/bindings/leds/common.txt
			0 - HVLED is not active in this control bank
			1 - HVLED string is controlled by this control bank

Optional child properties:
	- runtime-ramp-up-msec: Current ramping from one brightness level to
				the a higher brightness level.
				Range from 2048 us - 117.44 s
	- runtime-ramp-down-msec: Current ramping from one brightness level to
				  the a lower brightness level.
				  Range from 2048 us - 117.44 s
	- label : see Documentation/devicetree/bindings/leds/common.txt
	- linux,default-trigger :
	   see Documentation/devicetree/bindings/leds/common.txt

Example:

HVLED string 1 and 3 are controlled by control bank A and HVLED 2 string is
controlled by control bank B.

led-controller@36 {
	compatible = "ti,lm3697";
	reg = <0x36>;
	#address-cells = <1>;
	#size-cells = <0>;

	enable-gpios = <&gpio1 28 GPIO_ACTIVE_HIGH>;
	vled-supply = <&vbatt>;

	led@0 {
		reg = <0>;
		led-sources = <1 0 1>;
		runtime-ramp-up-msec = <5000>;
		runtime-ramp-down-msec = <1000>;
		label = "white:first_backlight_cluster";
		linux,default-trigger = "backlight";
	};

	led@1 {
		reg = <1>;
		led-sources = <0 1 0>;
		runtime-ramp-up-msec = <500>;
		runtime-ramp-down-msec = <1000>;
		label = "white:second_backlight_cluster";
		linux,default-trigger = "backlight";
	};
}

All HVLED strings controlled by control bank A

led-controller@36 {
	compatible = "ti,lm3697";
	reg = <0x36>;
	#address-cells = <1>;
	#size-cells = <0>;

	enable-gpios = <&gpio1 28 GPIO_ACTIVE_HIGH>;
	vled-supply = <&vbatt>;

	led@0 {
		reg = <0>;
		led-sources = <1 1 1>;
		runtime-ramp-up-msec = <500>;
		runtime-ramp-down-msec = <1000>;
		label = "white:backlight_cluster";
		linux,default-trigger = "backlight";
	};
}

For more product information please see the link below:
http://www.ti.com/lit/ds/symlink/lm3697.pdf
```

## Documentation/devicetree/bindings/leds/leds-mt6323.txt
```
Device Tree Bindings for LED support on MT6323 PMIC

MT6323 LED controller is subfunction provided by
MT6323 PMIC, so the LED controller are defined as
the subnode of the function node provided by MT6323
PMIC controller that is being defined as one kind of
Muti-Function Device (MFD) using shared bus called
PMIC wrapper for each subfunction to access remote
MT6323 PMIC hardware.

For MT6323 MFD bindings see:
Documentation/devicetree/bindings/mfd/mt6397.txt
For MediaTek PMIC wrapper bindings see:
Documentation/devicetree/bindings/soc/mediatek/pwrap.txt

There's sub-node for the LED controller that describes
the initial behavior for each LED physcially and currently
only four LED sub-nodes could be supported.

Required properties:
- compatible : must be "mediatek,mt6323-led"

Optional properties:
- label : (optional)
  see Documentation/devicetree/bindings/leds/common.txt
- linux,default-trigger : (optional)
  see Documentation/devicetree/bindings/leds/common.txt
- default-state: (optional) The initial state of the LED
  see Documentation/devicetree/bindings/leds/common.txt

Example:

&pwrap {
	pmic: mt6323 {
		compatible = "mediatek,mt6323";
		interrupt-parent = <&pio>;
		interrupts = <150 IRQ_TYPE_LEVEL_HIGH>;
		interrupt-controller;
		#interrupt-cells = <2>;

		mt6323led: mt6323led{
			compatible = "mediatek,mt6323-led";

			led0: isink0 {
				lebel = "LED0"
				linux,default-trigger = "timer";
				default-state = "on";
			};
			led1: isink1 {
				label = "LED1";
				default-state = "on";
			};
			led2: isink2 {
				label = "LED2";
				linux,default-trigger = "timer";
				default-state = "off";
			};
		};
	};
};
```

## Documentation/devicetree/bindings/leds/leds-ncp5623.txt
```
* ON Semiconductor - NCP5623 3-Channel LED Driver

The NCP5623 is a 3-channel I2C LED driver. The brightness of each
channel can be independently set using 32 levels. Each LED is represented
as a sub-node of the device.

Required properties:
  - compatible: Should be "onnn,ncp5623"
  - reg: I2C slave address (fixed to 0x38)
  - #address-cells: must be 1
  - #size-cells: must be 0
  - onnn,led-iref-microamp: Current on the Iref pin in microampere. It depends
    on the value of the external bias resistor Rbias, following
    Iref = Vref / Rbias with Vref = 0.6V. This is used to set the intensity of
    the current that can be provided by the internal current source, based on
    the maximum current permitted by LED sub-nodes (see below), but no more than
    Imax = 2400 * Iref.

LED sub-nodes
=============

Required properties:
  - reg : LED channel number (0..2)
  - led-max-microamp: Maximum allowable current inside the LED in microampere.
    This property is used to limit the PWM ratio, based on the intensity of the
    internal current source (see above).

Optional properties:
  - label: see Documentation/devicetree/bindings/leds/common.txt
  - linux,default-trigger: see Documentation/devicetree/bindings/leds/common.txt

Example
=======

led1: ncp5623@38 {
	#address-cells = <1>;
	#size-cells = <0>;
	compatible = "onnn,ncp5623";
	reg = <0x38>;
	onnn,led-iref-microamp = <10>;

	led1r@0 {
		label = "ncp:power:red";
		linux,default-trigger = "default-on";
		reg = <0>;
		led-max-microamp = <20000>;
	};

	led1b@1 {
		label = "ncp:power:blue";
		reg = <1>;
		led-max-microamp = <20000>;
	};

	led1g@2 {
		label = "ncp:power:green";
		reg = <2>;
		led-max-microamp = <20000>;
	};
};
```

## Documentation/devicetree/bindings/leds/leds-pca9532.txt
```
*NXP - pca9532 PWM LED Driver

The PCA9532 family is SMBus I/O expander optimized for dimming LEDs.
The PWM support 256 steps.

Required properties:
	- compatible:
		"nxp,pca9530"
		"nxp,pca9531"
		"nxp,pca9532"
		"nxp,pca9533"
	- reg -  I2C slave address

Optional properties:
	- psc0: 8 bit prescaler value according to NXP data sheet
	- pwm0: 8 bit PWM value according to NXP data sheet
	- psc1: 8 bit prescaler value according to NXP data sheet
	- pwm1: 8 bit PWM value according to NXP data sheet

Each led is represented as a sub-node of the nxp,pca9530.

Optional sub-node properties:
	- label: see Documentation/devicetree/bindings/leds/common.txt
	- type: Output configuration, see dt-bindings/leds/leds-pca9532.h (default NONE)
	- linux,default-trigger: see Documentation/devicetree/bindings/leds/common.txt
	- default-state: see Documentation/devicetree/bindings/leds/common.txt
	  This property is only valid for sub-nodes of type <PCA9532_TYPE_LED>.
	  In addition to the values mentioned in the document above the additional
	  values "pwm0" and "pwm1" are valid. The corresponding LED will blink
	  or will be dimmed depending on the configuration of prescaler and pwm
	  values (see optional node properties above).

Example:
  #include <dt-bindings/leds/leds-pca9532.h>

  leds: pca9530@60 {
    compatible = "nxp,pca9530";
    reg = <0x60>;
    psc0 = <0x97>; // blink frequency 1Hz
    pwm0 = <0x80>; // 50% duty cycle (500ms On / 500ms Off)

    red-power {
      label = "pca:red:power";
      type = <PCA9532_TYPE_LED>;
    };
    green-power {
      label = "pca:green:power";
      type = <PCA9532_TYPE_LED>;
    };
    kernel-booting {
    	type = <PCA9532_TYPE_LED>;
    	default-state = "pwm0";
    };
    sys-stat {
    	type = <PCA9532_TYPE_LED>;
    	default-state = "keep"; // don't touch, was set by U-Boot
    };
  };

For more product information please see the link below:
http://nxp.com/documents/data_sheet/PCA9532.pdf
```
