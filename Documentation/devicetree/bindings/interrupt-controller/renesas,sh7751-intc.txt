## Documentation/devicetree/bindings/media/atmel-isc.txt
```
Atmel Image Sensor Controller (ISC)
----------------------------------------------

Required properties for ISC:
- compatible
	Must be "atmel,sama5d2-isc".
- reg
	Physical base address and length of the registers set for the device.
- interrupts
	Should contain IRQ line for the ISC.
- clocks
	List of clock specifiers, corresponding to entries in
	the clock-names property;
	Please refer to clock-bindings.txt.
- clock-names
	Required elements: "hclock", "iscck", "gck".
- #clock-cells
	Should be 0.
- clock-output-names
	Should be "isc-mck".
- pinctrl-names, pinctrl-0
	Please refer to pinctrl-bindings.txt.

Optional properties for ISC:
- bus-type
	When set to 6, Bt.656 decoding (embedded sync) with CRC decoding
	is enabled. If omitted, then the default bus-type is parallel and
	the additional properties to follow can be specified:
- hsync-active
	Active state of the HSYNC signal, 0/1 for LOW/HIGH respectively.
	If unspecified, this signal is set as active HIGH.
- vsync-active
	Active state of the VSYNC signal, 0/1 for LOW/HIGH respectively.
	If unspecified, this signal is set as active HIGH.
- pclk-sample
	Sample data on rising (1) or falling (0) edge of the pixel clock
	signal. If unspecified, data is sampled on the rising edge.

ISC supports a single port node with parallel bus. It should contain one
'port' child node with child 'endpoint' node. Please refer to the bindings
defined in Documentation/devicetree/bindings/media/video-interfaces.txt.

Example:
isc: isc@f0008000 {
	compatible = "atmel,sama5d2-isc";
	reg = <0xf0008000 0x4000>;
	interrupts = <46 IRQ_TYPE_LEVEL_HIGH 5>;
	clocks = <&isc_clk>, <&iscck>, <&isc_gclk>;
	clock-names = "hclock", "iscck", "gck";
	#clock-cells = <0>;
	clock-output-names = "isc-mck";
	pinctrl-names = "default";
	pinctrl-0 = <&pinctrl_isc_base &pinctrl_isc_data_8bit &pinctrl_isc_data_9_10 &pinctrl_isc_data_11_12>;

	port {
		isc_0: endpoint {
			remote-endpoint = <&ov7740_0>;
			hsync-active = <1>;
			vsync-active = <0>;
			pclk-sample = <1>;
		};
	};
};

i2c1: i2c@fc028000 {
	ov7740: camera@21 {
		compatible = "ovti,ov7740";
		reg = <0x21>;
		clocks = <&isc>;
		clock-names = "xvclk";
		assigned-clocks = <&isc>;
		assigned-clock-rates = <24000000>;

		port {
			ov7740_0: endpoint {
				remote-endpoint = <&isc_0>;
			};
		};
	};
};
```

## Documentation/devicetree/bindings/media/cdns-csi2rx.txt
```
Cadence CSI2RX controller
=========================

The Cadence CSI2RX controller is a CSI-2 bridge supporting up to 4 CSI
lanes in input, and 4 different pixel streams in output.

Required properties:
  - compatible: must be set to "cdns,csi2rx"
  - reg: base address and size of the memory mapped region
  - clocks: phandles to the clocks driving the controller
  - clock-names: must contain:
    * sys_clk: main clock
    * p_clk: register bank clock
    * p_free_clk: free running register bank clock
    * pixel_ifX_clk: pixel stream output clock, one for each stream
                     implemented in hardware, between 0 and 3
    * dphy_rx_clk: D-PHY byte clock, if implemented in hardware
  - phys: phandle to the external D-PHY
  - phy-names: must contain dphy, if the implementation uses an
               external D-PHY

Required subnodes:
  - ports: A ports node with endpoint definitions as defined in
           Documentation/devicetree/bindings/media/video-interfaces.txt. The
           first port subnode should be the input endpoint, the second one the
           outputs

  The output port should have as many endpoints as stream supported by
  the hardware implementation, between 1 and 4, their ID being the
  stream output number used in the implementation.

Example:

csi2rx: csi-bridge@0d060000 {
	compatible = "cdns,csi2rx";
	reg = <0x0d060000 0x1000>;
	clocks = <&byteclock>, <&byteclock>, <&byteclock>,
		 <&coreclock>, <&coreclock>,
		 <&coreclock>, <&coreclock>;
	clock-names = "sys_clk", "p_clk", "p_free_clk",
		      "pixel_if0_clk", "pixel_if1_clk",
		      "pixel_if2_clk", "pixel_if3_clk";

	ports {
		#address-cells = <1>;
		#size-cells = <0>;

		port@0 {
			#address-cells = <1>;
			#size-cells = <0>;
			reg = <0>;

			csi2rx_in_sensor: endpoint@0 {
				reg = <0>;
				remote-endpoint = <&sensor_out_csi2rx>;
				clock-lanes = <0>;
				data-lanes = <1 2>;
			};
		};

		port@1 {
			#address-cells = <1>;
			#size-cells = <0>;
			reg = <1>;

			csi2rx_out_grabber0: endpoint@0 {
				reg = <0>;
				remote-endpoint = <&grabber0_in_csi2rx>;
			};

			csi2rx_out_grabber1: endpoint@1 {
				reg = <1>;
				remote-endpoint = <&grabber1_in_csi2rx>;
			};

			csi2rx_out_grabber2: endpoint@2 {
				reg = <2>;
				remote-endpoint = <&grabber2_in_csi2rx>;
			};

			csi2rx_out_grabber3: endpoint@3 {
				reg = <3>;
				remote-endpoint = <&grabber3_in_csi2rx>;
			};
		};
	};
};
```

## Documentation/devicetree/bindings/media/fsl-emmaprp.txt
```
* Freescale enhanced Multimedia Accelerator (eMMA) video Pre-processor (PrP)
  for i.MX21 & i.MX27 SoCs.

Required properties:
- compatible : Shall contain "fsl,imx21-emmaprp" for compatible with
               the one integrated on i.MX21 SoC.
- reg        : Offset and length of the register set for the device.
- interrupts : Should contain eMMA PrP interrupt number.
- clocks     : Should contain the ahb and ipg clocks, in the order
               determined by the clock-names property.
- clock-names: Should be "ahb", "ipg".

Example:
	emmaprp: emmaprp@10026400 {
		compatible = "fsl,imx21-emmaprp";
		reg = <0x10026400 0x100>;
		interrupts = <51>;
		clocks = <&clks 49>, <&clks 68>;
		clock-names = "ipg", "ahb";
	};
```
