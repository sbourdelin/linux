## Documentation/devicetree/bindings/interrupt-controller/renesas,sh7751-intc.txt
```
DT bindings for the SH7751 interrupt controller

Required properties:

  - compatible: has to be "renesas,sh7751-intc".

  - reg: Base address and length of interrupt controller register
         and extend register.

  - interrupt-controller: Identifies the node as an interrupt controller.

  - #interrupt-cells: has to be <2>: an interrupt index and flags, as defined
    in interrupts.txt in this directory.

Example
-------

 	shintc: interrupt-controller@ffd00000 {
		compatible = "renesas,sh7751-intc";
		#interrupt-cells = <2>;
		#address-cells = <1>;
		#size-cells = <1>;
		interrupt-controller;
		reg = <0xffd00000 14>, <0xfe080000 128>;
	};
```

## Documentation/devicetree/bindings/interrupt-controller/sigma,smp,irqrouter.txt
```
* Sigma Designs Interrupt Router

This module can route X IRQ inputs and Y SW IRQ inputs into Z IRQ outputs,
with X+Y>Z.
For instance X=128, Y=16, Z=24.

Note however that the HW does not latch the IRQ lines, so devices
connecting to the router are expected to latch their IRQ line by themselves.

SW IRQs can be used by firmware running on different parts of the SoC to
communicate with the CPU.
They can be registered by specific drivers, and any entity capable of writing
to the Interrupt Router registers can trigger and clear these interrupts.

A single node in the device tree is used to describe the Interrupt Router.
Since X+Y>Z, some IRQ inputs may need to be routed to the same IRQ output,
thus "sharing the IRQ line".

There are two ways of defining such sharing, either by specifying the number
of IRQ groups, either by listing the IRQ groups and their contents.
In the former case the groups are created and named "implicitly", in the
later case the groups are created "explicitly" by grouping IRQs.
An IRQ group will share an IRQ output, thus all input IRQs falling into that
group will share a given IRQ line.

If SW IRQs are enabled ("swirq-count" != 0), they will *ALL* be grouped
together.

Required properties:
- compatible: Should be "sigma,smp,irqrouter".
- interrupt-controller: Identifies the node as an interrupt controller.
- inputs: The number of IRQ lines entering the router
- outputs: The number of IRQ lines exiting the router
- swirq-count: The number of SW IRQs supported. If 0, none is supported.
- reg: Base address and size of interrupt router registers.
- #interrupt-cells: Should be <3>. Defines how other nodes will be able to
interact with this node. The meaning of the cells are
	* First Cell: SIGMA_HWIRQ, SIGMA_SWIRQ, [SIGMA_IRQGROUP_1, ...,
SIGMA_IRQGROUP_15].
	* Second Cell: IRQ ID
	* Third Cell: IRQ polarity (level high or low).

Optional properties:
- irq-groups: The number of IRQ groups used.
NOTE: if present, it forces implicit group definition.
- irq-group{i}: if 'irq-groups' is not present, then explicit group declaration
may be required, and can be done by creating child nodes of the form:
   irq-group0: {
      shared-irqs = <1 38 56>;
   };
NOTE: the number of groups cannot exceed the number of outputs.
NOTE2: SW IRQs have their own group so the number of total groups is
'irq-groups'+1.
- interrupt-parent: pHandle of the parent interrupt controller, if not
  inherited from the parent node. It should be the GIC.


Example:

See Documentation/devicetree/bindings/interrupt-controller/interrupts.txt and
Documentation/devicetree/bindings/arm/gic.txt for further details.

The following example declares a irqrouter with 128 inputs, 24 outputs, 16
SW IRQs, declaring 4 implicit IRQ groups, with registers @ 0x6F800 and
connected to the GIC.

		irqrouter: irqrouter@6f800 {
			 compatible = "sigma,smp,irqrouter";
			 reg = <0x6f800 0x800>;
			 interrupt-controller;
			 interrupt-parent = <&gic>;

			 #interrupt-cells = <3>;

			 inputs = <128>;
			 outputs = <24>;
			 swirq-count = <16>;

			 irq-groups = <4>;
		};

Devices can then request IRQs using:

a) interrupts = <SIGMA_SWIRQ      10 IRQ_TYPE_LEVEL_HIGH>;
b) interrupts = <SIGMA_HWIRQ      10 IRQ_TYPE_LEVEL_HIGH>;
c) interrupts = <SIGMA_IRQGROUP_2 10 IRQ_TYPE_LEVEL_HIGH>;

Case a) is for SWIRQs: requests SW IRQ 10
Case b) is for non-shared HW IRQs: requests HW IRQ 10, the irqrouter will
assign a direct route from input (10) to a free output reserving an IRQ line on
the parent Interrupt controller.
Case c) is for shared HW IRQs: indeed, SIGMA_IRQGROUP_2 is used as ID, thus the
irqrouter will then route this input (10) to the output assigned to IRQ group 2.

NOTE: SW IRQ 10 and HW IRQ 10 are not the same.

The following example declares the same irqrouter as the preceding example
but using explicit IRQ group declaration.

		irqrouter: irqrouter@6f800 {
			 compatible = "sigma,smp,irqrouter";
			 reg = <0x6f800 0x800>;
			 interrupt-controller;
			 interrupt-parent = <&gic>;

			 #interrupt-cells = <3>;

			 inputs = <128>;
			 outputs = <24>;
			 swirq-count = <16>;

			 irq-group0 {
			       shared-irqs = <1 38 56 11>;
			 };

			 irq-group1 {
			       shared-irqs = <67 68>;
			 };
		};

Devices can then request IRQs using:

d) interrupts = <SIGMA_SWIRQ 10 IRQ_TYPE_LEVEL_HIGH>;
e) interrupts = <SIGMA_HWIRQ 10 IRQ_TYPE_LEVEL_HIGH>;
f) interrupts = <SIGMA_HWIRQ 11 IRQ_TYPE_LEVEL_HIGH>;

Case d) is for SWIRQs: requests SW IRQ 10
Case e) is for non-shared HW IRQs: requests HW IRQ 10, the irqrouter will
assign a direct route from input (10) to a free output reserving an IRQ line on
the parent Interrupt controller.
Case f) is for a shared HW IRQ: indeed, 'irq-group0' lists IRQ 11 as belonging
to a group ('irq-group0' but it is not really important), thus the irqrouter
will route this input (11) to the output assigned to IRQ group 'irq-group0'.

NOTE: SW IRQ 10 and HW IRQ 10 are not the same.
```

## Documentation/devicetree/bindings/interrupt-controller/sigma,smp8642-intc.txt
```
Sigma Designs SMP86xx/SMP87xx secondary interrupt controller

Required properties:
- compatible: should be "sigma,smp8642-intc"
- reg: physical address of MMIO region
- ranges: address space mapping of child nodes
- interrupt-parent: phandle of parent interrupt controller
- interrupt-controller: boolean
- #address-cells: should be <1>
- #size-cells: should be <1>

One child node per control block with properties:
- reg: address of registers for this control block
- interrupt-controller: boolean
- #interrupt-cells: should be <2>, interrupt index and flags per interrupts.txt
- interrupts: interrupt spec of primary interrupt controller

Example:

interrupt-controller@6e000 {
	compatible = "sigma,smp8642-intc";
	reg = <0x6e000 0x400>;
	ranges = <0x0 0x6e000 0x400>;
	interrupt-parent = <&gic>;
	interrupt-controller;
	#address-cells = <1>;
	#size-cells = <1>;

	irq0: irq0 {
		reg = <0x000 0x100>;
		interrupt-controller;
		#interrupt-cells = <2>;
		interrupts = <GIC_SPI 2 IRQ_TYPE_LEVEL_HIGH>;
	};

	irq1: irq1 {
		reg = <0x100 0x100>;
		interrupt-controller;
		#interrupt-cells = <2>;
		interrupts = <GIC_SPI 3 IRQ_TYPE_LEVEL_HIGH>;
	};

	irq2: irq2 {
		reg = <0x300 0x100>;
		interrupt-controller;
		#interrupt-cells = <2>;
		interrupts = <GIC_SPI 4 IRQ_TYPE_LEVEL_HIGH>;
	};
};
```

## Documentation/devicetree/bindings/iommu/hisi,hi6220-iommu.txt
```
Hi6220 SoC SMMU Device Driver devicetree document
=======================================================================
The Architecture of SMMU on Hi6220 SoC:

   +------------------------------------------------------------------+
   |                                                                  |
   |         +---------+  +--------+  +-------------+   +-------+     |
   |         |   ADE   |  |  ISP   |  |  V/J codec  |   |  G3D  |     |
   |         +----|----+  +---|----+  +------|------+   +---|---|     |
   |              |           |              |              |         |
   |     ---------v-----------v--------------v--------------v-----    |
   |                           Media Bus                              |
   |     --------------------------------|---------------|--------    |
   |                                     |               |            |
   |                                 +---v---------------v--------+   |
   |                                 |            SMMU            |   |
   |                                 +----------|---------|-------+   |
   |                                            |         |           |
   +--------------------------------------------|---------|-----------+
                                                |         |
                                   +------------v---------v-----------+
                                   |              DDRC                |
                                   +----------------------------------+

Note:
The media system shared the same smmu IP to access DDR memory. And all
media IP used the same page table.

Below binding describes the system mmu for media system in hi6220 platform

Required properties:
- compatible: should contain "hisilicon,hi6220-smmu".
- reg: A tuple of base address and size of System MMU registers.
- clocks: a list of phandle + clock-specifier pairs, one for each entry
  in clock-names.
- clock-names: should contain:
  * "smmu"
  * "media-sc"
  * "smmu-peri"
- interrupts: An interrupt specifier for interrupt signal of System MMU.
- #iommu-cells: The iommu-cells should be 0. Because no additional information
  needs to be encoded in the specifier.

Examples:
	iommu@f4210000 {
		compatible = "hisilicon,hi6220-smmu";
		reg = <0x0 0xf4210000 0x0 0x1000>;
		interrupts = <GIC_SPI 113 IRQ_TYPE_LEVEL_HIGH>;
		clocks = <&sys_ctrl HI6220_MMU_CLK>,
		         <&media_ctrl HI6220_MED_MMU>,
		         <&sys_ctrl HI6220_MEDIA_PLL_SRC>;
		clock-names = "smmu",
			      "media-sc",
			      "smmu-peri";
		#iommu-cells = <0>;
	};
```

## Documentation/devicetree/bindings/jcore/cpus.txt
```
===================
J-Core cpu bindings
===================

The J-Core processors are open source CPU cores that can be built as FPGA
soft cores or ASICs. The device tree is also responsible for describing the
cache controls and, for SMP configurations, all details of the SMP method,
as documented below.


---------------------
Top-level "cpus" node
---------------------

Required properties:

- #address-cells: Must be 1.

- #size-cells: Must be 0.

Optional properties:

- enable-method: Required only for SMP systems. If present, must be
  "jcore,spin-table".


--------------------
Individual cpu nodes
--------------------

Required properties:

- device_type: Must be "cpu".

- compatible: Must be "jcore,j2".

- reg: Must be 0 on uniprocessor systems, or the sequential, zero-based
  hardware cpu id on SMP systems.

Optional properties:

- clock-frequency: Clock frequency of the cpu in Hz.

- cpu-release-addr: Necessary only for secondary processors on SMP systems
  using the "jcore,spin-table" enable method. If present, must consist of
  two cells containing physical addresses. The first cell contains an
  address which, when written, unblocks the secondary cpu. The second cell
  contains an address from which the cpu will read its initial program
  counter when unblocked.


---------------------
Cache controller node
---------------------

Required properties:

- compatible: Must be "jcore,cache".

- reg: A memory range for the cache controller registers.


--------
IPI node
--------

Device trees for SMP systems must have an IPI node representing the mechanism
used for inter-processor interrupt generation.

Required properties:

- compatible: Must be "jcore,ipi-controller".

- reg: A memory range used to IPI generation.

- interrupts: An irq on which IPI will be received.


----------
CPUID node
----------

Device trees for SMP systems must have a CPUID node representing the mechanism
used to identify the current processor on which execution is taking place.

Required properties:

- compatible: Must be "jcore,cpuid-mmio".

- reg: A memory range containing a single 32-bit mmio register which produces
  the current cpu id (matching the "reg" property of the cpu performing the
  read) when read.
```

## Documentation/devicetree/bindings/jtag/aspeed-jtag.txt
```
Aspeed JTAG driver for ast2400 and ast2500 SoC

Required properties:
- compatible:		Should be one of
      - "aspeed,ast2400-jtag"
      - "aspeed,ast2500-jtag"
- reg			contains the offset and length of the JTAG memory
			region
- clocks		root clock of bus, should reference the APB clock
- interrupts		should contain JTAG controller interrupt

Example:
jtag: jtag@1e6e4000 {
	compatible = "aspeed,ast2500-jtag";
	reg = <0x1e6e4000 0x1c>;
	clocks = <&clk_apb>;
	interrupts = <43>;
};
```

## Documentation/devicetree/bindings/leds/backlight/arcxcnn_bl.txt
```
Binding for ArcticSand arc family LED drivers

Required properties:
- compatible:	"arctic,arc1c0608", "arctic,arc2c0608", "arctic,arc3c0845"
- reg:		slave address

Optional properties:
- default-brightness:	brightness value on boot, value from: 0-4095
- label:		The name of the backlight device
			See Documentation/devicetree/bindings/leds/common.txt
- led-sources:		List of enabled channels from 0 to 5.
			See Documentation/devicetree/bindings/leds/common.txt

- arctic,led-config-0:	setting for register ILED_CONFIG_0
- arctic,led-config-1:	setting for register ILED_CONFIG_1
- arctic,dim-freq:		PWM mode frequence setting (bits [3:0] used)
- arctic,comp-config:	setting for register CONFIG_COMP
- arctic,filter-config:	setting for register FILTER_CONFIG
- arctic,trim-config:	setting for register IMAXTUNE

Note: Optional properties not specified will default to values in IC EPROM

Example:

arc2c0608@30 {
	compatible = "arctic,arc2c0608";
	reg = <0x30>;
	default-brightness = <500>;
	label = "lcd-backlight";
	linux,default-trigger = "backlight";
	led-sources = <0 1 2 5>;
};
```

## Documentation/devicetree/bindings/leds/backlight/tps65217-backlight.txt
```
Texas Instruments TPS65217 backlight regulator

This module is part of the TPS65217. For more details about the whole
TPS65217 chip see Documentation/devicetree/bindings/mfd/tps65217.txt.

The TPS65217 chip contains a boost converter and current sinks which can be
used to drive LEDs for use as backlights.

Required properties:
- compatible: "ti,tps65217-bl"
- backlight: node for specifying WLED1 and WLED2 lines in TPS65217
- isel: selection bit, valid values: 1 for ISEL1 (low-level) and 2 for ISEL2 (high-level)
- fdim: PWM dimming frequency, valid values: 100, 200, 500, 1000
- default-brightness: valid values: 0-100

Each regulator is defined using the standard binding for regulators.

Example:

&tps {
	backlight {
		compatible = "ti,tps65217-bl";
		status = "okay";
		isel = <1>;  /* 1 - ISET1, 2 ISET2 */
		fdim = <100>; /* TPS65217_BL_FDIM_100HZ */
		default-brightness = <50>;
	};
};
```

## Documentation/devicetree/bindings/leds/irled/gpio-ir-tx.txt
```
Device tree bindings for IR LED connected through gpio pin which is used as
remote controller transmitter.

Required properties:
	- compatible: should be "gpio-ir-tx".

Example:
	irled@0 {
		compatible = "gpio-ir-tx";
		gpios = <&gpio1 2 GPIO_ACTIVE_HIGH>;
	};
```
