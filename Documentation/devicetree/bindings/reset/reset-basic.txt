## Documentation/devicetree/bindings/reset/reset-basic.txt
```
Basic single-register reset controller
======================================

This describes a generic reset controller where the reset lines are controlled
by single bits within a 32-bit memory location. The memory location is assumed
to be part of a syscon regmap.

By default the bit will be cleared on deassert. This behaviour can be inverted
with the assert-on-clear property mentioned below.

The bits are assumed to not be auto-clearing, and therefore can be read back to
determine the status.

Reset controller required properties:
 - compatible: should be "reset-basic"
 - #reset-cells: must be set to 1
 - reg: reset register location within regmap

Reset controller optional properties:
 - assert-on-clear: add this property when the hardware should clear (set to 0)
   the bit should to assert the reset.
   When this property is omitted the default is to set the bit to assert the
   reset

Device node required properties:
 - resets phandle
 - bit number, counting from zero, for the desired reset line. Max is 31.

Example:

syscon {
	compatible = "syscon";

	uart_reset: reset-controller@c {
		compatible = "reset-basic";
		#reset-cells = <1>;
		reg = <0xc>;
	};
}

&uart {
	resets = <&uart_rest 4>;
}
```

## Documentation/devicetree/bindings/reset/ti-syscon-reset.txt
```
TI SysCon Reset Controller
=======================

Almost all SoCs have hardware modules that require reset control in addition
to clock and power control for their functionality. The reset control is
typically provided by means of memory-mapped I/O registers. These registers are
sometimes a part of a larger register space region implementing various
functionalities. This register range is best represented as a syscon node to
allow multiple entities to access their relevant registers in the common
register space.

A SysCon Reset Controller node defines a device that uses a syscon node
and provides reset management functionality for various hardware modules
present on the SoC.

SysCon Reset Controller Node
============================
Each of the reset provider/controller nodes should be a child of a syscon
node and have the following properties.

Required properties:
--------------------
 - compatible		: Should be "syscon-reset"
 - #reset-cells		: Should be 1. Please see the reset consumer node below
			  for usage details
 - ti,reset-bits	: Contains the reset control register information
			  Should contain 5 cells for each reset exposed to
			  consumers, defined as:
			    Cell #1 : register offset of the reset control
			              register from the syscon register base
			    Cell #2 : bit shift value for the reset in the
			              respective reset control register
			    Cell #3 : register offset of the reset status
			              register from the syscon register base
			    Cell #4 : bit shift value for the reset in the
			              respective reset status register
			    Cell #5 : Flags used to control reset behavior,
			              availible flags defined in the DT include
			              file <dt-bindings/reset/ti-syscon.h>

SysCon Reset Consumer Nodes
===========================
Each of the reset consumer nodes should have the following properties,
in addition to their own properties.

Required properties:
--------------------
 - resets	: A phandle to the reset controller node and a phandle to a
		  reset specifier node as defined above.

Please also refer to Documentation/devicetree/bindings/reset/reset.txt for
common reset controller usage by consumers.

Example:
--------
The following example demonstrates a syscon node, the reset controller node
using the syscon node, and a consumer (a DSP device) on the TI Keystone 2
Edison SoC.

/ {
	soc {
		psc: power-sleep-controller@02350000 {
			compatible = "syscon", "simple-mfd";
			reg = <0x02350000 0x1000>;

			pscrst: psc-reset {
				compatible = "ti,k2l-pscrst", "syscon-reset";
				#reset-cells = <1>;

				ti,reset-bits = <
					0xa3c 8 0x83c 8 RESET_ASSERT_CLEAR  /* 0: pcrst-dsp0 */
					0xa40 5 0     0 RESET_TRIGGER_SET   /* 1: pcrst-example */
				>;
			};
		};

		dsp0: dsp0 {
			...
			resets = <&pscrst 0>;
			...
		};
	};
};
```

## Documentation/devicetree/bindings/rng/ingenic,jz4780-rng.txt
```
Ingenic jz4780 RNG driver

Required properties:
- compatible : Should be "ingenic,jz4780-rng"
- reg : Specifies base physical address and size of the registers.

Example:

rng: rng@100000D8 {
	compatible = "ingenic,jz4780-rng";
	reg = <0x100000D8 0x8>;
};
```

## Documentation/devicetree/bindings/rng/mxc_rngc.txt
```
Freescale RNGC (Random Number Generator Version C)

Required properties:
- compatible : Should be "fsl,imx25-rng" or "fsl,imx35-rng"
- reg : Offset and length of the register set of this block
- interrupts : the interrupt number for the RNG block
- clocks: should contain the RNG clk source

Example:

rng@53fb0000 {
	compatible = "fsl,imx25-rng";
	reg = <0x53fb0000 0x4000>;
	interrupts = <22>;
	clocks = <&trng_clk>;
};
```

## Documentation/devicetree/bindings/rtc/cpcap-rtc.txt
```
Motorola CPCAP PMIC RTC
------------------------------------

Requires node properties:
- compatible: should contain "motorola,cpcap-rtc"
- interrupts: An interrupt specifier for alarm and 1 Hz irq

Example:

cpcap_rtc: rtc {
	compatible = "motorola,cpcap-rtc";
	interrupts = <39 IRQ_TYPE_NONE>, <26 IRQ_TYPE_NONE>;
};
```

## Documentation/devicetree/bindings/rtc/dallas,ds1341.txt
```
* Dallas DS1341		I2C Serial Real-Time Clock

Required properties:

- compatible: Should contain "dallas,ds1341".

- reg: I2C address for chip

Optional properties:

- disable-oscillator-stop-flag : Configure chip to disable oscillator
  fault detection circuitry

- enable-glitch-filter : Configure chip to enable crystal oscillator
  output glitch filtering

Example:
	ds1341: rtc@68 {
		compatible = "dallas,ds1341";
		disable-oscillator-stop-flag;
		enable-glitch-filter;
		reg = <0x68>;
	};
```

## Documentation/devicetree/bindings/rtc/nxp,pcf85063.txt
```
* NXP PCF85063 Real Time Clock

NXP PCF85063 Real Time Clock

Required properties:
- compatible: Should contain "nxp,pcf85063".
- reg: I2C address for chip.

Optional property:
- nxp,quartz_load_12.5pF: The capacitive load on the quartz is 12.5 pF,
  which differ from the default value of 7 pF

Example:

pcf85063: pcf85063@51 {
	compatible = "nxp,pcf85063";
	reg = <0x51>;
	nxp,quartz_load_12.5pF;
};
```

## Documentation/devicetree/bindings/rtc/pcf8563.txt
```
* Philips PCF8563/Epson RTC8564 Real Time Clock

Philips PCF8563/Epson RTC8564 Real Time Clock

Required properties:
see: Documentation/devicetree/bindings/i2c/trivial-devices.txt

Optional property:
- #clock-cells: Should be 1.
- clocks: Reference to the clock entry.
- clock-output-names:
  overwrite the default clock name "pcf8563-clkout"

Example:

rtcclk: rtcclk {
	compatible = "fixed-clock";
	#clock-cells = <1>;
	clock-frequency = <1>;
	clock-output-names = "rtcclk";
};

pcf8563@51 {
	compatible = "nxp,pcf8563";
	reg = <0x51>;
	#clock-cells = <1>;
	clocks = <&rtcclk 0>;
};
```

## Documentation/devicetree/bindings/rtc/rtc-ds1302.txt
```
* Dallas Semiconductor DS-1302 RTC

Simple device which could be used to store date/time between reboots.

Required properties:
- compatible : Should be "dallas,rtc-ds1302"
- reg : Should be address and size of IO memory region

Examples:

rtc@40900000 {
	compatible = "dallas,rtc-ds1302";
	reg = <0x1700901c 0x1>;
};
```

## Documentation/devicetree/bindings/rtc/rtc-omap.txt
```
TI Real Time Clock

Required properties:
- compatible:
	- "ti,da830-rtc"  - for RTC IP used similar to that on DA8xx SoC family.
	- "ti,am3352-rtc" - for RTC IP used similar to that on AM335x SoC family.
			    This RTC IP has special WAKE-EN Register to enable
			    Wakeup generation for event Alarm. It can also be
			    used to control an external PMIC via the
			    pmic_power_en pin.
	- "ti,am4372-rtc" - for RTC IP used similar to that on AM437X SoC family.
- reg: Address range of rtc register set
- interrupts: rtc timer, alarm interrupts in order
- interrupt-parent: phandle for the interrupt controller

Optional properties:
- system-power-controller: whether the rtc is controlling the system power
  through pmic_power_en
- clocks: Any internal or external clocks feeding in to rtc
- clock-names: Corresponding names of the clocks
- gpio-controller: Mark as gpio controller when using ext_wakeup
- #gpio-cells: Should be set to 2
- ngpios: Number of ext_wakeup sources supported by processor (board)
- ext-wakeup-gpios: List of ext_wakeup sources to configure

Examples:

rtc@1c23000 {
	compatible = "ti,da830-rtc";
	reg = <0x23000 0x1000>;
	interrupts = <19
		      19>;
	interrupt-parent = <&intc>;
	system-power-controller;
	clocks = <&clk_32k_rtc>, <&clk_32768_ck>;
	clock-names = "ext-clk", "int-clk";
};

rtc: rtc@44e3e000 {
	compatible = "ti,am3352-rtc", "ti,da830-rtc";
	reg = <0x44e3e000 0x1000>;
	interrupts = <75
		      76>;
	system-power-controller;
	gpio-controller;
	#gpio-cells = <2>;
	ngpios = <1>;
	ext-wakeup-gpios = <&rtc 0 GPIO_ACTIVE_LOW>;
};
```

## Documentation/devicetree/bindings/rtc/rtc-sd3078.txt
```
SD3078 Real Time Clock
============================

Required properties:
- compatible: Should contain "whwave,sd3078".
- reg: I2C address for chip.

Example:

sd3078: sd3078@32 {
       compatible = "whwave,sd3078";
       reg = <0x32>;
};
```

## Documentation/devicetree/bindings/scsi/hisilicon-sas.txt
```
* HiSilison SAS controller

The HiSilicon SAS controller supports SAS/SATA.

Main node required properties:
  - compatible : value should be as follows:
	(a) "hisilicon,sas-controller-v1" for v1 of HiSilicon SAS controller IP

  - controller-id : identifier for controller in the SoC

  - reg : Address and length of the register sets for the device
   - SAS controller registers
   - SAS controller control registers

  - reset-reg : offset to reset, status, and clock registers in control registers

  - queue-count : number of delivery and completion queues in the controller

  - phy-count : number of phys accessible by the controller

  - interrupts : Interrupts for phys, completion queues, and fatal
		 interrupts:
		  - Each phy has 3 interrupt sources:
			- broadcast
			- phyup
			- abnormal
		  - Each completion queue has 1 interrupt source
		  - Each controller has 2 fatal interrupt sources:
			- ECC
			- AXI bus

Example:
	sas0: sas@c1000000 {
		compatible = "hisilicon,sas-controller-v1";
		controller-id = <0>;
		reg = <0x0 0xc1000000 0x0 0x10000>,
			<0x0 0xc0000000 0x0 0x10000>;
		reset-reg = <0xa60 0x33c 0x5a30 0xa64 0x338>;
		queue-count = <32>;
		phy-count = <8>;
		#interrupt-cells = <2>;
		dma-coherent;
		interrupt-parent = <&mbigen_dsa>;
		interrupts = <259 4>, <263 4>,<264 4>,/* phy irq(0~79) */
				<269 4>,<273 4>,<274 4>,/* phy irq(0~79) */
				<279 4>,<283 4>,<284 4>,/* phy irq(0~79) */
				<289 4>,<293 4>,<294 4>,/* phy irq(0~79) */
				<299 4>,<303 4>,<304 4>,/* phy irq(0~79) */
				<309 4>,<313 4>,<314 4>,/* phy irq(0~79) */
				<319 4>,<323 4>,<324 4>,/* phy irq(0~79) */
				<329 4>,<333 4>,<334 4>,/* phy irq(0~79) */
				<336 1>,<337 1>,<338 1>,<339 1>,<340 1>,
				<341 1>,<342 1>,<343 1>,/* cq irq (80~111) */
				<344 1>,<345 1>,<346 1>,<347 1>,<348 1>,
				<349 1>,<350 1>,<351 1>,/* cq irq (80~111) */
				<352 1>,<353 1>,<354 1>,<355 1>,<356 1>,
				<357 1>,<358 1>,<359 1>,/* cq irq (80~111) */
				<360 1>,<361 1>,<362 1>,<363 1>,<364 1>,
				<365 1>,<366 1>,<367 1>,/* cq irq (80~111) */
				<376 4>,/* chip fatal error irq(120) */
				<381 4>;/* chip fatal error irq(125) */
		status = "okay";
	};
```

## Documentation/devicetree/bindings/serial/acts,owl-uart.txt
```
Actions Semi Owl UART

Required properties:
- compatible :  "acts,s500-uart", "acts,owl-uart" for S500
                "acts,s900-uart", "acts,owl-uart" for S900
- reg        :  Offset and length of the register set for the device.
- interrupts :  Should contain UART interrupt.


Example:

		uart3: serial@b0126000 {
			compatible = "acts,s500-uart", "acts,owl-uart";
			reg = <0xb0126000 0x1000>;
			interrupts = <GIC_SPI 32 IRQ_TYPE_LEVEL_HIGH>;
		};
```

## Documentation/devicetree/bindings/serial/amlogic,meson_uart.txt
```
* Amlogic Meson UART, used in multiple SoCs (e.g. S905, s905X, ...)

Required properties:
- compatible	: "amlogic,meson-uart"
- reg		: offset and length of the register set for the device.
- interrupts	: device interrupt
- clocks	: a list of phandle + clock-specifier pairs, one for each
		    entry in clock names.
- clocks-names	: contains:
   * "xtal" for the baud rate clock
   * "core" for the core clock of none AO UARTs (optional)

e.g.
uart_A: serial@84c0 {
	compatible = "amlogic,meson-uart";
	reg = <0x0 0x84c0 0x0 0x14>;
	pinctrl-0 = <&uart_a_pins &uart_a_cts_rts_pins>;
	interrupts = <GIC_SPI 26 IRQ_TYPE_EDGE_RISING>;
	clocks = <&xtal>, <&clkc CLKID_UART0>;
	clock-names = "xtal", "core";
	status = "ok";
};

Note: Each port should have an alias correctly numbered in "aliases" node.

e.g.
aliases {
	serial0 = &uart_AO;
	serial1 = &uart_A;
};
```

## Documentation/devicetree/bindings/serial/lantiq_asc.txt
```
Lantiq SoC ASC serial controller

Required properties:
- compatible : Should be "lantiq,asc"
- reg : Address and length of the register set for the device
- interrupts: the 3 (tx rx err) interrupt numbers. The interrupt specifier
  depends on the interrupt-parent interrupt controller.

Optional properties:
- clocks: Should contain frequency clock and gate clock
- clock-names: Should be "freq" and "asc"

Example:

asc1: serial@e100c00 {
	compatible = "lantiq,asc";
	reg = <0xE100C00 0x400>;
	interrupt-parent = <&icu0>;
	interrupts = <112 113 114>;
};

asc0: serial@600000 {
	compatible = "lantiq,asc";
	reg = <0x600000 0x100000>;
	interrupt-parent = <&gic>;
	interrupts = <GIC_SHARED 103 IRQ_TYPE_LEVEL_HIGH>,
	<GIC_SHARED 105 IRQ_TYPE_LEVEL_HIGH>,
	<GIC_SHARED 106 IRQ_TYPE_LEVEL_HIGH>;
	clocks = <&pll0aclk SSX4_CLK>, <&clkgate1 GATE_URT_CLK>;
	clock-names = "freq", "asc";
};
```

## Documentation/devicetree/bindings/serial/sifive-serial.txt
```
SiFive asynchronous serial interface (UART)

Required properties:

- compatible: should be "sifive,fu540-c000-uart0" or "sifive,uart0"
- reg: address and length of the register space
- interrupt-parent: should contain a phandle pointing to the SoC interrupt
    controller device node that the UART interrupts are connected to
- interrupts: Should contain the UART interrupt identifier
- clocks: Should contain a clock identifier for the UART's parent clock


Example:

uart0: serial@10010000 {
	compatible = "sifive,uart0";
	interrupt-parent = <&plic0>;
	interrupts = <80>;
	reg = <0x0 0x10010000 0x0 0x1000>;
	clocks = <&prci PRCI_CLK_TLCLK>;
};
```

## Documentation/devicetree/bindings/serial/sprd-uart.txt
```
* Spreadtrum serial UART

Required properties:
- compatible must contain:
  * "sprd,sc9836-uart" for SC9836 and all Spreadtrum SoCs
  This also can be specific with:
  * "sprd, sc9860-uart" for SC9860

- reg: offset and length of the register set for the device
- interrupts: exactly one interrupt specifier
- clocks: phandles to input clocks.

Example:
	uart0: serial@70000000 {
		compatible = "sprd,sc9838-uart",
			     "sprd,sc9836-uart";
		reg = <0x000000 0x100>;
		interrupts = <GIC_SPI 2 IRQ_TYPE_LEVEL_HIGH>;
		clocks = <&ext_26m>;
		status = "disabled";
	};
```
