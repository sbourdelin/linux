## Documentation/devicetree/bindings/serio/ps2-gpio.txt
```
Device-Tree binding for ps/2 gpio device

Required properties:
	- compatible = "ps2-gpio"
	- gpios: data and clock gpio
	- interrupts: Should trigger on the falling edge of the clock line.

Optional properties:
	- write-enable: Indicates whether write function is provided
	to serio device. Possibly providing the write fn will not work, because
	of the tough timing requirements.

Example nodes:

ps2@0 {
	compatible = "ps2-gpio";
	interrupt-parent = <&gpio>;
	interrupts = <23 IRQ_TYPE_EDGE_FALLING>;
	data-gpios = <&gpio 24 GPIO_ACTIVE_HIGH>;
	clk-gpios = <&gpio 23 GPIO_ACTIVE_HIGH>;
	write-enable;
};
```

## Documentation/devicetree/bindings/slimbus/slim-ngd-qcom-ctrl.txt
```
Qualcomm SLIMBus Non Generic Device (NGD) Controller binding

SLIMBus NGD controller is a light-weight driver responsible for communicating
with SLIMBus slaves directly over the bus using messaging interface and
communicating with master component residing on ADSP for bandwidth and
data-channel management

Please refer to slimbus/bus.txt for details of the common SLIMBus bindings.

- compatible:
	Usage: required
	Value type: <stringlist>
	Definition: must be "qcom,slim-ngd"

- reg:
	Usage: required
	Value type: <prop-encoded-array>
	Definition: must specify the base address and size of the controller
		    register blocks.

- reg-names:
	Usage: required
	Value type: <stringlist>
	Definition: must be "ctrl"

- qcom,ngd-id
	Usage: required
	Value type: <u32>
	Definition: ngd instance id in the controller
- dmas
	Usage: required
	Value type: <array of phandles>
	Definition: List of rx and tx dma channels

- dma-names
	Usage: required
	Value type: <stringlist>
	Definition: must be "rx" and "tx".

- interrupts:
	Usage: required
	Value type: <prop-encoded-array>
	Definition: must list controller IRQ.

#address-cells
	Usage: required
	Refer to slimbus/bus.txt for details of the common SLIMBus bindings.

#size-cells
	Usage: required
	Refer to slimbus/bus.txt for details of the common SLIMBus bindings.

= EXAMPLE

slim@91c0000 {
	compatible = "qcom,slim-ngd";
	reg = <0x91c0000 0x2C000>;
	reg-names = "ctrl";
	interrupts = <0 163 0>;
	qcom,ngd-id = <1>;
	dmas =	<&slimbam 3>, <&slimbam 4>;
	dma-names = "rx", "tx";

	#address-cells = <1>;
	#size-cells = <1>;
	codec@1 {
		compatible = "slim217,1a0";
		reg  = <1 0>;
	};
};
```

## Documentation/devicetree/bindings/soc/qcom/qcom,socinfo.txt
```
Qualcomm SoC Information (socinfo) Driver binding

This binding describes the Qualcomm SoC Information Driver, which provides
information such as chip id, chip family, serial number and other such
details about Qualcomm SoCs.

- compatible:
	Usage: required
	Value type: <stringlist>
	Definition: must be "qcom,socinfo"

= EXAMPLE

The following example represents a socinfo node.

	socinfo {
		compatible = "qcom,socinfo";
	};
```

## Documentation/devicetree/bindings/soc/rockchip/power_domain.txt
```
* Rockchip Power Domains

Rockchip processors include support for multiple power domains which can be
powered up/down by software based on different application scenes to save power.

Required properties for power domain controller:
- compatible: Should be one of the following.
	"rockchip,rk3288-power-controller" - for RK3288 SoCs.
	"rockchip,rk3368-power-controller" - for RK3368 SoCs.
- #power-domain-cells: Number of cells in a power-domain specifier.
	Should be 1 for multiple PM domains.
- #address-cells: Should be 1.
- #size-cells: Should be 0.

Required properties for power domain sub nodes:
- reg: index of the power domain, should use macros in:
	"include/dt-bindings/power/rk3288-power.h" - for RK3288 type power domain.
	"include/dt-bindings/power/rk3368-power.h" - for RK3368 type power domain.
- clocks (optional): phandles to clocks which need to be enabled while power domain
	switches state.

Qos Example:

	qos_gpu: qos_gpu@ffaf0000 {
		compatible ="syscon";
		reg = <0x0 0xffaf0000 0x0 0x20>;
	};

Example:

	power: power-controller {
		compatible = "rockchip,rk3288-power-controller";
		#power-domain-cells = <1>;
		#address-cells = <1>;
		#size-cells = <0>;

		pd_gpu {
			reg = <RK3288_PD_GPU>;
			clocks = <&cru ACLK_GPU>;
			pm_qos = <&qos_gpu>;
		};
	};

	 power: power-controller {
                compatible = "rockchip,rk3368-power-controller";
                #power-domain-cells = <1>;
                #address-cells = <1>;
                #size-cells = <0>;

                pd_gpu_1 {
                        reg = <RK3368_PD_GPU_1>;
                        clocks = <&cru ACLK_GPU_CFG>;
                };
        };

Node of a device using power domains must have a power-domains property,
containing a phandle to the power device node and an index specifying which
power domain to use.
The index should use macros in:
	"include/dt-bindings/power/rk3288-power.h" - for rk3288 type power domain.
	"include/dt-bindings/power/rk3368-power.h" - for rk3368 type power domain.

Example of the node using power domain:

	node {
		/* ... */
		power-domains = <&power RK3288_PD_GPU>;
		/* ... */
	};

	node {
                /* ... */
                power-domains = <&power RK3368_PD_GPU_1>;
                /* ... */
        };
```

## Documentation/devicetree/bindings/soc/rockchip/rockchip,reboot-mode.txt
```
Rockchip reboot mode driver

This driver get reboot mode arguments from userspace
and stores it in special register. Then the bootloader
will read it and take different action according the
argument stored.

Required properties:
- compatible: should be "rockchip,reboot-mode"
- regmap: this is phandle to the register map node
- offset: offset in the register map for the storage register (in bytes)
The rest of the properties should follow the generic reboot-mode discription
found in ../../misc/reboot-mode.txt

Examples:
	reboot_mode {
		compatible = "rockchip,reboot-mode";
		rockchip,regmap = <&pmu>;
		offset = <0x40>;
		loader {
			linux,mode = "loader";
			linux,magic = <BOOT_LOADER>;
		};

		maskrom {
			linux,mode = "maskrom";
			linux,magic = <BOOT_MASKROM>;
		};

		recovery {
			linux,mode = "recovery";
			linux,magic = <BOOT_RECOVERY>;
		};

		fastboot {
			linux,mode = "fastboot";
			linux,magic = <BOOT_FASTBOOT>;
		};
	};
```

## Documentation/devicetree/bindings/soc/rockchip/rockchip-reboot.txt
```
Rockchip reboot notifier driver

This driver get reboot mode arguments from userspace
and stores it in special register. Then the bootloader
will read it and take different action according the
argument stored.

Required properties:
- compatible: should be "rockchip,reboot"
- regmap: this is phandle to the register map node
- offset: offset in the register map for the storage register (in bytes)

Examples:
	reboot {
	   compatible = "rockchip,reboot";
	   regmap = <&pmu>;
	   offset = <0x94>;
	};
```

## Documentation/devicetree/bindings/soc/xilinx/xlnx,zynqmp-pm.txt
```
Xilinx Zynq MPSoC Power Management Device Tree Bindings

The zynqmp-pm node describes the power management configurations.

Required properties:
 - compatible		: Must contain:  "xlnx,zynqmp-pm"
 - interrupt-parent	: Interrupt controller the interrupt is routed through
 - interrupts		: Interrupt specifier

Examples:
	zynqmp-firmware {
		compatible = "xlnx,zynqmp-pm";
		interrupt-parent = <&gic>;
		interrupts = <0 35 4>;
	};
```

## Documentation/devicetree/bindings/soc/zte/pd-2967xx.txt
```
* ZTE 2967 SoC Power Domains

2967 processors include support for multiple power domains which are used
to gate power to one or more peripherals on the processor.

Required Properties:
- compatible: should be one of the following.
    * zte,zx296718-pcu - for zx296718 board's power domain.
- reg: physical base address of the controller and length of memory mapped
    region.

Example:

	pcu_domain: pcu@0x00117000 {
		compatible = "zte,zx296718-pcu";
		reg = <0x00117000 0x1000>;
	};
```
