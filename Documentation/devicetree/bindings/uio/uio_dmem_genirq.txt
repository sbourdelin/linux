## Documentation/devicetree/bindings/usb/mediatek,musb.txt
```
MediaTek musb DRC/OTG controller
-------------------------------------------

Required properties:
 - compatible      : should be "mediatek,<soc-model>-musb",
   "mediatek,mtk-musb", soc-model is the name of SoC, such as
   mt2701, when using "mediatek,mtk-musb" compatible string, you
   need SoC specific ones in addition, one of:
   - "mediatek,mt2701-musb"
 - reg             : specifies physical base address and size of
   the registers
 - interrupts      : interrupt used by musb controller
 - interrupt-names : must be "mc"
 - phys            : PHY specifier for the OTG phy
 - phy-names       : should be "usb2-phy"
 - dr_mode         : should be one of "host", "peripheral" or "otg",
   refer to usb/generic.txt
 - clocks          : a list of phandle + clock-specifier pairs, one for
   each entry in clock-names
 - clock-names     : must contain "main","mcu","univpll"
   for clocks of controller

Optional properties:
 - extcon : external connector for VBUS and IDPIN changes detection,
   needed when supports dual-role mode.
 - vbus-supply : reference to the VBUS regulator, needed when supports
   dual-role mode.
 - power-domains   : a phandle to USB power domain node to control USB's
   MTCMOS

Example:

usb2: usb@11200000 {
	compatible = "mediatek,mt2701-musb";
		"mediatek,mtk-musb";
	reg = <0 0x11200000 0 0x1000>;
	interrupts = <GIC_SPI 32 IRQ_TYPE_LEVEL_LOW>;
	interrupt-names = "mc";
	phys = <&u2port2 PHY_TYPE_USB2>;
	phy-names = "usb2-phy";
	vbus-supply = <&usb_vbus>;
	extcon = <&extcon_usb>;
	dr_mode = "otg";
	clocks = <&pericfg CLK_PERI_USB0>,
		 <&pericfg CLK_PERI_USB0_MCU>,
		 <&pericfg CLK_PERI_USB_SLV>;
	clock-names = "main","mcu","univpll";
	power-domains = <&scpsys MT2701_POWER_DOMAIN_IFR_MSC>;
};
```

## Documentation/devicetree/bindings/usb/microchip,pic32-musb.txt
```
Microchip PIC32 MUSB DRC/OTG controller
-------------------------------------------

Required properties:
 - compatible       : should be "microchip,pic32mzda-usb".
 - reg              : offset and length of "MUSB Core Registers" and
                      "USB Clock & Reset Registers".
 - reg-names        : should be "mc", and "usbcr" in order
 - clocks           : clock specifier for the musb controller clock
 - clock-names      : should be "usb_clk"
 - interrupts       : interrupt number for MUSB Core General interrupt
                      and DMA interrupt
 - interrupt-names  : must be "mc" and "dma" in order.
 - phys             : phy specifier for the otg phy.
 - dr_mode          : should be one of "host", "peripheral" or "otg".
 - mentor,multipoint: Should be "1" indicating the musb controller supports
                      multipoint. This is MUSB configuration-specific setting.
 - mentor,num-eps   : Specifies the number of endpoints. This is also a
                      MUSB configuration-specific setting. Should be set to "8".
 - mentor,ram-bits  : Specifies the ram address size. Should be set to "11".
 - mentor,power     : Should be "500". This signifies the controller can supply
                      up to 500mA when operating in host mode.
 - phys             : phandle of the USB phy.
 - usb_overcurrent  : phandle to MUSB over-current note. It should have
                      interrupt number for over-current detection logic.

Optional properties:
 - microchip,fifo-mode: Specifies layout of internal SRAM for end-point fifos.
                        Should be 0 (default) or 1.

Example:
	aliases {
		usb1 = &usb1;
		phy1 = &usb1_phy;
	};

	usb1: hsusb1_core@1f8e3000 {
		compatible = "microchip,pic32mzda-usb";
		reg = <0x1f8e3000 0x1000>,
		      <0x1f884000 0x1000>;
		reg-names = "mc", "usbcr";
		interrupts = <132 IRQ_TYPE_EDGE_RISING>,
			     <133 IRQ_TYPE_LEVEL_HIGH>;
		interrupt-names = "mc", "dma";
		dr_mode = "host";
		mentor,multipoint = <1>;
		mentor,num-eps = <8>;
		mentor,ram-bits = <11>;
		mentor,power = <500>;
		phys = <&usb1_phy>;
		clocks = <&rootclk PB5CLK>;
		clock-names = "usb_clk";
		usb_overcurrent = <&usb1_overcurrent>;
	};

	usb1_phy: hsusb1_phy@1f8e4000 {
		compatible = "usb-nop-xceiv";
		reg = <0x1f8e4000 0x1000>;
		clocks = <&rootclk UPLLCLK>;
		clock-names = "main_clk";
		clock-frequency = <24000000>;
	};

	usb1_overcurrent: hsusb1_oc@0 {
		interrupt-parent = <&gpio1>;
		interrupts = <11 IRQ_TYPE_EDGE_FALLING>;
	};
```

## Documentation/devicetree/bindings/usb/npcm7xx-usb.txt
```
Nuvoton NPCM7XX SoC USB controllers:
-----------------------------

EHCI:
-----

Required properties:
- compatible: "nuvoton,npcm750-ehci"
- interrupts: Should contain the EHCI interrupt

Example:

	ehci@e1800000 {
		compatible = "nuvoton,npcm750-ehci";
		reg = <0xf0806000 0x1000>;
		interrupts = <0 61 4>;
	};
```

## Documentation/devicetree/bindings/usb/ns-usb3-phy.txt
```
Driver for Broadcom Northstar USB 3.0 PHY

Required properties:
- compatible: brcm,ns-usb3-phy
- bus: phandle of brcm,bus-axi

To initialize USB 3.0 PHY driver needs to access various bus cores (devices).
This is why phandle to bcma bus is needed.

Example:
	usb3-phy {
		compatible = "brcm,ns-usb3-phy";
		bus = <&axi>;
	};
```

## Documentation/devicetree/bindings/usb/ohci-da8xx.txt
```
DA8XX USB OHCI controller

Required properties:

 - compatible: Should be "ti,da830-ohci"
 - reg:        Should contain one register range i.e. start and length
 - interrupts: Description of the interrupt line
 - phys:       Phandle for the PHY device
 - phy-names:  Should be "usb-phy"

Optional properties:
 - vbus-supply: Regulator that controls vbus power

Example:

reg_usb_ohci: regulator@0 {
        compatible = "regulator-fixed";
        gpio = <&gpio 109 0>;
        over-current-gpios = <&gpio 36 0>;
        regulator-boot-on;
        enable-active-high;
        regulator-name = "usb_ohci_vbus";
        regulator-min-microvolt = <5000000>;
        regulator-max-microvolt = <5000000>;
};

usb_phy: usb-phy {
        compatible = "ti,da830-usb-phy";
        #phy-cells = <1>;
};

ohci: usb@0225000 {
        compatible = "ti,da830-ohci";
        reg = <0x225000 0x1000>;
        interrupts = <59>;
        phys = <&usb_phy 1>;
        phy-names = "usb-phy";
        vbus-supply = <&reg_usb_ohci>;
};
```

## Documentation/devicetree/bindings/usb/pxa25x-udc.txt
```
PXA25x UDC (USB Device Controller)

The PXA25x and IXP4xx USB Device Controller is different from the
PXA27x UDC described in pxa-usb.txt and is compatible between the
Marvell PXA25x and the Intel IXP4xx devices.

Required properties:
 - compatible: Should be one of
   "marvell,pxa25x-udc"
   "intel,ixp4xx-udc"
   for USB controllers used in device mode.
 - reg: usb device MMIO address space
 - interrupts: single interrupt generated by the UDC IP
 - clocks: input clock of the UDC IP (see clock-bindings.txt)

Optional properties:
 - gpios:
   - gpio activated to control the USB D+ pullup (see gpio.txt)

Example:

usb@c800b000 {
	compatible = "intel,ixp4xx-udc";
	reg = <0xc800b000 0x1000>;
	interrupts = <12 IRQ_TYPE_LEVEL_HIGH>;
	clocks = <&pclk 0>;
};
```

## Documentation/devicetree/bindings/usb/renesas_usb3.txt
```
Renesas Electronics USB3.0 Peripheral driver

Required properties:
  - compatible: Must contain one of the following:
	- "renesas,usb3-peri-r8a7795"
  - reg: Base address and length of the register for the USB3.0 Peripheral
  - interrupts: Interrupt specifier for the USB3.0 Peripheral
  - clocks: A list of phandle + clock specifier pairs

Example:
	usb3_peri0: usb@ee020000 {
		compatible = "renesas,usb3-peri-r8a7795";
		reg = <0 0xee020000 0 0x400>;
		interrupts = <GIC_SPI 104 IRQ_TYPE_LEVEL_HIGH>;
		clocks = <&cpg CPG_MOD 328>;
	};

	usb3_peri1: usb@ee060000 {
		compatible = "renesas,usb3-peri-r8a7795";
		reg = <0 0xee060000 0 0x400>;
		interrupts = <GIC_SPI 100 IRQ_TYPE_LEVEL_HIGH>;
		clocks = <&cpg CPG_MOD 327>;
	};
```

## Documentation/devicetree/bindings/usb/renesas_usbhs.txt
```
Renesas Electronics USBHS driver

Required properties:
  - compatible: "renesas,usbhs-<soctype>", "renesas,rcar-usbhs" as fallback.
	- "renesas,usbhs-r8a7790" (R-Car H2)
	- "renesas,usbhs-r8a7791" (R-Car M2-W)
	- "renesas,usbhs-r8a7792" (R-Car V2H)
	- "renesas,usbhs-r8a7793" (R-Car M2-N)
	- "renesas,usbhs-r8a7794" (R-Car E2)
	- "renesas,usbhs-r8a7795" (R-Car H3)
  - reg: Base address and length of the register for the USBHS
  - interrupts: Interrupt specifier for the USBHS
  - clocks: A list of phandle + clock specifier pairs

Optional properties:
  - renesas,buswait: Integer to use BUSWAIT register
  - renesas,enable-gpio: A gpio specifier to check GPIO determining if USB
			 function should be enabled
  - phys: phandle + phy specifier pair
  - phy-names: must be "usb"
  - dmas: Must contain a list of references to DMA specifiers.
  - dma-names : named "ch%d", where %d is the channel number ranging from zero
                to the number of channels (DnFIFOs) minus one.

Example:
	usbhs: usb@e6590000 {
		compatible = "renesas,usbhs-r8a7790", "renesas,rcar-usbhs";
		reg = <0 0xe6590000 0 0x100>;
		interrupts = <0 107 IRQ_TYPE_LEVEL_HIGH>;
		clocks = <&mstp7_clks R8A7790_CLK_HSUSB>;
	};
```

## Documentation/devicetree/bindings/usb/s3c2410-usb.txt
```
Samsung S3C2410 and compatible SoC USB controller

OHCI

Required properties:
 - compatible: should be "samsung,s3c2410-ohci" for USB host controller
 - reg: address and lenght of the controller memory mapped region
 - interrupts: interrupt number for the USB OHCI controller
 - clocks: Should reference the bus and host clocks
 - clock-names: Should contain two strings
		"usb-bus-host" for the USB bus clock
		"usb-host" for the USB host clock

Example:

usb0: ohci@49000000 {
	compatible = "samsung,s3c2410-ohci";
	reg = <0x49000000 0x100>;
	interrupts = <0 0 26 3>;
	clocks = <&clocks UCLK>, <&clocks HCLK_USBH>;
	clock-names = "usb-bus-host", "usb-host";
};

Samsung S3C2410 and compatible USB device controller

Required properties:
 - compatible: Should be one of the following
	       "samsung,s3c2410-udc"
	       "samsung,s3c2440-udc"
 - reg: address and length of the controller memory mapped region
 - interrupts: interrupt number for the USB device controller
 - clocks: Should reference the bus and host clocks
 - clock-names: Should contain two strings
		"usb-bus-gadget" for the USB bus clock
		"usb-device" for the USB device clock

Optional properties:
 - samsung,vbus-gpio: If present, specifies a gpio that needs to be
   activated for the bus to be powered.
 - samsung,pullup-gpio: If present, specifies a gpio to control the
   USB D+ pullup.

usb1: udc@52000000 {
	compatible = "samsung,s3c2440-udc";
	reg = <0x52000000 0x100000>;
	interrupts = <0 0 25 3>;
	clocks = <&clocks UCLK>, <&clocks HCLK_USBD>;
	clock-names = "usb-bus-gadget", "usb-device";
	samsung,pullup-gpio = <&gpc 5 GPIO_ACTIVE_HIGH>;
};
```
