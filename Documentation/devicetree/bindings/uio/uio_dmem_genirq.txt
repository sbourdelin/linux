## Documentation/devicetree/bindings/uio/uio_dmem_genirq.txt
```
UIO device for dynamic memory allocation
----------------------------------------

When binding the uio_dmem_genirq via the device tree by setting
the of_id from command line, the following OF properties are
used for initialization:

- uio,number-of-dynamic-regions

  Determines the number of dynamically allocated memory regions
  for the device.

- uio,dynamic-regions-sizes

  Sizes of regions to be allocated. It is expected to contain
  at least uio,number-of-dynamic-regions sizes.
```

## Documentation/devicetree/bindings/usb/brcm,bcm7445-ehci.txt
```
Broadcom STB USB EHCI controller

Required properties:
- compatible: should be "brcm,bcm7445-ehci"
- reg: should contain one register range i.e. start and length
- interrupts: description of the interrupt line
- phys: phandle + phy specifier pair
  The specifier should be 0 for the OHCI/EHCI PHY
- phy-supplies-usb-clock: See usb-hcd.txt for details.

Optional properties:
- clocks: A phandle for the EHCI clock

Example:

ehci@f0b00300 {
	compatible = "brcm,bcm7445-ehci";
	reg = <0xf0b00300 0xa8>;
	interrupts = <0x0 0x5a 0x0>;
	interrupt-names = "usb0_ehci_0";
	phys = <&usbphy_0 0x0>;
	clocks = <&usb20>;
	phy-supplies-usb-clock;
};
```

## Documentation/devicetree/bindings/usb/brcm,bcm7445-ohci.txt
```
Broadcom STB USB OHCI controller

Required properties:
- compatible: should be "brcm,bcm7445-ohci"
- reg: should contain one register range i.e. start and length
- interrupts: description of the interrupt line
- phys: phandle + phy specifier pair
  The specifier should be 0 for the OHCI/EHCI PHY

Optional properties:
- clocks: A phandle for the OHCI clock

Example:

ohci@f0b00400 {
	compatible = "brcm,bcm7445-ohci";
	reg = <0xf0b00400 0x58>;
	interrupts = <0x0 0x5b 0x0>;
	interrupt-names = "usb0_ohci_0";
	phys = <&usbphy_0 0x0>;
	clocks = <&usb20>;
};
```

## Documentation/devicetree/bindings/usb/brcm,bcm7445-xhci.txt
```
Broadcom STB USB XHCI controller

Required properties:
- compatible: should be "brcm,bcm7445-xhci"
- reg: should contain one register range i.e. start and length
- interrupts: description of the interrupt line
- phys: phandle + phy specifier pair
  The specifier should be 1 for the XHCI PHY

Optional properties:
- clocks: A phandle for the XHCI clock
- usb3-lpm-capable: determines if platform is USB3 LPM capable

Example:

xhci_0_0: xhci@f0b01000 {
	compatible = "brcm,bcm7445-xhci";
	reg = <0xf0b01000 0x1000>;
	interrupts = <0x0 0x5c 0x0>;
	interrupt-names = "usb0_xhci_0";
	phys = <&usbphy_0 0x1>;
	clocks = <&usb30>;
};
```

## Documentation/devicetree/bindings/usb/brcm,bdc-udc.txt
```
Broadcom USB Device Controller (BDC)
====================================

Required properties:

- compatible: must be one of:
                "brcm,bdc-udc-v0.16"
                "brcm,bdc-udc"
- reg: the base register address and length
- interrupts: ther interrupt line for this controller

Optional properties:

On Broadcom STB platforms, these properties are required:

- phys: phandle to the USB PHY blocks
- clocks: phandle to the functional clock of this block

Example:

        udc@f0b02000 {
                status = "disabled";
                compatible = "brcm,bdc-udc-v0.16";
                reg = <0xf0b02000 0xfc4>;
                interrupts = <0x0 0x60 0x0>;
                phys = <&usbphy_0 0x0>;
                clocks = <&sw_usbd>;
        };
```

## Documentation/devicetree/bindings/usb/brcm,cdru-usb3-ctrl.txt
```
Broadcom Chip Device Resource Unit USB3 register

Required properties:
- compatible: "brcm,cdru-usb3-ctrl"
- reg: Base address and length of the USB registers


Example:

cdru_usb3_ctrl: cdru_usb3_ctrl@6501d144 {
        compatible = "brcm,cdru-usb3-ctrl";
        reg = <0x6501d144 0x4>;
};
```

## Documentation/devicetree/bindings/usb/brcm,icfg-usb.txt
```
Broadcom ICFG USB3 registers

Required properties:
- compatible: "brcm,icfg-usb"
- reg: Base address and length of the USB registers


Example:

icfg_usb3: icfg_usb3@66000900 {
        compatible = "brcm,icfg-usb";
        reg = <0x66000900 0x60>;
};
```

## Documentation/devicetree/bindings/usb/brcm,usb3-idm.txt
```
Broadcom IDM USB3 registers

Required properties:
- compatible: "brcm,usb3-idm"
- reg: Base address and length of the USB registers


Example:

usb3_idm: idm@67000000 {
        compatible = "brcm,usb3-idm";
        reg = <0x67000000 0x2000>;
};
```

## Documentation/devicetree/bindings/usb/cdns3-usb.txt
```
Binding for the Cadence USBSS-DRD controller

Required properties:
  - reg: Physical base address and size of the controller's register areas.
	 Controller has 3 different regions:
	 region 1 - HOST registers area
	 region 2 - DEVICE registers area
	 region 3 - OTG/DRD registers area
  - compatible: Should contain: "cdns,usb3"
  - interrupts: Interrupt specifier. Refer to interrupt bindings.
		Driver supports only single interrupt line.
                This single interrupt is shared between Device,
		host and OTG/DRD part of driver.

Optional propertiesi:
 - maximum-speed : valid arguments are "super-speed", "high-speed" and
                   "full-speed"; refer to usb/generic.txt
 - dr_mode: Should be one of "host", "peripheral" or "otg".
 - phys: reference to the USB PHY
 - phy-names: name of the USB PHY, should be "cdns3,usbphy"


Example:
	usb@f3000000 {
		compatible = "cdns,usb3";
		interrupts = <USB_IRQ  7 IRQ_TYPE_LEVEL_HIGH>;
		reg = <0xf3000000 0x10000	//memory area for HOST registers
			0xf3010000 0x10000	//memory area for DEVICE registers
			0xf3020000 0x10000>;	//memory area for OTG/DRD registers
	};
```

## Documentation/devicetree/bindings/usb/ci-hdrc-qoriq.txt
```
* Freescale QorIQ SoC USB 2.0 Controllers

Required properties:
- compatible: Should be "fsl,ci-qoriq-usb2"
  Wherever applicable, the IP version of the USB controller should
  also be mentioned (for eg. fsl,ci-qoriq-usb2-vX.Y).
  where, X.Y is IP version of USB controller.
- reg: Should contain registers location and length
- interrupts: Should contain controller interrupt
- phy-names: from the *Generic PHY* bindings
- phys: from the *Generic PHY* bindings
- clocks: clock provider specifier
- clock-names: shall be "usb2-clock"
Refer to clk/clock-bindings.txt for generic clock consumer properties

Recommended properties:
- dr_mode: One of "host" or "peripheral".
- phy_type: the type of the phy connected to the core. Should be one
  of "utmi", "utmi_wide", "ulpi", "serial" or "hsic". Without this
  property the PORTSC register won't be touched

Examples:
usb@8600000 {
	compatible =  "fsl,ci-qoriq-usb2",
		      "fsl,ci-qoriq-usb2-v2.5";
	reg = <0x0 0x8600000 0x0 0x1000>;
	interrupts = <0 139 0x4>;
	phy-names = "usb2-phy";
	phys = <&usbphy0>;
	clock-names = "usb2-clock";
	clocks = <&clockgen 4 3>;
	dr_mode = "host";
	phy_type = "ulpi";
};
```

## Documentation/devicetree/bindings/usb/da8xx-usb.txt
```
TI DA8xx MUSB
~~~~~~~~~~~~~
For DA8xx/OMAP-L1x/AM17xx/AM18xx platforms.

Required properties:
~~~~~~~~~~~~~~~~~~~~
 - compatible : Should be set to "ti,da830-musb".

 - reg: Offset and length of the USB controller register set.

 - interrupts: The USB interrupt number.

 - interrupt-names: Should be set to "mc".

 - dr_mode: The USB operation mode. Should be one of "host", "peripheral" or "otg".

 - vbus-supply: Phandle to a regulator providing the USB bus power.

 - ti,usb2-phy-refclock-hz : Integer. Frequency in Hz of the USB 2.0 PHY reference clock,
     either provided by the internal PLL or an external source.
     The supported values are: 12MHz, 13MHz, 19.2MHz, 20MHz, 24MHz, 26MHz, 38.4MHz, 40MHz, 48MHz.


Optional properties:
~~~~~~~~~~~~~~~~~~~~
 - ti,usb2-phy-clkmux-refclkin: Boolean. Defines the USB 2.0 PHY reference clock source.
     If present the the external USB_REFCLKIN pin is used as a clock source, otherwise
     the internal PLL is used.

Example:

	usb20: usb@1e00000 {
		compatible = "ti,da830-musb";
		reg =   <0x00200000 0x10000>;
		interrupt-parent = <&intc>;
		interrupts = <58>;
		interrupt-names = "mc";

		dr_mode = "host";
		vbus-supply = <&usb_vbus>;

		ti,usb2-phy-refclock-hz = <24000000>;

		status = "okay";
	};
```

## Documentation/devicetree/bindings/usb/dwc2.txt
```
Platform DesignWare HS OTG USB 2.0 controller
-----------------------------------------------------

Required properties:
- compatible : One of:
  - brcm,bcm2835-usb: The DWC2 USB controller instance in the BCM2835 SoC.
  - hisilicon,hi6220-usb: The DWC2 USB controller instance in the hi6220 SoC.
  - rockchip,rk3066-usb: The DWC2 USB controller instance in the rk3066 Soc;
  - "rockchip,rk3188-usb", "rockchip,rk3066-usb", "snps,dwc2": for rk3188 Soc;
  - "rockchip,rk3288-usb", "rockchip,rk3066-usb", "snps,dwc2": for rk3288 Soc;
  - "lantiq,arx100-usb": The DWC2 USB controller instance in Lantiq ARX SoCs;
  - "lantiq,xrx200-usb": The DWC2 USB controller instance in Lantiq XRX SoCs;
  - "amlogic,meson8b-usb": The DWC2 USB controller instance in Amlogic Meson8b SoCs;
  - "amlogic,meson-gxbb-usb": The DWC2 USB controller instance in Amlogic S905 SoCs;
  - "amcc,dwc-otg": The DWC2 USB controller instance in AMCC Canyonlands 460EX SoCs;
  - snps,dwc2: A generic DWC2 USB controller with default parameters.
- reg : Should contain 1 register range (address and length)
- interrupts : Should contain 1 interrupt

Optional properties:
- clocks: A list of phandle + clock-specifier pairs for the clocks listed in clock-names.
- clock-names: Contain the following optional clocks on demand:
  - "otg":	AHB clock. It is the scan clock for the core's AHB domain.
  - "pmu":	PMU hclk. Clock to PMU module when hibernation and/or ADP is enabled.
  - "utmi":	UTMI+ clock. Functionally used only when a UTMI PHY is selected,
		but always used as the PHY domain clock during DFT Scan mode.
  - "ulpi":	ULPI PHY clock. Present only when a ULPI PHY is selected; negedge
		is also used in DDR mode.
  - "utmifs":	UTMI FS clock. Present only when OTG_FSPHY_INTERFACE != 0.
Refer to clk/clock-bindings.txt for generic clock consumer properties
- phys: phy provider specifier
- phy-names: shall be "usb2-phy"
Refer to phy/phy-bindings.txt for generic phy consumer properties
- dr_mode: shall be one of "host", "peripheral" and "otg"
  Refer to usb/generic.txt
- g-rx-fifo-size: size of rx fifo size in gadget mode.
- g-np-tx-fifo-size: size of non-periodic tx fifo size in gadget mode.
- g-tx-fifo-size: size of periodic tx fifo per endpoint (except ep0) in gadget mode.

Deprecated properties:
- g-use-dma: gadget DMA mode is automatically detected

Example:

        usb@101c0000 {
                compatible = "ralink,rt3050-usb, snps,dwc2";
                reg = <0x101c0000 40000>;
                interrupts = <18>;
		clocks = <&usb_otg_ahb_clk>;
		clock-names = "otg";
		phys = <&usbphy>;
		phy-names = "usb2-phy";
        };
```

## Documentation/devicetree/bindings/usb/dwc3-uniphier.txt
```
UniPhier DWC3 glue layer

This describes the devicetree bindings for dwc3-uniphier driver implemented on
Socionext UniPhier SoCs.

Required properties:
- compatible:
  - "socionext,uniphier-pxs2-dwc3" : For UniPhier PXs2 SoC
  - "socionext,uniphier-ld20-dwc3" : For UniPhier LD20 SoC
- reg: Address and range of the glue logic
- clocks: List of phandles for the clocks, and the number of phandles depends
	  on SoC platform.

Optional properties:
- resets: List of phandles for the resets, and the number of phandles depends
	on SoC platform.
- nvmem-cells: Phandles to nvmem cell that contains the trimming data.
	Available only for LD20, and if unspecified, default value is used.
- nvmem-cell-names: Should be the following names, which correspond to each
	nvmem-cells. N is the number indicating a port of phy.
	All of the 3 parameters associated with the following names are
	required for each port, if any one is omitted, the trimming data
	of the port will not be set at all.
	- "rtermN", "sel_tN", "hs_iN" : Each cell name for phy parameters

Required child node:
A child node must exist to represent the core DWC3 IP block. The name of
the node is not important. The content of the node is defined in dwc3.txt.

Example:

	usb: usb@65b00000 {
		compatible = "socionext,uniphier-ld20-dwc3";
		reg = <0x65b00000 0x1000>;
		#address-cells = <1>;
		#size-cells = <1>;
		clocks = <&sys_clk 14>, <&sys_clk 16>, <&sys_clk 17>;
		resets = <&sys_rst 12>, <&sys_rst 16>, <&sys_rst 17>,
			 <&sys_rst 18>, <&sys_rst 19>;
		nvmem-cells = <&usb_rterm0>, <&usb_rterm1>,
			      <&usb_rterm2>, <&usb_rterm3>,
			      <&usb_sel_t0>, <&usb_sel_t1>,
			      <&usb_sel_t2>, <&usb_sel_t3>,
			      <&usb_hs_i0>,  <&usb_hs_i0>,
			      <&usb_hs_i2>,  <&usb_hs_i2>;
		nvmem-cell-names = "rterm0", "rterm1", "rterm2", "rterm3",
				   "sel_t0", "sel_t1", "sel_t2", "sel_t3",
				   "hs_i0",  "hs_i1",  "hs_i2",  "hs_i3";
		ranges;

		dwc3@65a00000 {
			compatible = "snps,dwc3";
			reg = <0x65a00000 0xcd00>;
			interrupt-names = "host";
			interrupts = <0 134 4>;
			dr_mode = "host";
		};
	};
```

## Documentation/devicetree/bindings/usb/fotg2-host.txt
```
Faraday FOTG Host controller

Required properties:

- compatible: should be "faraday,fotg210-hcd"
- reg: should contain one register range i.e. start and length
- interrupts: description of the interrupt line

Example for Gemini:

usb@68000000 {
	compatible = "faraday,fotg210-hcd";
	reg = <0x68000000 0x1000>;
	interrupts = <10 IRQ_TYPE_LEVEL_HIGH>;
};
```

## Documentation/devicetree/bindings/usb/generic-onboard-hub.txt
```
Generic Onboard USB HUB

Required properties:
- compatible: should be "generic-onboard-hub"

Optional properties:
- clocks: the input clock for USB HUB.
- clock-frequency: the frequency for HUB's clock.
- reset-gpios: Should specify the GPIO for reset.
- reset-duration-us: the duration for assert reset signal, the time unit
  is microsecond.

Example:

	usb_hub1 {
		compatible = "generic-onboard-hub";
		clocks = <&clks IMX6QDL_CLK_CKO>;
		reset-gpios = <&gpio7 12 GPIO_ACTIVE_LOW>;
		hub-reset-duration-us = <2>;
	};
```

## Documentation/devicetree/bindings/usb/hisilicon-usb.txt
```
* HISILICON USB HUB

Required properties:
- compatible: One of the specific types :"hisilicon,hi3660-dwc3",
			"hisilicon,gpio_hubv1","hisilicon,gpio_hubv2"

Optional properties of devices using ISP1301:
- transceiver: phandle of isp1301 - this helps the ISP1301 driver to find the
               ISP1301 instance associated with the respective USB driver

Example:

	hisi_usb@ff200000 {
		#address-cells = <2>;
		#size-cells = <2>;
		compatible = "hisilicon,hi3660-dwc3";
		reg = <0x0 0xff200000 0x0 0x1000
			 0x0 0xff100000 0x0 0x100000>;
		ranges;
		bc_again_flag = <0>;

		clocks = <&crg_ctrl HI3660_CLK_ABB_USB>,
			 <&crg_ctrl HI3660_ACLK_GATE_USB3OTG>;
		clock-names = "clk_usb3phy_ref", "aclk_usb3otg";
		eye_diagram_param = <0x1c466e3>;
		eye_diagram_host_param = <0x1c466e3>;
		usb3_phy_cr_param = <0xb80>;
		usb3_phy_host_cr_param = <0x980>;
		usb3_phy_tx_vboost_lvl = <0x5>;

		dwc3@ff100000 {
			compatible = "snps,dwc3";
			reg = <0x0 0xff100000 0x0 0x100000>;
			interrupts = <0 159 4>, <0 161 4>;
			dr_mode = "otg";
			maximum-speed = "super-speed";
		};
	};
```
