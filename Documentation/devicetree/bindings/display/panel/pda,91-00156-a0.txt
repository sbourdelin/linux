## Documentation/devicetree/bindings/display/xlnx/xlnx,zynqmp-dpsub.txt
```
Xilinx ZynqMP DisplayPort subsystem
-----------------------------------

Required properties:

- compatible: Must be "xlnx,zynqmp-dpsub-1.7".

- reg: Physical base address and length of the registers set for the device.
- reg-names: Must be "dp", "blend", "av_buf", and "aud" to map logical register
  partitions.

- interrupts: Interrupt number.
- interrupts-parent: phandle for interrupt controller.

- clocks: phandles for axi, audio, non-live video, and live video clocks.
  axi clock is required. Audio clock is optional. If not present, audio will
  be disabled. One of non-live or live video clock should be present.
- clock-names: The identification strings are required. "aclk" for axi clock.
  "dp_aud_clk" for audio clock. "dp_vtc_pixel_clk_in" for non-live video clock.
  "dp_live_video_in_clk" for live video clock (clock from programmable logic).

- phys: phandles for phy specifier.
- phy-names: The identifier strings. "dp-phy" followed by index.

- power-domains: phandle for the corresponding power domain

- ports: crtc and encoder ports are required using DT bindings defined in
  Documentation/devicetree/bindings/graph.txt.

- vid-layer, gfx-layer: Required to represent available layers

Required layer properties

- dmas: phandles for DMA channels as defined in
  Documentation/devicetree/bindings/dma/dma.txt.
- dma-names: The identifier strings are required. "graphics0" for graphics
  layer. "video" followed by index for video layer

Optional child node

- The driver populates any child device node in this node. This can be used,
  for example, to populate the sound device from the DisplayPort subsystem
  driver.

Example:
	zynqmp_dpsub: zynqmp_dpsub@fd4a0000 {
		compatible = "xlnx,zynqmp-dpsub-1.7";
		reg = <0x0 0xfd4a0000 0x0 0x1000>,
		      <0x0 0xfd4aa000 0x0 0x1000>,
		      <0x0 0xfd4ab000 0x0 0x1000>,
		      <0x0 0xfd4ac000 0x0 0x1000>;
		reg-names = "dp", "blend", "av_buf", "aud";
		interrupts = <0 119 4>;
		interrupt-parent = <&gic>;

		clock-names = "dp_apb_clk", "dp_aud_clk", "dp_live_video_in_clk";
		clocks = <&dp_aclk>, <&clkc 17>, <&si570_1>;

		phys = <&lane1 PHY_TYPE_DP 0 1 27000000>,
		       <&lane0 PHY_TYPE_DP 1 1 27000000>;
		phy-names = "dp-phy0", "dp-phy1";

		power-domains = <&pd_dp>;

		#address-cells = <1>;
		#size-cells = <0>;

		vid-layer {
			dma-names = "vid0", "vid1", "vid2";
			dmas = <&xlnx_dpdma 0>,
			       <&xlnx_dpdma 1>,
			       <&xlnx_dpdma 2>;
		};

		gfx-layer {
			dma-names = "gfx0";
			dmas = <&xlnx_dpdma 3>;
		};

		crtc_port: port@0 {
			reg = <0>;
			crtc: endpoint {
				remote-endpoint = <&encoder>;
			};
		};
		port@1 {
			reg = <1>;
			encoder: endpoint {
				remote-endpoint = <&crtc>;
			};
		};
	};
};
```

## Documentation/devicetree/bindings/dma/fsl-qdma.txt
```
NXP Layerscape SoC qDMA Controller
==================================

This device follows the generic DMA bindings defined in dma/dma.txt.

Required properties:

- compatible:		Must be one of
			 "fsl,ls1021a-qdma": for LS1021A Board
			 "fsl,ls1043a-qdma": for ls1043A Board
			 "fsl,ls1046a-qdma": for ls1046A Board
- reg:			Should contain the register's base address and length.
- interrupts:		Should contain a reference to the interrupt used by this
			device.
- interrupt-names:	Should contain interrupt names:
			 "qdma-error": the error interrupt
			 "qdma-queue": the queue interrupt
- fsl,queues:		Should contain number of queues supported.

Optional properties:

- dma-channels:		Number of DMA channels supported by the controller.
- big-endian:		If present registers and hardware scatter/gather descriptors
			of the qDMA are implemented in big endian mode, otherwise in little
			mode.

Examples:

	qdma: dma-controller@8390000 {
		compatible = "fsl,ls1021a-qdma";
		reg = <0x0 0x8398000 0x0 0x2000 /* Controller registers */
		       0x0 0x839a000 0x0 0x2000>; /* Block registers */
		interrupts = <GIC_SPI 185 IRQ_TYPE_LEVEL_HIGH>,
				<GIC_SPI 76 IRQ_TYPE_LEVEL_HIGH>;
		interrupt-names = "qdma-error", "qdma-queue";
		dma-channels = <8>;
		queues = <2>;
		big-endian;
	};

DMA clients must use the format described in dma/dma.txt file.
```

## Documentation/devicetree/bindings/dma/k3dma.txt
```
* Hisilicon K3 DMA controller

See dma.txt first

Required properties:
- compatible: Must be one of
-		"hisilicon,k3-dma-1.0"
-		"hisilicon,hisi-pcm-asp-dma-1.0"
- reg: Should contain DMA registers location and length.
- interrupts: Should contain one interrupt shared by all channel
- #dma-cells: see dma.txt, should be 1, para number
- dma-channels: physical channels supported
- dma-requests: virtual channels supported, each virtual channel
		have specific request line
- clocks: clock required

Example:

Controller:
		dma0: dma@fcd02000 {
			compatible = "hisilicon,k3-dma-1.0";
			reg = <0xfcd02000 0x1000>;
			#dma-cells = <1>;
			dma-channels = <16>;
			dma-requests = <27>;
			interrupts = <0 12 4>;
			clocks = <&pclk>;
		};

Client:
Use specific request line passing from dmax
For example, i2c0 read channel request line is 18, while write channel use 19

		i2c0: i2c@fcb08000 {
			compatible = "snps,designware-i2c";
			dmas =	<&dma0 18          /* read channel */
				 &dma0 19>;        /* write channel */
			dma-names = "rx", "tx";
		};

		i2c1: i2c@fcb09000 {
			compatible = "snps,designware-i2c";
			dmas =	<&dma0 20          /* read channel */
				 &dma0 21>;        /* write channel */
			dma-names = "rx", "tx";
		};




Controller:
		asp_dmac: asp_dmac@E804B000 {
			compatible = "hisilicon,hisi-pcm-asp-dma-1.0";
			reg = <0x0 0xe804b000 0x0 0x1000>;
			#dma-cells = <1>;
			dma-channels = <16>;
			dma-requests = <32>;
			dma-min-chan = <0>;
			dma-used-chans = <0xFFFE>;
			dma-share;
			interrupts = <0 216 4>;
			interrupt-names = "asp_dma_irq";
			status = "ok";
		};

Client:
		i2s2: hisi_i2s {
			compatible = "hisilicon,hisi-i2s";
			reg = <0x0 0xe804f800 0x0 0x400>,
				<0x0 0xe804e000 0x0 0x400>;
			pinctrl-names = "default";
			pinctrl-0 = <&i2s2_pmx_func &i2s2_cfg_func>;
			dmas = <&asp_dmac 18 &asp_dmac 19>;
			dma-names = "rx", "tx";
			#sound-dai-cells = <0>;
		};
```

## Documentation/devicetree/bindings/dma/mtk-cqdma.txt
```
MediaTek Command-Queue DMA Controller
==================================

Required properties:

- compatible:	Must be "mediatek,mt6765-cqdma" for MT6765.
- reg:		Should contain the base address and length for each channel.
- interrupts:	Should contain references to the interrupts for each channel.
- clocks:	Should be the clock specifiers corresponding to the entry in
		clock-names property.
- clock-names:	Should contain "cqdma" entries.
- dma-channels: The number of DMA channels supported by the controller.
- dma-requests: The number of DMA request supported by the controller.
- #dma-cells: 	The length of the DMA specifier, must be <1>. This one cell
		in dmas property of a client device represents the channel
		number.
Example:

        cqdma: dma-controller@10212000 {
		compatible = "mediatek,mt6765-cqdma";
		reg = <0 0x10212000 0 0x1000>;
		interrupts = <GIC_SPI 113 IRQ_TYPE_LEVEL_LOW>,
			<GIC_SPI 114 IRQ_TYPE_LEVEL_LOW>;
		clocks = <&infracfg CLK_IFR_CQ_DMA>;
		clock-names = "cqdma";
		dma-channels = <2>;
		dma-requests = <32>;
		#dma-cells = <1>;
	};

DMA clients must use the format described in dma/dma.txt file.
```

## Documentation/devicetree/bindings/dma/qcom_hidma.txt
```
Qualcomm Technologies HIDMA Channel driver

Required properties:
- compatible: must contain "qcom,hidma-1.0"
- reg: Addresses for the transfer and event channel
- interrupts: Should contain the event interrupt
- desc-count: Number of asynchronous requests this channel can handle
- event-channel: The HW event channel completions will be delivered.
Example:

	hidma_24: dma-controller@0x5c050000 {
		compatible = "qcom,hidma-1.0";
		reg = <0 0x5c050000 0x0 0x1000>,
		      <0 0x5c0b0000 0x0 0x1000>;
		interrupts = <0 389 0>;
		desc-count = <10>;
		event-channel = <4>;
	};
```

## Documentation/devicetree/bindings/dma/qcom_hidma_mgmt.txt
```
Qualcomm Technologies HIDMA Management interface

Qualcomm Technologies HIDMA is a high speed DMA device. It only supports
memcpy and memset capabilities. It has been designed for virtualized
environments.

Each HIDMA HW instance consists of multiple DMA channels. These channels
share the same bandwidth. The bandwidth utilization can be parititioned
among channels based on the priority and weight assignments.

There are only two priority levels and 15 weigh assignments possible.

Other parameters here determine how much of the system bus this HIDMA
instance can use like maximum read/write request and and number of bytes to
read/write in a single burst.

Main node required properties:
- compatible: "qcom,hidma-mgmt-1.0";
- reg: Address range for DMA device
- dma-channels: Number of channels supported by this DMA controller.
- max-write-burst-bytes: Maximum write burst in bytes. A memcpy requested is
  fragmented to multiples of this amount.
- max-read-burst-bytes: Maximum read burst in bytes. A memcpy request is
  fragmented to multiples of this amount.
- max-write-transactions: Maximum write transactions to perform in a burst
- max-read-transactions: Maximum read transactions to perform in a burst
- channel-reset-timeout-cycles: Channel reset timeout in cycles for this SOC.

Sub-nodes:

HIDMA has one or more DMA channels that are used to move data from one
memory location to another.

Each DMA channel is described as a sub-node under the management object.
When a transfer channel is given to the guest operating system, only the channel
object is created. The drivers have support for both flat and hierarchical
configuration.

Required properties:
- compatible: must contain "qcom,hidma-1.0"
- reg: Addresses for the transfer and event channel
- interrupts: Should contain the event interrupt
- desc-count: Number of asynchronous requests this channel can handle
- channel-index: The HW event channel completions will be delivered.

Example:

Hypervisor OS configuration:

	hidma-mgmt@f9984000 = {
		compatible = "qcom,hidma-mgmt-1.0";
		reg = <0xf9984000 0x15000>;
		dma-channels = <6>;
		max-write-burst-bytes = <1024>;
		max-read-burst-bytes = <1024>;
		max-write-transactions = <31>;
		max-read-transactions = <31>;
		channel-reset-timeout-cycles = <0x500>;

		hidma_24: dma-controller@0x5c050000 {
			compatible = "qcom,hidma-1.0";
			reg = <0 0x5c050000 0x0 0x1000>,
			      <0 0x5c0b0000 0x0 0x1000>;
			interrupts = <0 389 0>;
			desc-count = <10>;
			channel-index = <4>;
		};
	};

Guest OS configuration:

	hidma_24: dma-controller@0x5c050000 {
		compatible = "qcom,hidma-1.0";
		reg = <0 0x5c050000 0x0 0x1000>,
		      <0 0x5c0b0000 0x0 0x1000>;
		interrupts = <0 389 0>;
		desc-count = <10>;
		channel-index = <4>;
	};
```

## Documentation/devicetree/bindings/dma/snps,axi-dw-dmac.txt
```
* Synopsys DesignWare AXI DMA Controller

Required properties:
- compatible: "snps,axi-dma-1.01a"
- reg: Address range of the DMAC registers. This should include
  all of the per-channel registers.
- interrupt: Should contain the DMAC interrupt number.
- interrupt-parent: Should be the phandle for the interrupt controller
  that services interrupts for this device.
- dma-channels: Number of channels supported by hardware.
- snps,dma-masters: Number of AXI masters supported by the hardware.
- snps,data-width: Maximum AXI data width supported by hardware.
  (0 - 8bits, 1 - 16bits, 2 - 32bits, ..., 6 - 512bits)
- snps,priority: Priority of channel. Array size is equal to the number of
  dma-channels. Priority value must be programmed within [0:dma-channels-1]
  range. (0 - minimum priority)
- snps,block-size: Maximum block size supported by the controller channel.
  Array size is equal to the number of dma-channels.

Example:

dmac: dma-controller@80000 {
	compatible = "snps,axi-dma-1.01a";
	reg = <0x80000 0x400>;
	clocks = <&core_clk>;
	interrupt-parent = <&intc>;
	interrupts = <27>;

	dma-channels = <4>;
	snps,dma-masters = <2>;
	snps,data-width = <3>;
	snps,block-size = <4096 4096 4096 4096>;
	snps,priority = <0 1 2 3>;
};
```

## Documentation/devicetree/bindings/dma/st_fdma.txt
```
* STMicroelectronics Flexible Direct Memory Access Device Tree bindings

The FDMA is a general-purpose direct memory access controller capable of
supporting 16 independent DMA channels. It accepts up to 32 DMA requests.
The FDMA is based on a Slim processor which require a firmware.

* FDMA Controller

Required properties:
- compatible	: Should be one of
		 - st,stih407-fdma-mpe31-11
		 - st,stih407-fdma-mpe31-12
		 - st,stih407-fdma-mpe31-13
- reg		: Should contain DMA registers location and length
- interrupts	: Should contain one interrupt shared by all channels
- dma-channels	: Number of channels supported by the controller
- #dma-cells	: Must be <3>. See DMA client section below
- clocks	: Must contain an entry for each name in clock-names
- clock-names	: Must contain "fdma_slim, fdma_hi, fdma_low, fdma_ic" entries
See: Documentation/devicetree/bindings/clock/clock-bindings.txt


Example:

	fdma1-app: dma-controller@8e40000 {
		compatible = "st,stih407-fdma-mpe31-11";
		reg = <0x8e40000 0x20000>;
		interrupts = <GIC_SPI 7 IRQ_TYPE_NONE>;
		dma-channels = <16>;
		#dma-cells = <3>;
		clocks = <&CLK_S_C0_FLEXGEN CLK_FDMA>,
			 <&CLK_S_C0_FLEXGEN CLK_TX_ICN_DMU>,
			 <&CLK_S_C0_FLEXGEN CLK_TX_ICN_DMU>,
			 <&CLK_S_C0_FLEXGEN CLK_EXT2F_A9>;
		clock-names = "fdma_slim",
			      "fdma_hi",
			      "fdma_low",
			      "fdma_ic";
		};

* DMA client

Required properties:
- dmas: Comma separated list of dma channel requests
- dma-names: Names of the aforementioned requested channels

Each dmas request consists of 4 cells:
1. A phandle pointing to the FDMA controller
2. The request line number
3. A 32bit mask specifying (see include/linux/platform_data/dma-st-fdma.h)
 -bit 2-0: Holdoff value, dreq will be masked for
	0x0: 0-0.5us
	0x1: 0.5-1us
	0x2: 1-1.5us
 -bit 17: data swap
	0x0: disabled
	0x1: enabled
 -bit 21: Increment Address
	0x0: no address increment between transfers
	0x1: increment address between transfers
 -bit 22: 2 STBus Initiator Coprocessor interface
	0x0: high priority port
	0x1: low priority port
4. transfers type
 0 free running
 1 paced

Example:

	sti_uni_player2: sti-uni-player@2 {
		compatible = "st,sti-uni-player";
		status = "disabled";
		#sound-dai-cells = <0>;
		st,syscfg = <&syscfg_core>;
		clocks = <&clk_s_d0_flexgen CLK_PCM_2>;
		assigned-clocks = <&clk_s_d0_flexgen CLK_PCM_2>;
		assigned-clock-parents = <&clk_s_d0_quadfs 2>;
		assigned-clock-rates = <50000000>;
		reg = <0x8D82000 0x158>;
		interrupts = <GIC_SPI 86 IRQ_TYPE_NONE>;
		dmas = <&fdma0 4 0 1>;
		dai-name = "Uni Player #1 (DAC)";
		dma-names = "tx";
		st,uniperiph-id = <2>;
		st,version = <5>;
		st,mode = "PCM";
	};
```
