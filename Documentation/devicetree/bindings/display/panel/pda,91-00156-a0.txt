## Documentation/devicetree/bindings/display/ste,mcde.txt
```
ST-Ericsson Multi Channel Display Engine MCDE

The ST-Ericsson MCDE is a display controller with support for compositing
and displaying several channels memory resident graphics data on DSI or
LCD displays or bridges. It is used in the ST-Ericsson U8500 platform.

Required properties:

- compatible: must be:
  "ste,mcde"
- reg: register base for the main MCDE control registers, should be
  0x1000 in size
- interrupts: the interrupt line for the MCDE
- epod-supply: a phandle to the EPOD regulator
- vana-supply: a phandle to the analog voltage regulator
- clocks: an array of the MCDE clocks in this strict order:
  MCDECLK (main MCDE clock), LCDCLK (LCD clock), PLLDSI
  (HDMI clock), DSI0ESCLK (DSI0 energy save clock),
  DSI1ESCLK (DSI1 energy save clock), DSI2ESCLK (DSI2 energy
  save clock)
- clock-names: must be the following array:
  "mcde", "lcd", "hdmi", "dsi0", "dsi1", "dsi0es", "dsi1es", "dsi2es"
  to match the required clock inputs above.
- #address-cells: should be <1> (for the DSI hosts that will be children)
- #size-cells: should be <1> (for the DSI hosts that will be children)
- ranges: this should always be stated

Required subnodes:

The devicetree must specify subnodes for the DSI host adapters.
These must have the following characteristics:

- compatible: must be:
  "ste,mcde-dsi"
- reg: must specify the register range for the DSI host
- vana-supply: phandle to the VANA voltage regulator
- #address-cells: should be <1>
- #size-cells: should be <0>

Display panels and bridges will appear as children on the DSI hosts, and
the displays are connected to the DSI hosts using the common binding
for video transmitter interfaces; see
Documentation/devicetree/bindings/media/video-interfaces.txt

If a DSI host is unused (not connected) it will have no children or ports
defined.

Example:

mcde@a0350000 {
	compatible = "ste,mcde";
	reg = <0xa0350000 0x1000>;
	interrupts = <GIC_SPI 48 IRQ_TYPE_LEVEL_HIGH>;
	epod-supply = <&db8500_b2r2_mcde_reg>;
	vana-supply = <&ab8500_ldo_ana_reg>;
	clocks = <&prcmu_clk PRCMU_MCDECLK>, /* Main MCDE clock */
		 <&prcmu_clk PRCMU_LCDCLK>, /* LCD clock */
		 <&prcmu_clk PRCMU_PLLDSI>, /* HDMI clock */
		 <&prcmu_clk PRCMU_DSI0CLK>, /* DSI 0 */
		 <&prcmu_clk PRCMU_DSI1CLK>, /* DSI 1 */
		 <&prcmu_clk PRCMU_DSI0ESCCLK>, /* TVout clock 0 */
		 <&prcmu_clk PRCMU_DSI1ESCCLK>, /* TVout clock 1 */
		 <&prcmu_clk PRCMU_DSI2ESCCLK>; /* TVout clock 2 */
	clock-names = "mcde", "lcd", "hdmi", "dsi0", "dsi1",
		    "dsi0es", "dsi1es", "dsi2es";
	#address-cells = <1>;
	#size-cells = <1>;
	ranges;

	dsi0: dsi@a0351000 {
		compatible = "ste,mcde-dsi";
		reg = <0xa0351000 0x1000>;
		vana-supply = <&ab8500_ldo_ana_reg>;
		#address-cells = <1>;
		#size-cells = <0>;
		port {
			dsi0_out: endpoint {
				remote-endpoint = <&panel_in>;
			};
		};

		panel: display {
			compatible = "samsung,s6d16d0";
			reg = <0>;
			vdd1-supply = <&ab8500_ldo_aux1_reg>;
			reset-gpios = <&gpio2 1 GPIO_ACTIVE_LOW>;

			port {
				panel_in: endpoint {
					remote-endpoint = <&dsi0_out>;
				};
			};
		};

	};
	dsi1: dsi@a0352000 {
		compatible = "ste,mcde-dsi";
		reg = <0xa0352000 0x1000>;
		vana-supply = <&ab8500_ldo_ana_reg>;
		#address-cells = <1>;
		#size-cells = <0>;
	};
	dsi2: dsi@a0353000 {
		compatible = "ste,mcde-dsi";
		reg = <0xa0353000 0x1000>;
		vana-supply = <&ab8500_ldo_ana_reg>;
		#address-cells = <1>;
		#size-cells = <0>;
	};
};
```

## Documentation/devicetree/bindings/display/sunxi/sun6i-dsi.txt
```
Allwinner A31 DSI Encoder
=========================

The DSI pipeline consists of two separate blocks: the DSI controller
itself, and its associated D-PHY.

DSI Encoder
-----------

The DSI Encoder generates the DSI signal from the TCON's.

Required properties:
  - compatible: value must be one of:
    * allwinner,sun6i-a31-mipi-dsi
  - reg: base address and size of memory-mapped region
  - interrupts: interrupt associated to this IP
  - clocks: phandles to the clocks feeding the DSI encoder
    * bus: the DSI interface clock
    * mod: the DSI module clock
  - clock-names: the clock names mentioned above
  - phys: phandle to the D-PHY
  - phy-names: must be "dphy"
  - resets: phandle to the reset controller driving the encoder

  - ports: A ports node with endpoint definitions as defined in
    Documentation/devicetree/bindings/media/video-interfaces.txt. The
    port should be the input endpoint, usually coming from the
    associated TCON.

D-PHY
-----

Required properties:
  - compatible: value must be one of:
    * allwinner,sun6i-a31-mipi-dphy
  - reg: base address and size of memory-mapped region
  - clocks: phandles to the clocks feeding the DSI encoder
    * bus: the DSI interface clock
    * mod: the DSI module clock
  - clock-names: the clock names mentioned above
  - resets: phandle to the reset controller driving the encoder

Example:

dsi0: dsi@01ca0000 {
	compatible = "allwinner,sun6i-a31-mipi-dsi";
	reg = <0x01ca0000 0x1000>;
	interrupts = <GIC_SPI 89 IRQ_TYPE_LEVEL_HIGH>;
	clocks = <&ccu CLK_BUS_MIPI_DSI>,
		 <&ccu CLK_DSI_SCLK>;
	clock-names = "bus", "mod";
	resets = <&ccu RST_BUS_MIPI_DSI>;
	phys = <&dphy0>;
	phy-names = "dphy";
	#address-cells = <1>;
	#size-cells = <0>;

	ports {
		#address-cells = <1>;
		#size-cells = <0>;

		dsi0_in: port@0 {
			#address-cells = <1>;
			#size-cells = <0>;
			reg = <0>;

			dsi0_in_tcon0: endpoint@0 {
				reg = <0>;
				remote-endpoint = <&tcon0_out_dsi0>;
			};
		};
	};
};

dphy0: d-phy@01ca1000 {
	compatible = "allwinner,sun6i-a31-mipi-dphy";
	reg = <0x01ca1000 0x1000>;
	clocks = <&ccu CLK_BUS_MIPI_DSI>,
		 <&ccu CLK_DSI_DPHY>;
	clock-names = "bus", "mod";
	resets = <&ccu RST_BUS_MIPI_DSI>;
	#address-cells = <1>;
	#size-cells = <0>;
	#phy-cells = <0>;
};
```

## Documentation/devicetree/bindings/display/ti/ti,omap-dss.txt
```
Texas Instruments OMAP Display Subsystem
========================================

Generic Description
-------------------

This document is a generic description of the OMAP Display Subsystem bindings.
Binding details for each OMAP SoC version are described in respective binding
documentation.

The OMAP Display Subsystem (DSS) hardware consists of DSS Core, DISPC module and
a number of encoder modules. All DSS versions contain DSS Core and DISPC, but
the encoder modules vary.

The DSS Core is the parent of the other DSS modules, and manages clock routing,
integration to the SoC, etc.

DISPC is the display controller, which reads pixels from the memory and outputs
a RGB pixel stream to encoders.

The encoder modules encode the received RGB pixel stream to a video output like
HDMI, MIPI DPI, etc.

DISPC
-----

Optional properties:
- max-memory-bandwidth: Input memory (from main memory to dispc) bandwidth limit
			in bytes per second
- plane: Child node(s) which defines which logical plane are available to
	the system. If at least one plane child node is defined then
	only planes defined by these nodes will be available to the system.
	Plane nodes must be sequential starting with reg = <0> as DT parsing
	will stop on the first missing numbered node.
	This means if plane #1 is defined but plane #0 is not then it will
	be as if none of the plane nodes were defined.

	Each plane node contains the following properties:
	Required properties:
	- reg:       Used to number the logical plane
	- hw-planes: One or two HW plane number(s).
		     When 2 numbers are present this indicates a virtual plane
		     composed of two physical planes intended to be used
		     when the display is larger then the capacity of a
		     single plane i.e. wider than 2048 pixels.
		     The first number in the pair will dictate the capabilities
		     of the virtual plane. This means that for proper
		     operation the virtual plane should be composed of HW
		     planes of the same capabilities.
		     If GFX plane is used in a virtual plane it should be
		     specified first, otherwise unexpected behavior would
		     be encountered.
	Optional property:
	- hw-crtcs:  One or more HW crtc number(s).
		     Describe the list of CRTCs on which this plane is
		     available. If this node is not present then the
		     plane will be available on all available CRTCs.

Video Ports
-----------

The DSS Core and the encoders have video port outputs. The structure of the
video ports is described in Documentation/devicetree/bindings/graph.txt,
and the properties for the ports and endpoints for each encoder are
described in the SoC's DSS binding documentation.

The video ports are used to describe the connections to external hardware, like
panels or external encoders.

Aliases
-------

The board dts file may define aliases for displays to assign "displayX" style
name for each display. If no aliases are defined, a semi-random number is used
for the display.

Example
-------

A shortened example of the DSS description for OMAP4, with non-relevant parts
removed, defined in omap4.dtsi:

dss: dss@58000000 {
	compatible = "ti,omap4-dss";
	reg = <0x58000000 0x80>;
	status = "disabled";
	ti,hwmods = "dss_core";
	clocks = <&dss_dss_clk>;
	clock-names = "fck";
	#address-cells = <1>;
	#size-cells = <1>;
	ranges;

	dispc@58001000 {
		compatible = "ti,omap4-dispc";
		reg = <0x58001000 0x1000>;
		interrupts = <GIC_SPI 25 IRQ_TYPE_LEVEL_HIGH>;
		ti,hwmods = "dss_dispc";
		clocks = <&dss_dss_clk>;
		clock-names = "fck";
	};

	hdmi: encoder@58006000 {
		compatible = "ti,omap4-hdmi";
		reg = <0x58006000 0x200>,
		      <0x58006200 0x100>,
		      <0x58006300 0x100>,
		      <0x58006400 0x1000>;
		reg-names = "wp", "pll", "phy", "core";
		interrupts = <GIC_SPI 101 IRQ_TYPE_LEVEL_HIGH>;
		status = "disabled";
		ti,hwmods = "dss_hdmi";
		clocks = <&dss_48mhz_clk>, <&dss_sys_clk>;
		clock-names = "fck", "sys_clk";
	};
};

A shortened example of the board description for OMAP4 Panda board, defined in
omap4-panda.dts.

The Panda board has a DVI and a HDMI connector, and the board contains a TFP410
chip (MIPI DPI to DVI encoder) and a TPD12S015 chip (HDMI ESD protection & level
shifter). The video pipelines for the connectors are formed as follows:

DSS Core --(MIPI DPI)--> TFP410 --(DVI)--> DVI Connector
OMAP HDMI --(HDMI)--> TPD12S015 --(HDMI)--> HDMI Connector

/ {
	aliases {
		display0 = &dvi0;
		display1 = &hdmi0;
	};

	tfp410: encoder@0 {
		compatible = "ti,tfp410";
		gpios = <&gpio1 0 GPIO_ACTIVE_LOW>;	/* 0, power-down */

		pinctrl-names = "default";
		pinctrl-0 = <&tfp410_pins>;

		ports {
			#address-cells = <1>;
			#size-cells = <0>;

			port@0 {
				reg = <0>;

				tfp410_in: endpoint@0 {
					remote-endpoint = <&dpi_out>;
				};
			};

			port@1 {
				reg = <1>;

				tfp410_out: endpoint@0 {
					remote-endpoint = <&dvi_connector_in>;
				};
			};
		};
	};

	dvi0: connector@0 {
		compatible = "dvi-connector";
		label = "dvi";

		i2c-bus = <&i2c3>;

		port {
			dvi_connector_in: endpoint {
				remote-endpoint = <&tfp410_out>;
			};
		};
	};

	tpd12s015: encoder@1 {
		compatible = "ti,tpd12s015";

		pinctrl-names = "default";
		pinctrl-0 = <&tpd12s015_pins>;

		gpios = <&gpio2 28 GPIO_ACTIVE_HIGH>,	/* 60, CT CP HPD */
			<&gpio2 9 GPIO_ACTIVE_HIGH>,	/* 41, LS OE */
			<&gpio2 31 GPIO_ACTIVE_HIGH>;	/* 63, HPD */

		ports {
			#address-cells = <1>;
			#size-cells = <0>;

			port@0 {
				reg = <0>;

				tpd12s015_in: endpoint@0 {
					remote-endpoint = <&hdmi_out>;
				};
			};

			port@1 {
				reg = <1>;

				tpd12s015_out: endpoint@0 {
					remote-endpoint = <&hdmi_connector_in>;
				};
			};
		};
	};

	hdmi0: connector@1 {
		compatible = "hdmi-connector";
		label = "hdmi";

		port {
			hdmi_connector_in: endpoint {
				remote-endpoint = <&tpd12s015_out>;
			};
		};
	};
};

&dss {
	status = "ok";

	pinctrl-names = "default";
	pinctrl-0 = <&dss_dpi_pins>;

	port {
		dpi_out: endpoint {
			remote-endpoint = <&tfp410_in>;
			data-lines = <24>;
		};
	};
};

&hdmi {
	status = "ok";
	vdda-supply = <&vdac>;

	pinctrl-names = "default";
	pinctrl-0 = <&dss_hdmi_pins>;

	port {
		hdmi_out: endpoint {
			remote-endpoint = <&tpd12s015_in>;
		};
	};
};

A short example on how to define a virtual plane configuration
to enable wide display support.
Here we define:
- plane#0 to be the HW plane #0 (i.e. GFX plane)
	  only available on crtc #0
- plane#1 to be a virtual wide plane composed of HW plane #1 and #2
	  (i.e. VID1 & VID2) available on crtc #0 & #1
- plane#2 to be the HW plane #3 (i.e. VID3 plane)
	  only available on crtc #0

&dss {
        dispc@58001000 {
                #address-cells = <1>;
                #size-cells = <0>;

                plane@0 {
                        reg = <0>;
                        hw-planes = <0>;
                        hw-crtcs = <0>;
                };

                plane@1 {
                        reg = <1>;
                        hw-planes = <1 2>;
                        hw-crtcs = <0 1>;
                };

                plane@2 {
                        reg = <2>;
                        hw-planes = <3>;
                        hw-crtcs = <0>;
                };
        };
};
```

## Documentation/devicetree/bindings/display/truly,nt35597.txt
```
Truly model NT35597 1440x2560 DSI Panel

Required properties:
- compatible: should be "truly,nt35597"
- vdda-supply: phandle of the regulator that provides the supply voltage
  Power IC supply
- vdispp-supply: phandle of the regulator that provides the supply voltage
  for positive LCD bias
- vdispn-supply: phandle of the regulator that provides the supply voltage
  for negative LCD bias
- reset-gpios: phandle of gpio for reset line
  This should be 8mA, gpio can be configured using mux, pinctrl, pinctrl-names
- mode-gpios: phandle of the gpio for choosing the mode of the display
  for single DSI or Dual DSI
  This should be low for dual DSI and high for single DSI mode
- display-timings: Node for the Panel timings
- ports: This device has two video ports driven by two DSIs. Their connections
  are modelled using the OF graph bindings specified in
  Documentation/devicetree/bindings/graph.txt.
  - port@0: DSI input port driven by master DSI
  - port@1: DSI input port driven by secondary DSI

Example:

	dsi@ae94000 {
		panel@0 {
			compatible = "truly,nt35597";
			reg = <0>;
			vdda-supply = <&pm8998_l14>;
			vdispp-supply = <&lab_regulator>;
			vdispn-supply = <&ibb_regulator>;
			pinctrl-names = "default", "suspend";
			pinctrl-0 = <&dpu_dsi_active>;
			pinctrl-1 = <&dpu_dsi_suspend>;

			reset-gpios = <&tlmm 6 0>;
			mode-gpios = <&tlmm 52 0>;
			display-timings {
				timing0: timing-0 {
					clock-frequency = <268316138>;
					hactive = <1440>;
					vactive = <2560>;
					hfront-porch = <200>;
					hback-porch = <64>;
					hsync-len = <32>;
					vfront-porch = <8>;
					vback-porch = <7>;
					vsync-len = <1>;
				};
			};
			ports {
				#address-cells = <1>;
				#size-cells = <0>;
				port@0 {
					reg = <0>;
					panel0_in: endpoint {
						remote-endpoint = <&dsi0_out>;
					};
				};

				port@1 {
					reg = <1>;
					panel1_in: endpoint {
						remote-endpoint = <&dsi1_out>;
					};
				};
			};
		};
	};
```

## Documentation/devicetree/bindings/display/xlnx/xlnx,kms.txt
```
Xilinx KMS Pipeline
-------------------

Xilinx display pipelines can be designed with hardened video IPs and soft video
IPs in programmable logic. This KMS module provides the common functionality
of individual subdevice drivers, and glue logics between them.

Required properties:

- compatible: Must be "xlnx,kms".

- ports: phandles for CRTC ports, using the DT bindings defined in
  Documentation/devicetree/bindings/graph.txt.

Example:

	xlnx_drm: xlnx_drm {
		compatible = "xlnx,kms";
		ports = <&crtc_port>;
	};
```
