## Documentation/devicetree/bindings/display/panel/pda,91-00156-a0.txt
```
PDA 91-00156-A0 5.0" WVGA TFT LCD panel

Required properties:
- compatible: should be "pda,91-00156-a0"

This binding is compatible with the simple-panel binding, which is specified
in simple-panel.txt in this directory.
```

## Documentation/devicetree/bindings/display/panel/raspberrypi,7inch-touchscreen-panel.txt
```
Official 7" (800x480) Raspberry Pi touchscreen panel's panel.

This binding is compatible with the simple-panel binding, which is specified
in simple-panel.txt in this directory.

Required properties:
- compatible:	Must be "raspberrypi,7inch-touchscreen-panel"
```

## Documentation/devicetree/bindings/display/panel/seiko,43wvf1g.txt
```
Seiko Instruments Inc. 4.3" WVGA (800 x RGB x 480) TFT with Touch-Panel

Required properties:
- compatible: should be "sii,43wvf1g".
- "DVDD-supply": 3v3 digital regulator.
- "AVDD-supply": 5v analog regulator.

Optional properties:
- backlight: phandle for the backlight control.

Example:

	panel {
		compatible = "sii,43wvf1g";
		backlight = <&backlight_display>;
		DVDD-supply = <&reg_lcd_3v3>;
		AVDD-supply = <&reg_lcd_5v>;
		port {
			panel_in: endpoint {
				remote-endpoint = <&display_out>;
			};
		};
	};
```

## Documentation/devicetree/bindings/display/panel/sharp,lq035q7db03.txt
```
Sharp LQ035Q7DB03 3.5" QVGA TFT LCD panel

Required properties:
- compatible: should be "sharp,lq035q7db03"

This binding is compatible with the simple-panel binding, which is specified
in simple-panel.txt in this directory.
```

## Documentation/devicetree/bindings/display/panel/sharp,lq150x1lg11.txt
```
Sharp 15" LQ150X1LG11 XGA TFT LCD panel

Required properties:
- compatible: should be "sharp,lq150x1lg11"

This binding is compatible with the simple-panel binding, which is specified
in simple-panel.txt in this directory.
```

## Documentation/devicetree/bindings/display/panel/simple-panel.txt
```
Simple display panel

Required properties:
- power-supply: regulator to provide the supply voltage

Optional properties:
- ddc-i2c-bus: phandle of an I2C controller used for DDC EDID probing
- enable-gpios: GPIO pin to enable or disable the panel
- backlight: phandle of the backlight device attached to the panel
- override-mode: For devices which require a mode which differs from the
		 display_timing's "typical" mode, and whose restrictions cannot
		 be applied across the entire platform. The mode must fall
		 within the bounds of the panel's specified display_timing, and
		 cannot be used if the panel already specifies a single fixed
		 mode. The format is specified under "timing subnode" in
		 display-timing.txt


Example:

	panel: panel {
		compatible = "cptt,claa101wb01";
		ddc-i2c-bus = <&panelddc>;

		power-supply = <&vdd_pnl_reg>;
		enable-gpios = <&gpio 90 0>;

		backlight = <&backlight>;

		override-mode {
			clock-frequency = <266604720>;
			hactive = <2400>;
			hfront-porch = <48>;
			hback-porch = <84>;
			hsync-len = <32>;
			vactive = <1600>;
			vfront-porch = <3>;
			vback-porch = <120>;
			vsync-len = <10>;
		}
	};
```

## Documentation/devicetree/bindings/display/panel/tpo,tpg110.txt
```
TPO TPG110 Panel
================

This panel driver can driver a variety of panels. It requires
a few GPIO lines for control of its reset line and custom serial
protocol.

Required properties:
- compatible : one of:
  "ste,nomadik-nhk15-display", "tpo,tpg110"
  "tpo,tpg110"
- grestb-gpios : panel reset GPIO
- scen-gpios : serial control enable GPIO
- scl-gpios : serial control clock line GPIO
- sda-gpios : serial control data line GPIO
- width-mm : see display/panel/panel-common.txt
- height-mm : see display/panel/panel-common.txt

The device node can contain one 'port' child node with one child
'endpoint' node, according to the bindings defined in
media/video-interfaces.txt. This node should describe panel's video bus.

Example
-------

panel {
	compatible = "tpo,tpg110";
	width-mm = <116>;
	height-mm = <87>;
	grestb-gpios = <&stmpe_gpio44 5 GPIO_ACTIVE_LOW>;
	scen-gpios = <&gpio0 6 GPIO_ACTIVE_LOW>;
	scl-gpios = <&gpio0 5 GPIO_ACTIVE_HIGH>;
	sda-gpios = <&gpio0 4 GPIO_ACTIVE_HIGH>;
	backlight = <&bl>;

	port {
		nomadik_clcd_panel: endpoint {
			remote-endpoint = <&nomadik_clcd_pads>;
		};
	};
};
```

## Documentation/devicetree/bindings/display/panel/video-graphics-array.txt
```
Video Graphics Array

This binding is for simple panels using the standardized VGA resolutions
defined by de facto standards beginning with the IBM PS/2 in 1987.

Required properties:
- compatible: should be "video-graphics-array"

This binding is compatible with the simple-panel binding, which is specified
in simple-panel.txt in this directory.

Example:

panel {
	compatible = "video-graphics-array";
	port {
		vga_panel_in: endpoint {
			remote-endpoint = <&foo>;
		};
	};
};
```

## Documentation/devicetree/bindings/display/rockchip/rockchip-lvds.txt
```
Rockchip RK3288 LVDS interface
================================

Required properties:
- compatible: matching the soc type, one of
	- "rockchip,rk3288-lvds";

- reg: physical base address of the controller and length
	of memory mapped region.
- clocks: must include clock specifiers corresponding to entries in the
	clock-names property.
- clock-names: must contain "pclk_lvds"

- avdd1v0-supply: regulator phandle for 1.0V analog power
- avdd1v8-supply: regulator phandle for 1.8V analog power
- avdd3v3-supply: regulator phandle for 3.3V analog power

- rockchip,grf: phandle to the general register files syscon

Optional properties:
- pinctrl-names: must contain a "lcdc" entry.
- pinctrl-0: pin control group to be used for this controller.

Required nodes:

The lvds has two video ports as described by
	Documentation/devicetree/bindings/media/video-interfaces.txt.
Their connections are modeled using the OF graph bindings specified in
	Documentation/devicetree/bindings/graph.txt.

- video port 0 for the VOP inputs
- video port 1 for either a panel or subsequent encoder

the lvds panel described by
	Documentation/devicetree/bindings/display/panel/simple-panel.txt

Panel required properties:
- rockchip,data-width : should be <18> or <24>;
- rockchip,output: should be "rgb", "lvds" or "duallvds",
	This describes the output face.
- ports for remote LVDS output

Panel optional properties:
- rockchip,data-mapping: should be "vesa" or "jeida",
	This describes how the color bits are laid out in the
	serialized LVDS signal.
Example:

lvds_panel: lvds-panel {
	status = "okay";
	compatible = "simple-panel";
	enable-gpios = <&gpio7 21 GPIO_ACTIVE_HIGH>;
	rockchip,data-mapping = "jeida";
	rockchip,data-width = <24>;
	rockchip,output = "rgb";

	ports {
		panel_in_lvds: endpoint {
			remote-endpoint = <&lvds_out_panel>;
		};
	};
};


For Rockchip RK3288:

	lvds: lvds@ff96c000 {
		compatible = "rockchip,rk3288-lvds";
		rockchip,grf = <&grf>;
		reg = <0xff96c000 0x4000>;
		clocks = <&cru PCLK_LVDS_PHY>;
		clock-names = "pclk_lvds";
		pinctrl-names = "lcdc";
		pinctrl-0 = <&lcdc_ctl>;
		avdd1v0-supply = <&vdd10_lcd>;
		avdd1v8-supply = <&vcc18_lcd>;
		avdd3v3-supply = <&vcca_33>;
		rockchip,data-mapping = "jeida";
		rockchip,data-width = <24>;
		rockchip,output = "rgb";
		ports {
			#address-cells = <1>;
			#size-cells = <0>;

			lvds_in: port@0 {
				reg = <0>;

				lvds_in_vopb: endpoint@0 {
					reg = <0>;
					remote-endpoint = <&vopb_out_lvds>;
				};
				lvds_in_vopl: endpoint@1 {
					reg = <1>;
					remote-endpoint = <&vopl_out_lvds>;
				};
			};

			lvds_out: port@1 {
				reg = <1>;

				lvds_out_panel: endpoint {
					remote-endpoint = <&panel_in>;
				};
			};
		};
	};
```

## Documentation/devicetree/bindings/display/sitronix,st7586.txt
```
Sitronix ST7586 display panel

Required properties:
- compatible:	"lego,ev3-lcd".

The node for this driver must be a child node of a SPI controller, hence
all mandatory properties described in ../spi/spi-bus.txt must be specified.

Optional properties:
- dc-gpios:	D/C pin. The presence/absence of this GPIO determines
		the panel interface operation mode (IF[3:1] pins):
		- present: IF=011 4-wire 8-bit data serial interface
		- absent:  IF=010 3-wire 9-bit data serial interface
- reset-gpios:	Reset pin
- power-supply:	A regulator node for the supply voltage.
- backlight:	phandle of the backlight device attached to the panel
- rotation:	panel rotation in degrees counter clockwise (0,90,180,270)

Example:
	display@0{
		compatible = "lego,ev3-lcd";
		reg = <0>;
		spi-max-frequency = <10000000>;
		dc-gpios = <&gpio 43 GPIO_ACTIVE_HIGH>;
		reset-gpios = <&gpio 80 GPIO_ACTIVE_HIGH>;
	};
```

## Documentation/devicetree/bindings/display/snps,arcpgu.txt
```
ARC PGU

This is a display controller found on several development boards produced
by Synopsys. The ARC PGU is an RGB streamer that reads the data from a
framebuffer and sends it to a single digital encoder (usually HDMI).

Required properties:
  - compatible: "snps,arcpgu"
  - reg: Physical base address and length of the controller's registers.
  - clocks: A list of phandle + clock-specifier pairs, one for each
    entry in 'clock-names'.
  - clock-names: A list of clock names. For ARC PGU it should contain:
      - "pxlclk" for the clock feeding the output PLL of the controller.

Required sub-nodes:
  - port: The PGU connection to an encoder chip.

Example:

/ {
	...

	pgu@XXXXXXXX {
		compatible = "snps,arcpgu";
		reg = <0xXXXXXXXX 0x400>;
		clocks = <&clock_node>;
		clock-names = "pxlclk";
		encoder-slave = <&encoder_node>;

		port {
			pgu_output: endpoint {
				remote-endpoint = <&hdmi_enc_input>;
			};
		};
	};

	/* HDMI encoder on I2C bus */
	i2c@XXXXXXXX {
		compatible = "...";

		encoder_node:hdmi@XX{
			compatible="...";

			ports {
				port@0 {
					reg = <0>;
					hdmi_enc_input:endpoint {
						remote-endpoint = <&pgu_output>;
					};
				};

				port@1 {
					reg = <1>;
					hdmi_enc_output:endpoint {
						remote-endpoint = <&hdmi_connector_in>;
					};
				};
			};
		};
	}

	hdmi0: connector {
		compatible = "hdmi-connector";

		port {
			hdmi_connector_in: endpoint {
				remote-endpoint = <&hdmi_enc_output>;
			};
		};
	};
};
```

## Documentation/devicetree/bindings/display/st,stm32-ltdc.txt
```
* STMicroelectronics STM32 lcd-tft display controller

- ltdc: lcd-tft display controller host
  Required properties:
  - compatible: "st,stm32-ltdc"
  - reg: Physical base address of the IP registers and length of memory mapped region.
  - clocks: A list of phandle + clock-specifier pairs, one for each
    entry in 'clock-names'.
  - clock-names: A list of clock names. For ltdc it should contain:
      - "lcd" for the clock feeding the output pixel clock & IP clock.
  - resets: reset to be used by the device (defined by use of RCC macro).
  Required nodes:
    - Video port for RGB output.

* STMicroelectronics STM32 dsi specific extensions to Synopsys DesignWare MIPI
  DSI host controller

The STMicroelectronics STM32 dsi driver uses the Synopsys DesignWare MIPI
DSI host controller driver (related documentation in [5]).

Required properties:
- #address-cells: Should be <1>.
- #size-cells: Should be <0>.
- compatible: "st,stm32-dsi".
- reg: Memory mapped base address and length of the DWC MIPI DSI registers.
- clocks: References to all the clocks specified in the clock-names property
  as specified in [1].
- clock-names:
  - peripheral clock string name, must be "pclk".
  - phy pll reference clock string name, must be "ref".
- resets: References to all the resets specified in the reset-names property
  as specified in [2].
- reset-names: string reset name, must be "apb".

Required nodes:
- dsi input port node: connected to the ltdc rgb output port, see [3] & [4].
- panel or bridge node: see [6].

Note: You can find more documentation
[1] Documentation/devicetree/bindings/clock/clock-bindings.txt
[2] Documentation/devicetree/bindings/reset/reset.txt
[3] Documentation/devicetree/bindings/media/video-interfaces.txt
[4] Documentation/devicetree/bindings/graph.txt
[5] Documentation/devicetree/bindings/display/bridge/dw_mipi_dsi.txt
[6] Documentation/devicetree/bindings/display/mipi-dsi-bus.txt

Example 1: RGB panel
/ {
	...
	soc {
	...
		ltdc: display-controller@40016800 {
			compatible = "st,stm32-ltdc";
			reg = <0x40016800 0x200>;
			interrupts = <88>, <89>;
			resets = <&rcc STM32F4_APB2_RESET(LTDC)>;
			clocks = <&rcc 1 CLK_LCD>;
			clock-names = "lcd";

			port {
				ltdc_out_rgb: endpoint {
				};
			};
		};
	};
};

Example 2: DSI panel

/ {
	...
	soc {
	...
		ltdc: display-controller@40016800 {
			compatible = "st,stm32-ltdc";
			reg = <0x40016800 0x200>;
			interrupts = <88>, <89>;
			resets = <&rcc STM32F4_APB2_RESET(LTDC)>;
			clocks = <&rcc 1 CLK_LCD>;
			clock-names = "lcd";

			port {
				ltdc_out_dsi: endpoint {
					remote-endpoint = <&dsi_in>;
				};
			};
		};


		dsi: dsi@40016c00 {
			#address-cells = <1>;
			#size-cells = <0>;
			compatible = "st,stm32-dsi";
			reg = <0x40016c00 0x800>;
			clocks = <&rcc 1 CLK_F469_DSI>, <&clk_hse>;
			clock-names = "ref", "pclk";
			resets = <&rcc STM32F4_APB2_RESET(DSI)>;
			reset-names = "apb";

			port {
				dsi_in: endpoint {
					remote-endpoint = <&ltdc_out_dsi>;
				};
			};

			panel-dsi@0 {
				reg = <0>; /* dsi virtual channel (0..3) */
				compatible = ...;
				enable-gpios = ...;

			};

		};

	};
};
```
