## Documentation/devicetree/bindings/mfd/tps65086.txt
```
* TPS65086 Power Management Integrated Circuit bindings

Required properties:
 - compatible		: Should be "ti,tps65086".
 - reg			: I2C slave address.
 - interrupt-parent	: Phandle to he parent interrupt controller.
 - interrupts		: The interrupt line the device is connected to.
 - interrupt-controller	: Marks the device node as an interrupt controller.
 - #interrupt-cells	: The number of cells to describe an IRQ, this
			    should be 2. The first cell is the IRQ number,
			    the second cell is the flags, encoded as the trigger
			    masks from <dt-bindings/interrupt-controller/irq.h>.

Additional nodes defined in:
 - Regulators	: ../regulator/tps65086-regulator.txt
 - GPIO		: ../gpio/gpio-tps65086.txt

Example:

	pmic: tps65086@5e {
		compatible = "ti,tps65086";
		reg = <0x5e>;
		interrupt-parent = <&gpio1>;
		interrupts = <28 IRQ_TYPE_LEVEL_LOW>;
		interrupt-controller;
		#interrupt-cells = <2>;

		regulators {
			compatible = "ti,tps65086-regulator";

			buck1 {
				regulator-name = "vcc1";
				regulator-min-microvolt = <1600000>;
				regulator-max-microvolt = <1600000>;
				regulator-boot-on;
				ti,regulator-decay;
				ti,regulator-step-size-25mv;
			};
		};

		gpio4: gpio {
			compatible = "ti,tps65086-gpio";
			gpio-controller;
			#gpio-cells = <2>;
		};
	};
```

## Documentation/devicetree/bindings/mfd/tps65217.txt
```
Texas Instruments TPS65217 Single-Chip PMIC for Battery-Powered Systems

Required properties:
- compatible: "ti,tps65217"
- reg: I2C slave address.
- interrupt-controller: Marks the device node as an interrupt controller.
- #interrupt-cells: The number of cells to describe an IRQ, this should be 1.
- backlight: Child node that specify the backlight regulator sub-device. See:
	Documentation/devicetree/bindings/leds/backlight/tps65217-backlight.txt
- charger: Child node that specify the charger sub-device. See:
	Documentation/devicetree/bindings/power/supply/tps65217_charger.txt
- pwrbutton: Child node that specify the power button sub-device. See:
	Documentation/devicetree/bindings/input/tps65218-pwrbutton.txt
- regulators: List of child nodes that specify the regulator initialization
	data. See:
	Documentation/devicetree/bindings/regulator/tps65217.txt.

Optional properties:
- ti,pmic-shutdown-controller: Telling the PMIC to shutdown on PWR_EN toggle.

Example:

	tps: tps@24 {
		compatible = "ti,tps65217";
		interrupt-controller;
		#interrupt-cells = <1>;

		ti,pmic-shutdown-controller;

		backlight {
			compatible = "ti,tps65217-bl";
			status = "disabled";
		};

		charger {
			compatible = "ti,tps65217-charger";
			status = "disabled";
		};

		pwrbutton {
			compatible = "ti,tps65217-pwrbutton";
			status = "disabled";
		};

		regulators {
			compatible = "ti,tps65217-pmic";
			#address-cells = <1>;
			#size-cells = <0>;

			dcdc1_reg: dcdc1 {
				regulator-min-microvolt = <900000>;
				regulator-max-microvolt = <1800000>;
				regulator-boot-on;
				regulator-always-on;
			};

			dcdc2_reg: dcdc2 {
				regulator-min-microvolt = <900000>;
				regulator-max-microvolt = <3300000>;
				regulator-boot-on;
				regulator-always-on;
			};

			dcdc3_reg: dcc3 {
				regulator-min-microvolt = <900000>;
				regulator-max-microvolt = <1500000>;
				regulator-boot-on;
				regulator-always-on;
			};

			ldo1_reg: ldo1 {
				regulator-min-microvolt = <1000000>;
				regulator-max-microvolt = <3300000>;
				regulator-boot-on;
				regulator-always-on;
			};

			ldo2_reg: ldo2 {
				regulator-min-microvolt = <900000>;
				regulator-max-microvolt = <3300000>;
				regulator-boot-on;
				regulator-always-on;
			};

			ldo3_reg: ldo3 {
				regulator-min-microvolt = <1800000>;
				regulator-max-microvolt = <3300000>;
				regulator-boot-on;
				regulator-always-on;
			};

			ldo4_reg: ldo4 {
				regulator-min-microvolt = <1800000>;
				regulator-max-microvolt = <3300000>;
				regulator-boot-on;
				regulator-always-on;
			};
		};
	};
```

## Documentation/devicetree/bindings/mfd/tps65912.txt
```
* TPS65912 Power Management Integrated Circuit bindings

Required properties:
 - compatible		: Should be "ti,tps65912".
 - reg			: Slave address or chip select number (I2C / SPI).
 - interrupt-parent	: The parent interrupt controller.
 - interrupts		: The interrupt line the device is connected to.
 - interrupt-controller	: Marks the device node as an interrupt controller.
 - #interrupt-cells	: The number of cells to describe an IRQ, this should be 2.
			    The first cell is the IRQ number.
			    The second cell is the flags, encoded as the trigger masks from
			    ../interrupt-controller/interrupts.txt.

Additional nodes defined in:
 - Regulators: ../regulator/tps65912-regulator.txt
 - GPIO: ../gpio/gpio-tps65912.txt.

Example:

	pmic: tps65912@2d {
		compatible = "ti,tps65912";
		reg = <0x2d>;
		interrupt-parent = <&gpio1>;
		interrupts = <28 IRQ_TYPE_LEVEL_LOW>;
		interrupt-controller;
		#interrupt-cells = <2>;

		regulators {
			compatible = "ti,tps65912-regulator";

			dcdc1 {
				regulator-name = "vdd_core";
				regulator-min-microvolt = <912000>;
				regulator-max-microvolt = <1144000>;
				regulator-boot-on;
				regulator-always-on;
			};

			ldo1 {
				regulator-name = "ldo1";
				regulator-min-microvolt = <1900000>;
				regulator-max-microvolt = <1900000>;
			};
		};

		gpio4: gpio {
			compatible = "ti,tps65912-gpio";
			gpio-controller;
			#gpio-cells = <2>;
		};
	};
```

## Documentation/devicetree/bindings/mfd/ts4800-syscon.txt
```
Technologic Systems Syscon

Required properties:
- compatible : must be "ts,ts4800-syscon"
- reg : physical base address and length of memory mapped region

The driver exposes following subdevices:
- a watchdog: see ../watchdog/ts4800-wdt.txt

Example:

syscon@b0010000 {
	compatible = "ts,ts4800-syscon";
	reg = <0xb0010000 0x3d>;

	wdt@e {
		compatible = "ts,ts4800-wdt";
		offset = <0xe>;
	};
};
```

## Documentation/devicetree/bindings/mfd/wm831x.txt
```
Cirrus Logic/Wolfson Microelectronics wm831x PMICs

System PMICs with a wide range of additional features.

Required properties:

  - compatible : One of the following chip-specific strings:
        "wlf,wm8310"
        "wlf,wm8311"
        "wlf,wm8312"
        "wlf,wm8320"
        "wlf,wm8321"
        "wlf,wm8325"
        "wlf,wm8326"

  - reg : I2C slave address when connected using I2C, chip select number when
    using SPI.

  - gpio-controller : Indicates this device is a GPIO controller.
  - #gpio-cells : Must be 2. The first cell is the pin number and the
    second cell is used to specify optional parameters (currently unused).

Example:

wm8310: wm8310@36 {
	compatible = "wlf,wm8310";
	reg = <0x36>;

	gpio-controller;
	#gpio-cells = <2>;
};
```

## Documentation/devicetree/bindings/mips/img/boston.txt
```
Imagination Technologies Boston Development Board
=================================================

Required properties:
--------------------
 - compatible: Must be "img,boston".

Boot protocol:
--------------
In accordance with the MIPS UHI specification[1], the bootloader must pass the
following arguments to the kernel:
 - $a0: -2.
 - $a1: KSEG0 address of the flattened device-tree blob.

[1] http://prplfoundation.org/wiki/MIPS_documentation
```

## Documentation/devicetree/bindings/mips/mscc.txt
```
* Microsemi MIPS CPUs

Required properties:
- compatible: "brcm,ocelot"

- mips-hpt-frequency: CPU counter frequency.
```

## Documentation/devicetree/bindings/misc/ad525x_dpot-spi.txt
```
Digital Potentiometers (SPI) compatible with Analog Devices family

Required properties:
- compatible: Should be one of
	* "ad,ad5160"
	* "ad,ad5161"
	* "ad,ad5162"
	* "ad,ad5165"
	* "ad,ad5200"
	* "ad,ad5201"
	* "ad,ad5203"
	* "ad,ad5204"
	* "ad,ad5206"
	* "ad,ad5207"
	* "ad,ad5231"
	* "ad,ad5232"
	* "ad,ad5233"
	* "ad,ad5235"
	* "ad,ad5260"
	* "ad,ad5262"
	* "ad,ad5263"
	* "ad,ad5290"
	* "ad,ad5291"
	* "ad,ad5292"
	* "ad,ad5293"
	* "ad,ad7376"
	* "ad,ad8400"
	* "ad,ad8402"
	* "ad,ad8403"
	* "ad,adn2850"
	* "ad,ad5270"
	* "ad,ad5271"
- reg : spi chip select number for the device
- spi-max-frequency : max spi frequency to use
see: Documentation/misc-devices/ad525x_dpot.txt

Example:
	ad5204@1 {
		#address-cells = <1>;
		#size-cells = <1>;
		compatible = "ad,ad5204";
		spi-max-frequency = <5000000>;
		reg = <1>;
	};
```

## Documentation/devicetree/bindings/misc/arcx,anybus-bridge.txt
```
* Arcx anybus bridge

This chip communicates with the SoC over a parallel bus. It is
expected that its Device Tree node is specified as the child of a node
corresponding to the parallel bus used for communication.

Required properties:

  - compatible : The following chip-specific string:
        "arcx,anybus-bridge"

  - reg : bus memory area where the cpld registers are located.

  - reset-gpios : the GPIO pin connected to the reset line of the bridge.

  - #reset-cells : Must be 1.
	this bridge is a reset provider to its two embedded Anybus-S slots.

Example of usage:

This example places the bridge on top of the i.MX WEIM parallel bus, see:
Documentation/devicetree/bindings/bus/imx-weim.txt

&weim {
	anybus_bridge: bridge@0,0 {
		compatible = "arcx,anybus-bridge";
		reg = <0 0 0x100>;
		reset-gpios = <&gpio5 2 GPIO_ACTIVE_HIGH>;
		#reset-cells = <1>;
		/* fsl,weim-cs-timing is a i.MX WEIM bus specific property */
		fsl,weim-cs-timing = <0x024400b1 0x00001010 0x20081100
				0x00000000 0xa0000240 0x00000000>;
	};
};
```

## Documentation/devicetree/bindings/misc/avago-apds990x.txt
```
Avago APDS990X driver

Required properties:
- compatible: "avago,apds990x"
- reg: address on the I2C bus
- interrupts: external interrupt line number
- Vdd-supply: power supply for VDD
- Vled-supply: power supply for LEDA
- ga: Glass attenuation
- cf1: Clear channel factor 1
- irf1: IR channel factor 1
- cf2: Clear channel factor 2
- irf2: IR channel factor 2
- df: Device factor
- pdrive: IR current, one of APDS_IRLED_CURR_XXXmA values
- ppcount: Proximity pulse count

Example (Nokia N9):

	als_ps@39 {
		compatible = "avago,apds990x";
		reg = <0x39>;

		interrupt-parent = <&gpio3>;
		interrupts = <19 10>; /* gpio_83, IRQF_TRIGGER_FALLING | IRQF_TRIGGER_LOW */

		Vdd-supply = <&vaux1>;
		Vled-supply = <&vbat>;

		ga	= <168834>;
		cf1	= <4096>;
		irf1	= <7824>;
		cf2	= <877>;
		irf2	= <1575>;
		df	= <52>;

		pdrive	= <0x2>; /* APDS_IRLED_CURR_25mA */
		ppcount	= <5>;
	};
```

## Documentation/devicetree/bindings/misc/bmc-misc-ctrl.txt
```
BMC Miscellaneous Control Interfaces
====================================

Baseboard Management Controllers (BMCs) often have an array of hardware
features that need to be described but are awkward to sensibly expose.

This bindings document provides a generic mechanism for describing such
features, covering read-only (RO), read-modify-write (RMW) and
write-1-set/write-1-clear (W1SC) semantics.

All uses of bmc-misc-ctrl must be documented under Valid Uses below.

The bindings are similar in nature to register-bit-led.

Required Properties
-------------------

compatible: 	Must be "bmc-misc-ctrl"
offset:		A one or three cell property describing the registers
		associated with the field.

		If the optional property 'set-clear' is not present then the
		node describes a register with read-modify-write semantics. The
		offset property has one cell describing the register of
		interest.

		If the optional property 'set-clear' is present then the node
		describes a register set that together implement read,
		write-1-set and write-1-clear semantics. The offset property
		must be three cells, the first is the address of the register
		to read from, the second the write-1-set register and the third
		write-1-clear.

mask: 		A mask whose set bits represent the bits of the field.
label:		The name of the field

Optional Properties
-------------------

read-only:	Define a read-only field (RMW/W1SC irrelevant).
set-clear:	Define whether the field exists in a RMW or W1SC register set
default-value:	Single cell applicable to RMW. The field will be updated to the
		cell's value.
default-set:	For W1SC, set all bits in the field
default-clear:	For W1SC, clear all bits in the field

Valid Uses
----------

Description:	Control bit for switching the video display DAC mux between
		host VGA and BMC CRT mode
Machines:	aspeed,ast2500
Parent:		compatible = "aspeed,ast2500-scu", "syscon", "simple-mfd";
Node:
		field@2c.16 {
			compatible = "bmc-misc-ctrl";
			offset = <0x2c>;
			mask = <0x00030000>;
			label = "dac-mux";
		};

Description:	Host VGA scratch registers
Machines:	aspeed,ast2500
Parent:		compatible = "aspeed,ast2500-scu", "syscon", "simple-mfd";
Node:
		field@50.0 {
			compatible = "bmc-misc-ctrl";
			offset = <0x50>;
			mask = <0xffffffff>;
			label = "vga0";
			read-only;
		};

		field@54.0 {
			compatible = "bmc-misc-ctrl";
			offset = <0x54>;
			mask = <0xffffffff>;
			label = "vga1";
			read-only;
		};

		field@58.0 {
			compatible = "bmc-misc-ctrl";
			offset = <0x58>;
			mask = <0xffffffff>;
			label = "vga2";
			read-only;
		};

		field@5c.0 {
			compatible = "bmc-misc-ctrl";
			offset = <0x5c>;
			mask = <0xffffffff>;
			label = "vga3";
			read-only;
		};

		field@60.0 {
			compatible = "bmc-misc-ctrl";
			offset = <0x60>;
			mask = <0xffffffff>;
			label = "vga4";
			read-only;
		};

		field@64.0 {
			compatible = "bmc-misc-ctrl";
			offset = <0x64>;
			mask = <0xffffffff>;
			label = "vga5";
			read-only;
		};

		field@68.0 {
			compatible = "bmc-misc-ctrl";
			offset = <0x68>;
			mask = <0xffffffff>;
			label = "vga6";
			read-only;
		};

		field@6c.0 {
			compatible = "bmc-misc-ctrl";
			offset = <0x6c>;
			mask = <0xffffffff>;
			label = "vga7";
			read-only;
		};

Description:	Super I/O device scratch registers for host/BMC communication
Machines:	aspeed,ast2500
Parent:		compatible = "aspeed,ast2500-lpc-host", "simple-mfd", "syscon";
		field@f0.24 {
			compatible = "bmc-misc-ctrl";
			offset = <0xf0 24 8>;
			mask = <0xff000000>;
			label = "sio-2b";
		};

		field@f0.16 {
			compatible = "bmc-misc-ctrl";
			offset = <0xf0>;
			mask = <0x00ff0000>;
			label = "sio-2a";
		};

		field@f0.8 {
			compatible = "bmc-misc-ctrl";
			offset = <0xf0>;
			mask = <0x0000ff00>;
			bit-shift = <8>;
			label = "sio-29";
		};

		field@f0.0 {
			compatible = "bmc-misc-ctrl";
			offset = <0xf0>;
			mask = <0x000000ff>;
			label = "sio-28";
		};

		field@f4.24 {
			compatible = "bmc-misc-ctrl";
			offset = <0xf4>;
			mask = <0xff000000>;
			label = "sio-2f";
		};

		field@f4.16 {
			compatible = "bmc-misc-ctrl";
			offset = <0xf4>;
			mask = <0x00ff0000>;
			label = "sio-2e";
		};

		field@f4.8 {
			compatible = "bmc-misc-ctrl";
			offset = <0xf4>;
			mask = <0x0000ff00>;
			label = "sio-2d";
		};

		field@f4.0 {
			compatible = "bmc-misc-ctrl";
			offset = <0xf4>;
			mask = <0x000000ff>;
			label = "sio-2c";
		};

		field@f8.24 {
			compatible = "bmc-misc-ctrl";
			offset = <0xf8>;
			mask = <0xff000000>;
			read-only;
			label = "sio-23";
		};

		field@f8.16 {
			compatible = "bmc-misc-ctrl";
			offset = <0xf8>;
			mask = <0x00ff0000>;
			read-only;
			label = "sio-22";
		};

		field@f8.8 {
			compatible = "bmc-misc-ctrl";
			offset = <0xf8>;
			mask = <0x0000ff00>;
			read-only;
			label = "sio-21";
		};

		field@f8.0 {
			compatible = "bmc-misc-ctrl";
			offset = <0xf8>;
			mask = <0x000000ff>;
			read-only;
			label = "sio-20";
		};

		field@fc.24 {
			compatible = "bmc-misc-ctrl";
			offset = <0xfc>;
			mask = <0xff000000>;
			read-only;
			label = "sio-27";
		};

		field@fc.16 {
			compatible = "bmc-misc-ctrl";
			offset = <0xfc>;
			mask = <0x00ff0000>;
			read-only;
			label = "sio-26";
		};

		field@fc.8 {
			compatible = "bmc-misc-ctrl";
			offset = <0xfc>;
			mask = <0x0000ff00>;
			read-only;
			label = "sio-25";
		};

		field@fc.0 {
			compatible = "bmc-misc-ctrl";
			offset = <0xfc>;
			mask = <0x000000ff>;
			read-only;
			label = "sio-24";
		};
```
