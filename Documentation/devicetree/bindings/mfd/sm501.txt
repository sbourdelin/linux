## Documentation/devicetree/bindings/misc/chromeos-firmware.txt
```
Device-Tree bindings for chromeos-firmware.c.

Required properties:
	- compatible = "google,gpio-firmware";

Each signal is represented as a sub-node of "chromeos_firmware":
Subnode properties:

	- gpios: OF device-tree gpio specification.

Example nodes:

	chromeos_firmware {
		compatible = "google,gpio-firmware";

		write-protect {
			gpios = <&gpx3 0 GPIO_ACTIVE_LOW>;
		};

		developer-switch {
			gpios = <&gpx1 3 GPIO_ACTIVE_HIGH>;
		};

		recovery-switch {
			gpios = <&gpx0 7 GPIO_ACTIVE_LOW>;
		};
	};
```

## Documentation/devicetree/bindings/misc/cros_ec_throttler.txt
```
* cros_ec_throttler driver

Required properties:
- compatible: "google,cros-ec-throttler"
```

## Documentation/devicetree/bindings/misc/gpio-switch.txt
```
Device-Tree bindings for gpio attached switches.

This provides a mechanism to provide a named link to specified gpios. This can
be useful in instances such as when theres a need to monitor a switch, which is
common across a family of devices, but attached to different gpios and even
implemented in different ways on differnet devices.

Required properties:
	- compatible = "gpio-switch";

Each signal is represented as a sub-node of "gpio-switch". The naming of
sub-nodes is arbitrary.

Required sub-node properties:

	- label: Name to be given to gpio switch.
	- gpios: OF device-tree gpio specification.

Optional sub-node properties:

	- read-only: Boolean flag to mark the gpio as read-only, i.e. the line
	  should not be driven by the host.

Example nodes:

        gpio-switch {
                compatible = "gpio-switch";

                write-protect {
                        label = "write-protect";
                        gpios = <&gpx3 0 GPIO_ACTIVE_LOW>;
                        read-only;
                };

                developer-switch {
                        label = "developer-switch";
                        gpios = <&gpx1 3 GPIO_ACTIVE_HIGH>;
                        read-only;
                };

                recovery-switch {
                        label = "recovery-switch";
                        gpios = <&gpx0 7 GPIO_ACTIVE_LOW>;
                        read-only;
                };
        };
```

## Documentation/devicetree/bindings/misc/idt_89hpesx.txt
```
EEPROM / CSR SMBus-slave interface of IDT 89HPESx devices

Required properties:
  - compatible : should be "<manufacturer>,<type>"
		 Basically there is only one manufacturer: idt, but some
		 compatible devices may be produced in future. Following devices
		 are supported: 89hpes8nt2, 89hpes12nt3, 89hpes24nt6ag2,
		 89hpes32nt8ag2, 89hpes32nt8bg2, 89hpes12nt12g2, 89hpes16nt16g2,
		 89hpes24nt24g2, 89hpes32nt24ag2, 89hpes32nt24bg2;
		 89hpes12n3, 89hpes12n3a, 89hpes24n3, 89hpes24n3a;
		 89hpes32h8, 89hpes32h8g2, 89hpes48h12, 89hpes48h12g2,
		 89hpes48h12ag2, 89hpes16h16, 89hpes22h16, 89hpes22h16g2,
		 89hpes34h16, 89hpes34h16g2, 89hpes64h16, 89hpes64h16g2,
		 89hpes64h16ag2;
		 89hpes12t3g2, 89hpes24t3g2, 89hpes16t4, 89hpes4t4g2,
		 89hpes10t4g2, 89hpes16t4g2, 89hpes16t4ag2, 89hpes5t5,
		 89hpes6t5, 89hpes8t5, 89hpes8t5a, 89hpes24t6, 89hpes6t6g2,
		 89hpes24t6g2, 89hpes16t7, 89hpes32t8, 89hpes32t8g2,
		 89hpes48t12, 89hpes48t12g2.
		 Current implementation of the driver doesn't have any device-
		 specific functionalities. But since each of them differs
		 by registers mapping, CSRs read/write restrictions can be
		 added in future.
  - reg :	 I2C address of the IDT 89HPES device.

Optional properties:
  - read-only :	 Parameterless property disables writes to the EEPROM
  - idt,eesize : Size of EEPROM device connected to IDT 89HPES i2c-master bus
		 (default value is 4096 bytes if option isn't specified)
  - idt,eeaddr : Custom address of EEPROM device
		 (If not specified IDT 89HPESx device will try to communicate
		  with EEPROM sited by default address - 0x50)

Example:
	idt_pcie_sw@60 {
		compatible = "idt,89hpes12nt3";
		reg = <0x60>;
		read-only;
		idt,eesize = <65536>;
		idt,eeaddr = <0x50>;
	};
```

## Documentation/devicetree/bindings/misc/mti,mips-cpc.txt
```
Binding for MIPS Cluster Power Controller (CPC).

This binding allows a system to specify where the CPC registers should be
mapped using device tree.

Required properties:
compatible : Should be "mti,mips-cpc".
regs: Should describe the address & size of the CPC register region.
```

## Documentation/devicetree/bindings/misc/mux-adg792a.txt
```
Bindings for Analog Devices ADG792A/G Triple 4:1 Multiplexers

Required properties:
- compatible : "adi,adg792a" or "adi,adg792g"
- #mux-control-cells : <0> if parallel, or <1> if not.
* Standard mux-controller bindings as decribed in mux-controller.txt

Optional properties:
- adi,parallel : if present, the three muxes are bound together with a single
  mux controller, controlling all three muxes in parallel.
- adi,idle-state : if present, array of states the three mux controllers will
  have when idle (or, if parallel, a single idle-state).

Mux controller states 0 through 3 correspond to signals A through D in the
datasheet. Mux controller states 4 and 5 are only available as possible idle
states. State 4 represents that nothing is connected, and state 5 represents
that the mux controller keeps the mux in its previously selected state during
the idle period. State 5 is the default idle state.

Example:

	/* three independent mux controllers (of which one is used) */
	&i2c0 {
		mux: adg792a@50 {
			compatible = "adi,adg792a";
			reg = <0x50>;
			#mux-control-cells = <1>;
		};
	};

	adc-mux {
		compatible = "iio-mux";
		io-channels = <&adc 0>;
		io-channel-names = "parent";

		mux-controls = <&mux 1>;

		channels = "sync-1", "", "out";
	};


	/*
	 * Three parallel muxes with one mux controller, useful e.g. if
	 * the adc is differential, thus needing two signals to be muxed
	 * simultaneously for correct operation.
	 */
	&i2c0 {
		pmux: adg792a@50 {
			compatible = "adi,adg792a";
			reg = <0x50>;
			#mux-control-cells = <0>;
			adi,parallel;
		};
	};

	diff-adc-mux {
		compatible = "iio-mux";
		io-channels = <&adc 0>;
		io-channel-names = "parent";

		mux-controls = <&pmux>;

		channels = "sync-1", "", "out";
	};
```

## Documentation/devicetree/bindings/misc/mux-controller.txt
```
Common multiplexer controller bindings

A mux controller will have one, or several, consumer devices that uses the
mux controller. Thus, a mux controller can possibly control several
parallel multiplexers. If there are several consumer devices, the node for
a mux controller will have one child node for each consumer of the multiplexer
controller. If there is only one consumer of the mux controller, the mux
controller node can be the child (with node name 'mux-controller') of the
consumer node.

A mux controller provides a number of states to its consumers, and the
state space is a simple zero-based enumeration. I.e. 0-1 for a 2-way
multiplexer, 0-7 for an 8-way multiplexer, etc.

Example:

	/*
	 * One consumer of a 2-way multiplexer controller by one GPIO-line,
	 * with the multiplexer controller as a child node.
	 */
	adc-mux {
		compatible = "iio-mux";
		io-channels = <&adc 0>;
		io-channel-names = "parent";

		#address-cells = <1>;
		#size-cells = <0>;

		mux-controller {
			compatible = "mux-gpio";

			mux-gpios = <&pioA 0 GPIO_ACTIVE_HIGH>;
		};

		sync-1@0 {
			reg = <0>;
		};

		in@1 {
			reg = <1>;
		};
	};

	/*
	 * Two consumers (one for an ADC line and one for an i2c bus) of
	 * parallel 4-way multiplexers controlled by the same two GPIO-lines.
	 */
	mux {
		compatible = "mux-gpio";

		mux-gpios = <&pioA 0 GPIO_ACTIVE_HIGH>,
			    <&pioA 1 GPIO_ACTIVE_HIGH>;

		adc-mux {
			compatible = "iio-mux";
			io-channels = <&adc 0>;
			io-channel-names = "parent";

			#address-cells = <1>;
			#size-cells = <0>;

			sync-1@0 {
				reg = <0>;
			};

			in@1 {
				reg = <1>;
			};

			out@2 {
				reg = <2>;
			};

			sync-2@3 {
				reg = <3>;
			};
		};

		i2c-mux {
			compatible = "i2c-mux-simple,mux-locked";
			i2c-parent = <&i2c1>;

			#address-cells = <1>;
			#size-cells = <0>;

			i2c@0 {
				reg = <0>;
				#address-cells = <1>;
				#size-cells = <0>;

				ssd1307: oled@3c {
					/* ... */
				};
			};

			i2c@3 {
				reg = <3>;
				#address-cells = <1>;
				#size-cells = <0>;

				pca9555: pca9555@20 {
					/* ... */
				};
			};
		};
	};
```
