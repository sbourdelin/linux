## Documentation/devicetree/bindings/mfd/sm501.txt
```
* SM SM501

The SM SM501 is a LCD controller, with proper hardware, it can also
drive DVI monitors.

Required properties:
- compatible : should be "smi,sm501".
- reg : contain two entries:
    - First entry: System Configuration register
    - Second entry: IO space (Display Controller register)
- interrupts : SMI interrupt to the cpu should be described here.
- interrupt-parent : the phandle for the interrupt controller that
  services interrupts for this device.

Optional properties:
- mode : select a video mode:
    <xres>x<yres>[-<bpp>][@<refresh>]
- edid : verbatim EDID data block describing attached display.
  Data from the detailed timing descriptor will be used to
  program the display controller.
- little-endian: available on big endian systems, to
  set different foreign endian.
- big-endian: available on little endian systems, to
  set different foreign endian.
- smi,devices: function block enable bitmap.
	bit0: USB host
	bit1: USB slave
	bit2: SSP Ch0
	bit3: SSP Ch1
	bit4: UART Ch0
	bit5: UART Ch1
	bit6: Accelerator
	bit7: AC97
	bit8: I2S
	bit9: GPIO

Example for MPC5200:
	display@1,0 {
		compatible = "smi,sm501";
		reg = <1 0x00000000 0x00800000
		       1 0x03e00000 0x00200000>;
		interrupts = <1 1 3>;
		mode = "640x480-32@60";
		edid = [edid-data];
	};
```

## Documentation/devicetree/bindings/mfd/stm32-dfsdm.txt
```
STMicroelectronics STM32 Digital Filter for Sigma Delta Modulator (DFSDM)
ulti-function device.

The STM32 DFSDM device is a multifunction device that handles the DFSDM IP.

The DFSDM IP allows to add processing on Sigma Delta ADC based on SinC filters.
For this, a pool of m filters can be connected to a pool of n channels.
For STM32H7 : m = 4, n = 8.

Each channel n is assigned to the SPI or Manchester interface n or n + 1.
Channels 0 to 2 can also be connected to ADC IP instance 1 to 3.
Filtering result is stored in a left aligned register, with 8 LSB reserved for
the input channel ID.

Each filter instance supports two contexts to manage conversions, each one has
its own configurable sequence and trigger:
- regular conversion: used for single or continuous conversion.
- injected conversions: used for triggered conversion.

Interfaces supported:
- sigma delta ADCs trough IIO framework.
- PDM microphones through ASoC framework.

Required properties:
- compatible:	Must be "st,stm32h7-dfsdm".
- reg:		Specifies the DFSDM block register address and length.
- interrupts:	IRQ lines connected to each DFSDM filter instance.
- clocks:	IP and serial interfaces clocking. Should be set according
		to rcc clock ID and "clock-names".
- clock-names:	Input clock name "dfsdm_clk" must be defined,
		"audio_clk" is optional. If defined CLKOUT is based on the audio
		clock, else "dfsdm_clk" is used.

Optional properties:
- st,clkout-freq: clkout clock frequency (Hz).This clock must be set according
		  to "clock" property. Frequency must be a multiple of the rcc
		  clock frequency. If not, clkout frequency will not be
		  accurate.
- pinctrl-names:  set to "default".
- pinctrl-0:	  List of phandles pointing to pin configuration nodes for DFSDM
		  module.
		  For Pinctrl properties see ../pinctrl/pinctrl-bindings.txt
Example :
	dfsdm: dfsdm@4400D000 {
		compatible = "st,stm32h7-dfsdm";
		reg = <0x40017000 0x400>;
		interrupts = <110>, <111>, <112>, <113>;
		clocks = <&timer_clk>;
		clock-names = "dfsdm_clk";
		pinctrl-0 = <&dfsdm_ch0 &dfsdm_ch1>;
		pinctrl-names = "default";
		st,clkout-freq = <2480000>;

		iio_dfsdm0: iio-dfsdm@0 {
			compatible = "st,stm32-dfsdm-adc";
			#io-channel-cells = <1>;
			reg = <0>;
			status = "disabled";
		};
		dai_dfsdm0: dfsdm-audio@0 {
			compatible = "st,stm32-dfsdm-audio";
			#sound-dai-cells = <0>;
			reg = <0>;
			dmas = <&dmamux1 101 0x400 0x00>;
			dma-names = "rx";
			status = "disabled";
		};
	};
```

## Documentation/devicetree/bindings/mfd/stm32-general-purpose-timer.txt
```
STM32 General Purpose Timer driver bindings

Required parameters:
- compatible: must be "st,stm32-gptimer"

- reg:			Physical base address and length of the controller's
			registers.
- clock-names: 		Set to "clk_int".
- clocks: 		Phandle to the clock used by the timer module.
			For Clk properties, please refer to ../clock/clock-bindings.txt

Optional parameters:
- resets:		Phandle to the parent reset controller.
			See ../reset/st,stm32-rcc.txt

Optional subnodes:
- pwm:			See ../pwm/pwm-stm32.txt
- timer:		See ../iio/timer/stm32-timer-trigger.txt

Example:
	timers@40010000 {
		#address-cells = <1>;
		#size-cells = <0>;
		compatible = "st,stm32-gptimer";
		reg = <0x40010000 0x400>;
		clocks = <&rcc 0 160>;
		clock-names = "clk_int";

		pwm@0 {
			compatible = "st,stm32-pwm";
			pinctrl-0	= <&pwm1_pins>;
			pinctrl-names	= "default";
		};

		timer@0 {
			compatible = "st,stm32-timer-trigger";
			reg = <0>;
		};
	};
```

## Documentation/devicetree/bindings/mfd/ti,ds90ux9xx-i2c-bridge.txt
```
TI DS90Ux9xx de-/serializer I2C bridge subcontroller

Required properties:
- compatible: Must contain a generic "ti,ds90ux9xx-i2c-bridge" value and
	may contain one more specific value from the list:
	"ti,ds90ux925-i2c-bridge",
	"ti,ds90ux926-i2c-bridge",
	"ti,ds90ux927-i2c-bridge",
	"ti,ds90ux928-i2c-bridge",
	"ti,ds90ux940-i2c-bridge".

Required properties of a de-/serializer device connected to a local I2C bus:
- ti,i2c-bridges: List of phandles to remote de-/serializer devices with
	two arguments: id of a local de-/serializer FPD link and an assigned
	I2C address of a remote de-/serializer to be accessed on a local
	I2C bus.

Optional properties of a de-/serializer device connected to a local I2C bus:
- ti,i2c-bridge-maps: List of 3-cell values:
	- the first argument is id of a local de-/serializer FPD link,
	- the second argument is an I2C address of a device connected to
	  a remote de-/serializer IC,
	- the third argument is an I2C address of the remote I2C device
	  for access on a local I2C bus.
- ti,i2c-bridge-auto-ack: Enables AUTO ACK mode.
- ti,i2c-bridge-pass-all: Enables PASS ALL mode, remote I2C slave devices
	are accessible on a local (host) I2C bus without I2C address
	remappings.

Remote de-/serializer device may contain a list of device nodes, each
one represents an I2C device connected to that remote de-/serializer IC.

Example (remote device is a deserializer with Atmel MXT touchscreen):

serializer: serializer@c {
	compatible = "ti,ds90ub927q", "ti,ds90ux9xx";
	reg = <0xc>;

	i2c-bridge {
		compatible = "ti,ds90ux927-i2c-bridge",
			     "ti,ds90ux9xx-i2c-bridge";
		ti,i2c-bridges = <&deserializer 0 0x3b>;
		ti,i2c-bridge-maps = <0 0x4b 0x64>;
	};
};

deserializer: deserializer {
	compatible = "ti,ds90ub928q", "ti,ds90ux9xx";

	i2c-bridge {
		compatible = "ti,ds90ux928-i2c-bridge",
			     "ti,ds90ux9xx-i2c-bridge";
		#address-cells = <1>;
		#size-cells = <0>;

		touchscreen@4b {
			compatible = "atmel,maxtouch";
			reg = <0x4b>;
		};
	};
};
```

## Documentation/devicetree/bindings/mfd/ti,ds90ux9xx.txt
```
Texas Instruments DS90Ux9xx de-/serializer controllers

Required properties:
- compatible: Must contain a generic "ti,ds90ux9xx" value and
	may contain one more specific value from the list:
	"ti,ds90ub925q",
	"ti,ds90uh925q",
	"ti,ds90ub927q",
	"ti,ds90uh927q",
	"ti,ds90ub926q",
	"ti,ds90uh926q",
	"ti,ds90ub928q",
	"ti,ds90uh928q",
	"ti,ds90ub940q",
	"ti,ds90uh940q".

Optional properties:
- reg : Specifies the I2C slave address of a local de-/serializer.
- power-gpios : GPIO line to control supplied power to the device.
- ti,backward-compatible-mode : Overrides backward compatibility mode.
	Possible values are "<1>" or "<0>".
	If "ti,backward-compatible-mode" is not mentioned, the backward
	compatibility mode is not touched and given by hardware pin strapping.
- ti,low-frequency-mode : Overrides low frequency mode.
	Possible values are "<1>" or "<0>".
	If "ti,low-frequency-mode" is not mentioned, the low frequency mode
	is not touched and given by hardware pin strapping.
- ti,video-map-select-msb: Sets video bridge pins to MSB mode, if it is set
	MAPSEL pin value is ignored.
- ti,video-map-select-lsb: Sets video bridge pins to LSB mode, if it is set
	MAPSEL pin value is ignored.
- ti,pixel-clock-edge : Selects Pixel Clock Edge.
	Possible values are "<1>" or "<0>".
	If "ti,pixel-clock-edge" is High <1>, output data is strobed on the
	Rising edge of the PCLK. If ti,pixel-clock-edge is Low <0>, data is
	strobed on the Falling edge of the PCLK.
	If "ti,pixel-clock-edge" is not mentioned, the pixel clock edge
	value is not touched and given by hardware pin strapping.
- ti,spread-spectrum-clock-generation : Spread Sprectrum Clock Generation.
	Possible values are from "<0>" to "<7>". The same value will be
	written to SSC register. If "ti,spread-spectrum-clock-gen" is not
	found, then SSCG will be disabled.

TI DS90Ux9xx serializers and deserializer device nodes may contain a number
of children device nodes to describe and enable particular subcomponents
found on ICs.

Example:

serializer: serializer@c {
	compatible = "ti,ds90ub927q", "ti,ds90ux9xx";
	reg = <0xc>;
	power-gpios = <&gpio5 12 GPIO_ACTIVE_HIGH>;
	ti,backward-compatible-mode = <0>;
	ti,low-frequency-mode = <0>;
	ti,pixel-clock-edge = <0>;
	...
}

deserializer: deserializer@3c {
	compatible = "ti,ds90ub940q", "ti,ds90ux9xx";
	reg = <0x3c>;
	power-gpios = <&gpio6 31 GPIO_ACTIVE_HIGH>;
	...
}
```

## Documentation/devicetree/bindings/mfd/ti-lmu.txt
```
TI LMU(Lighting Management Unit) device tree bindings

TI LMU driver supports lighting devices belows.

   Name              Child nodes
  ------      -------------------------
  LM3532       Backlight
  LM3631       Backlight and regulator
  LM3632       Backlight and regulator
  LM3633       Backlight, LED and HWMON
  LM3695       Backlight
  LM3697       Backlight and HWMON

Required properties:
  - compatible: Should be one of lists below.
                "ti,lm3532"
                "ti,lm3631"
                "ti,lm3632"
                "ti,lm3633"
                "ti,lm3695"
                "ti,lm3697"
  - reg: I2C slave address.
         0x11 is LM3632
         0x29 is LM3631
         0x36 is LM3633, LM3697
         0x38 is LM3532
         0x63 is LM3695

Optional properties:
  - enable-gpios: A GPIO specifier for hardware enable pin.

Required node:
  - backlight: All LMU devices have backlight child nodes.
               For the properties, please refer to [1].

Optional nodes:
  - hwmon: Hardware fault monitoring driver for LM3633 and LM3697.
           For the property, please refer to [2].
  - leds: LED properties for LM3633. Please refer to [3].
  - regulators: Regulator properties for LM3631 and LM3632.
          Please refer to [4].

[1] Documentation/devicetree/bindings/video/backlight/ti-lmu-backlight.txt
[2] Documentation/devicetree/bindings/hwm/ti-lmu-hwmon.txt
[3] Documentation/devicetree/bindings/leds/leds-lm3633.txt
[4] Documentation/devicetree/bindings/regulator/lm363x-regulator.txt

Examples:

LM3532 has a backlight device. External GPIO is used for enabling LM3532.

lm3532@38 {
	compatible = "ti,lm3532";
	reg = <0x38>;

	enable-gpios = <&pioC 2 GPIO_ACTIVE_HIGH>;

	backlight {
		compatible = "ti,lm3532-backlight";

		lcd {
			hvled1-used;
			hvled2-used;
			hvled3-used;

			ramp-up-msec = <30>;
			ramp-down-msec = <0>;

			backlight-max-microamp = <5000>;
		};
	};
};

LM3631 has 5 regulators with one backlight device.

lm3631@29 {
	compatible = "ti,lm3631";
	reg = <0x29>;

	regulators {
		compatible = "ti,lm363x-regulator";

		vboost {
			regulator-name = "lcd_boost";
			regulator-min-microvolt = <4500000>;
			regulator-max-microvolt = <6350000>;
			regulator-always-on;
		};

		vcont {
			regulator-name = "lcd_vcont";
			regulator-min-microvolt = <1800000>;
			regulator-max-microvolt = <3300000>;
		};

		voref {
			regulator-name = "lcd_voref";
			regulator-min-microvolt = <4000000>;
			regulator-max-microvolt = <6000000>;
		};

		vpos {
			regulator-name = "lcd_vpos";
			regulator-min-microvolt = <4000000>;
			regulator-max-microvolt = <6000000>;
			regulator-boot-on;
		};

		vneg {
			regulator-name = "lcd_vneg";
			regulator-min-microvolt = <4000000>;
			regulator-max-microvolt = <6000000>;
			regulator-boot-on;
		};
	};

	backlight {
		compatible = "ti,lm3631-backlight";

		lcd {
			backlight-name = "lcd_bl";
			hvled1-used;
			hvled2-used;

			ramp-up-msec = <300>;
		};
	};
};

LM3632 has 3 regulators with one backlight device. External GPIO is
used for enabling LM3632.

lm3632@11 {
	compatible = "ti,lm3632";
	reg = <0x11>;

	enable-gpios = <&pioC 2 GPIO_ACTIVE_HIGH>;

	regulators {
		compatible = "ti,lm363x-regulator";

		ti,lcm-en1-gpio = <&pioC 0 GPIO_ACTIVE_HIGH>;
		ti,lcm-en2-gpio = <&pioC 1 GPIO_ACTIVE_HIGH>;

		vboost {
			regulator-name = "lcd_boost";
			regulator-min-microvolt = <4500000>;
			regulator-max-microvolt = <6400000>;
			regulator-always-on;
		};

		vpos {
			regulator-name = "lcd_vpos";
			regulator-min-microvolt = <4000000>;
			regulator-max-microvolt = <6000000>;
		};

		vneg {
			regulator-name = "lcd_vneg";
			regulator-min-microvolt = <4000000>;
			regulator-max-microvolt = <6000000>;
		};
	};

	backlight {
		compatible = "ti,lm3632-backlight";

		lcd {
			backlight-name = "lcd";
			hvled1-used;
			hvled2-used;
		};
	};
};

LM3633 has multiple backlight channels, LED channels and hardware fault
monitoring driver. External GPIO is used for enabling LM3633.

lm3633@36 {
	compatible = "ti,lm3633";
	reg = <0x36>;

	enable-gpios = <&pioC 2 GPIO_ACTIVE_HIGH>;

	backlight {
		compatible = "ti,lm3633-backlight";

		pwms = <&pwm0 0 10000 0>; /* pwm number, period, polarity */
		pwm-names = "lmu-backlight";

		main {
			backlight-name = "main_lcd";
			hvled2-used;
			hvled3-used;
			backlight-max-microamp = <20000>;

			ramp-up-msec = <500>;
			ramp-down-msec = <500>;
		};

		front {
			backlight-name = "front_lcd";
			hvled1-used;

			ramp-up-msec = <1000>;
			ramp-down-msec = <0>;

			pwm-period = <10000>;
		};
	};

	leds {
		compatible = "ti,lm3633-leds";

		chan2 {
			channel-name = "status";
			lvled2-used;
			led-max-microamp = <6000>;
		};

		chan456 {
			channel-name = "rgb";
			lvled4-used;
			lvled5-used;
			lvled6-used;
		};
	};

	hwmon {
		compatible = "ti,lm3633-hwmon";
	};
};

LM3695 is single backlight device.

lm3695@63 {
	compatible = "ti,lm3695";
	reg = <0x63>;

	backlight {
		compatible = "ti,lm3695-backlight";

		lcd {
			hvled1-used;
			hvled2-used;
			backlight-max-microamp = <20000>;
		};
	};
};

LM3697 has one backlight device and hardware fault monitoring driver.
External GPIO is used for enabling LM3697.

lm3697@36 {
	compatible = "ti,lm3697";
	reg = <0x36>;

	enable-gpios = <&pioC 2 GPIO_ACTIVE_HIGH>;

	backlight {
		compatible = "ti,lm3697-backlight";

		pwms = <&pwm0 0 10000 0>; /* pwm number, period, polarity */
		pwm-names = "lmu-backlight";

		lcd {
			backlight-name = "bl";
			hvled1-used;
			hvled2-used;
			hvled3-used;
			backlight-max-microamp = <20000>;

			ramp-up-msec = <500>;
			ramp-down-msec = <500>;
			pwm-period = <10000>;
		};
	};

	hwmon {
		compatible = "ti,lm3697-hwmon";
	};
};
```

## Documentation/devicetree/bindings/mfd/tps6105x.txt
```
* Device tree bindings for TI TPS61050/61052 Boost Converters

The TP61050/TPS61052 is a high-power "white LED driver". This boost converter
is also used for other things than white LEDs, and also contains a GPIO pin.

Required properties:
- compatible:		"ti,tps61050" or "ti,tps61052"
- reg:			Specifies the I2C slave address

Example:

i2c0 {
	tps61052@33 {
		compatible = "ti,tps61052";
		reg = <0x33>;
	};
};
```
