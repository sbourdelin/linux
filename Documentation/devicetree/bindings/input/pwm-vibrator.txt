## Documentation/devicetree/bindings/interconnect/interconnect.txt
```
Interconnect Provider Device Tree Bindings
=========================================

The purpose of this document is to define a common set of generic interconnect
providers/consumers properties.


= interconnect providers =

The interconnect provider binding is intended to represent the interconnect
controllers in the system. Each provider registers a set of interconnect
nodes, which expose the interconnect related capabilities of the interconnect
to consumer drivers. These capabilities can be throughput, latency, priority
etc. The consumer drivers set constraints on interconnect path (or endpoints)
depending on the usecase.

Required properties:
- compatible : contains the interconnect provider vendor specific compatible
	       string
- reg : register space of the interconnect controller hardware
- #interconnect-cells : number of cells in a interconnect specifier needed to
		       encode the interconnect node id.


Optional properties:
interconnect-port : A phandle and interconnect provider specifier as defined by
		bindings of the interconnect provider specified by phandle.
		This denotes the port to which the interconnect consumer is
		wired. It is used when there are multiple interconnect providers
		that have one or multiple links between them.

Example:

		snoc: snoc@0580000 {
			compatible = "qcom,msm-bus-snoc";
			reg = <0x580000 0x14000>;
			#interconnect-cells = <1>;
			clock-names = "bus_clk", "bus_a_clk";
			clocks = <&rpmcc RPM_SMD_SNOC_CLK>, <&rpmcc RPM_SMD_SNOC_A_CLK>;
			status = "okay";
			interconnect-port = <&bimc MAS_SNOC_CFG>,
					<&bimc SNOC_BIMC_0_MAS>,
					<&bimc SNOC_BIMC_1_MAS>,
					<&pnoc SNOC_PNOC_SLV>;
		};
		bimc: bimc@0400000 {
			compatible = "qcom,msm-bus-bimc";
			reg = <0x400000 0x62000>;
			#interconnect-cells = <1>;
			clock-names = "bus_clk", "bus_a_clk";
			clocks = <&rpmcc RPM_SMD_BIMC_CLK>, <&rpmcc RPM_SMD_BIMC_A_CLK>;
			status = "okay";
			interconnect-port = <&snoc BIMC_SNOC_MAS>;
		};
		pnoc: pnoc@500000 {
			compatible = "qcom,msm-bus-pnoc";
			reg = <0x500000 0x11000>;
			#interconnect-cells = <1>;
			clock-names = "bus_clk", "bus_a_clk";
			clocks = <&rpmcc RPM_SMD_PCNOC_CLK>, <&rpmcc RPM_SMD_PCNOC_A_CLK>;
			status = "okay";
			interconnect-port = <&snoc PNOC_SNOC_SLV>;
		};

= interconnect consumers =

The interconnect consumers are device nodes which consume the interconnect
path(s) provided by the interconnect provider. There can be multiple
interconnect providers on a SoC and the consumer may consume multiple paths
from different providers depending on usecase and the components it has to
interact with.

Required-properties:
interconnect-port : A phandle and interconnect provider specifier as defined by
		bindings of the interconnect provider specified by phandle.
		This denotes the port to which the interconnect consumer is
		wired.
interconnect-path : List of phandles to the data path endpoints.
interconnect-path-names : List of interconnect path name strings sorted in the
		same order as the interconnect-path property.  Consumers drivers
		will use interconnect-path-names to match the link names with
		interconnect specifiers.

Example:

	sdhci@07864000 {
		...
		interconnect-port = <&pnoc MAS_PNOC_SDCC_2>;
		interconnect-path = <&blsp1_uart2>;
		interconnect-path-names = "spi";
	};
```

## Documentation/devicetree/bindings/interrupt-controller/actions,owl-sirq.txt
```
Actions Semi Owl SoCs SIRQ interrupt controller

S500, S700 and S900 SoC's from Actions provides 3 SPI's from GIC,
in which external interrupt controller can be connected. 3 SPI's
45, 46, 47 from GIC are directly exposed as SIRQ. It has
the following properties:

- inputs three interrupt signal from external interrupt controller

Required properties:

- compatible: should be "actions,owl-sirq"
- reg: physical base address of the controller and length of memory mapped
  region.
- interrupt-controller: identifies the node as an interrupt controller
- #interrupt-cells: specifies the number of cells needed to encode an interrupt
  source, should be 2.
- actions,sirq-shared-reg: Applicable for S500 and S700 where SIRQ register
  details are maintained at same offset/register.
- actions,sirq-reg-offset: register offset for SIRQ interrupts. When registers are
  shared, all the three offsets will be same (S500 and S700).
- actions,ext-irq-range: Identifies external irq number range in different SoCs.

Example for S900:

sirq: interrupt-controller@e01b0000 {
	compatible = "actions,owl-sirq";
	reg = <0x0 0xe01b0000 0x0 0x1000>;
	interrupt-controller;
	#interrupt-cells = <3>;
	actions,sirq-offset = <0x200 0x528 0x52c>;
	actions,ext-irq-range = <13 15>;
};

Example for S700:

sirq: interrupt-controller@e01b0000 {
	compatible = "actions,owl-sirq";
	reg = <0x0 0xe01b0000 0x0 0x1000>;
	interrupt-controller;
	#interrupt-cells = <3>;
	actions,sirq-shared-reg;
	actions,sirq-reg-offset = <0x200 0x200 0x200>;
	actions,ext-irq-range = <13 15>;
};

Example for S500:

sirq: interrupt-controller@b01b0000 {
	compatible = "actions,owl-sirq";
	reg = <0x0 0xb01b0000 0x0 0x1000>;
	interrupt-controller;
	#interrupt-cells = <3>;
	actions,sirq-shared-reg;
	actions,sirq-offset = <0x200 0x200 0x200>;
	actions,ext-irq-range = <13 15>;
};
```

## Documentation/devicetree/bindings/interrupt-controller/amlogic,meson-gpio-intc.txt
```
Amlogic meson GPIO interrupt controller

Meson SoCs contains an interrupt controller which is able watch the SoC pads
and generate an interrupt on edges or level. The controller is essentially a
256 pads to 8 GIC interrupt multiplexer, with a filter block to select edge
or level and polarity. We don’t expose all 256 mux inputs because the
documentation shows that upper part is not mapped to any pad. The actual number
of interrupt exposed depends on the SoC.

Required properties:

- compatible : should be either
   "amlogic,meson8-gpio-intc” for meson8 SoCs (AML7826MX) or
   “amlogic,meson8b-gpio-intc” for meson8b SoCs (S805) or
   “amlogic,meson-gxbb-gpio-intc” for GXBB SoCs (S905)
- interrupt-parent : a phandle to the GIC the interrupts are routed to.
   Usually this is provided at the root level of the device tree as it is
   common to most of the SoC
- reg : Specifies base physical address and size of the registers.
- interrupt-controller : Identifies the node as an interrupt controller.
- #interrupt-cells : Specifies the number of cells needed to encode an
   interrupt source. The value must be 2.

Example:

gpio_interrupt: interrupt-controller@9880 {
	compatible = "amlogic,meson-gxbb-gpio-intc";
	reg = <0x0 0x9880 0x0 0x10>;
	interrupt-controller;
	#interrupt-cells = <2>;
};
```

## Documentation/devicetree/bindings/interrupt-controller/brcm,bcm2835-aux-intc.txt
```
BCM2835 Auxiliary ("AUXIRQ") Interrupt Controller

The BCM2835 family of SoCs multiplexes the interrupts for peripherals in
the AUX block into a single IRQ. The AUXIRQ register shows the IRQ status
of each of the peripherals. Note that there are no masking or clearing
facilities - interrupts must be enabled and acknowledged in the
individual peripherals.

Required properties:
- compatible :	     Should be "brcm,bcm2835-aux-intc".
- reg :		     Specifies base physical address and size of the registers.
- interrupts :	     The interrupt number - see
		     bindings/interrupt-controller/brcm,bcm2835-armctrl-ic.txt
- interrupt-controller : Identifies the node as an interrupt controller
- #interrupt-cells : Specifies the number of cells needed to encode an
		     interrupt source. The value shall be 1.

  The cell contains the interrupt specifier, as found in
  include/dt-bindings/interrupt-controller/bcm2835-aux-intc.h.

Example:

	auxintc: interrupt-controller@7e215000 {
		compatible = "brcm,bcm2835-aux-intc";
		reg = <0x7e215000 0x4>;
		interrupts = <1 29>;
		interrupt-controller;
```

## Documentation/devicetree/bindings/interrupt-controller/cirrus,madera.txt
```
Cirrus Logic Madera class audio codec IRQ driver

The IRQ properties are members of the parent MFD node.

See also the core bindings for the parent MFD driver:
See Documentation/devicetree/bindings/mfd/madera.txt

Required properties:
  - interrupt-controller : Madera class devices contain interrupt controllers
    and may provide interrupt services to other devices.

  - #interrupt-cells: the number of cells to describe an IRQ, this should be 2.
    The first cell is the IRQ number.
    The second cell is the flags, encoded as the trigger masks from
    bindings/interrupt-controller/interrupts.txt

  - interrupts : The interrupt line the /IRQ signal for the device is
    connected to.

  - interrupt-parent : The parent interrupt controller.

Example:

codec: cs47l85@0 {
	compatible = "cirrus,cs47l85";

	interrupt-controller;
	#interrupt-cells = <2>;
	interrupts = <&host_irq1>;
	interrupt-parent = <&gic>;
};
```

## Documentation/devicetree/bindings/interrupt-controller/fsl,ls-extirq.txt
```
* Freescale Layerscape external IRQs

Some Layerscape SOCs (LS1021A, LS1043A, LS1046A) support inverting
the polarity of certain external interrupt lines.

The device node must be a child of the node representing the
Supplemental Configuration Unit (SCFG).

Required properties:
- compatible: should be "fsl,<soc-name>-extirq", e.g. "fsl,ls1021a-extirq".
- interrupt-controller: Identifies the node as an interrupt controller
- #interrupt-cells: Use the same format as specified by GIC in arm,gic.txt.
- interrupt-parent: phandle of GIC.
- offset: offset to the Interrupt Polarity Control Register (INTPCR)
  register in the SCFG.
- interrupts: Specifies the mapping to interrupt numbers in the parent
  interrupt controller. Interrupts are mapped one-to-one to parent
  interrupts.

Optional properties:
- fsl,bit-reverse: This boolean property should be set on the LS1021A
  if the SCFGREVCR register has been set to all-ones (which is usually
  the case), meaning that all reads and writes of SCFG registers are
  implicitly bit-reversed. Other compatible platforms do not have such
  a register.

Example:
	scfg: scfg@1570000 {
		compatible = "fsl,ls1021a-scfg", "syscon";
		...
		extirq: interrupt-controller {
			compatible = "fsl,ls1021a-extirq";
			#interrupt-cells = <3>;
			interrupt-controller;
			interrupt-parent = <&gic>;
			offset = <0x1ac>;
			interrupts = <163 164 165 167 168 169>;
			fsl,bit-reverse;
		};
	};


	interrupts-extended = <&gic GIC_SPI 88 IRQ_TYPE_LEVEL_HIGH>,
			      <&extirq GIC_SPI 1 IRQ_TYPE_LEVEL_LOW>;
```

## Documentation/devicetree/bindings/interrupt-controller/google,goldfish-pic.txt
```
Android Goldfish PIC

Android Goldfish programmable interrupt device used by Android
emulator.

Required properties:

- compatible : should contain "google,goldfish-pic"
- reg        : <registers mapping>
- interrupts : <interrupt mapping>

Example:

        goldfish_pic@9020000 {
                compatible = "google,goldfish-pic";
                reg = <0x9020000 0x1000>;
                interrupts = <0x3>;
        };
```

## Documentation/devicetree/bindings/interrupt-controller/icpdas-lp8x4x-irq.txt
```
ICP DAS LP-8841 FPGA Interrupt Controller

ICP DAS LP-8841 contains FPGA chip. The chip functions as a interrupt
source providing 16 additional interrupts among other things.

Required properties:
- compatible : should be "icpdas,lp8x4x-irq"

- reg: physical base address of the controller and length of memory mapped
  region.

- interrupt-controller : identifies the node as an interrupt controller

- #interrupt-cells : should be 1

- interrupts : should provide interrupt

Optional properties:

- interrupt-parent : should provide a link to interrupt controller either
		     explicitly and implicitly from a parent node

Example:

fpgairq: irq@9006 {
	compatible = "icpdas,lp8841-irq";
	reg = <0x9006 0x16>;
	interrupt-parent = <&gpio>;
	interrupts = <3 IRQ_TYPE_EDGE_FALLING>;
	#interrupt-cells = <1>;
	interrupt-controller;
	status = "okay";
};

serial@9050 {
	compatible = "icpdas,lp8841-uart";
	reg =  <0x9050 0x10
		0x9030 0x02>;
	interrupts = <13>;
	status = "okay";
};

serial@9060 {
	compatible = "icpdas,lp8841-uart";
	reg =  <0x9060 0x10
		0x9032 0x02>;
	interrupts = <14>;
	status = "okay";
};
```

## Documentation/devicetree/bindings/interrupt-controller/iodata-landisk.txt
```
DT bindings for the I/O DATA HDL-U interrupt controler

Required properties:

  - compatible: has to be "iodata,landisk-intc".

  - reg: Base address and length of interrupt controller register.

  - interrupt-controller: Identifies the node as an interrupt controller.

  - #interrupt-cells: has to be <2>: an interrupt index and flags, as defined
    in interrupts.txt in this directory.

  - interrupt-map: Interrupt mapping on parent controler.

Example
-------

	cpldintc: cpld@b0000000 {
		compatible = "iodata,landisk-intc";
		#interrupt-cells = <2>;
		interrupt-controller;
		reg = <0xb0000000 8>;
		interrupt-map=<0 &shintc 0 0>, <1 &shintc 1 0>,
		              <2 &shintc 2 0>, <3 &shintc 3 0>,
		              <4 &shintc 4 0>, <5 &shintc 5 0>,
		              <6 &shintc 6 0>, <7 &shintc 7 0>;
	};
```

## Documentation/devicetree/bindings/interrupt-controller/irq-lp8x4x.txt
```
ICP DAS LP-8x4x FPGA Interrupt Controller

ICP DAS LP-8x4x contains FPGA chip. The chip functions as a interrupt
source providing 16 additional interrupts among other things.

Required properties:
- compatible : should be "icpdas,irq-lp8x4x"

- reg: physical base address of the controller and length of memory mapped
  region.

- interrupt-controller : identifies the node as an interrupt controller

- #interrupt-cells : should be 1

- interrupts : should provide interrupt

- interrupt-parent : should provide a link to interrupt controller either
		     explicitly and implicitly from a parent node

Example:

	fpga: fpga@17000006 {
		compatible = "icpdas,irq-lp8x4x";
		reg = <0x17000006 0x16>;
		interrupt-parent = <&gpio>;
		interrupts = <3 IRQ_TYPE_EDGE_RISING>;
		#interrupt-cells = <1>;
		interrupt-controller;
		status = "okay";
	};

	uart@17009050 {
		compatible = "icpdas,uart-lp8x4x";
		reg = <0x17009050 0x10
		       0x17009030 0x02>;
		interrupt-parent = <&fpga>;
		interrupts = <13>;
		status = "okay";
	};

	uart@17009060 {
		compatible = "icpdas,uart-lp8x4x";
		reg = <0x17009060 0x10
		       0x17009032 0x02>;
		interrupt-parent = <&fpga>;
		interrupts = <14>;
		status = "okay";
	};
```

## Documentation/devicetree/bindings/interrupt-controller/jcore,aic.txt
```
J-Core Advanced Interrupt Controller

Required properties:

- compatible : Should be "jcore,aic1" for the (obsolete) first-generation aic
  with 8 interrupt lines with programmable priorities, or "jcore,aic2" for
  the "aic2" core with 64 interrupts.

- interrupt-controller : Identifies the node as an interrupt controller

- #interrupt-cells : Specifies the number of cells needed to encode an
  interrupt source. The value shall be 1.

Additional properties required for aic1:

- reg : Memory region for configuration.

- cpu-offset : For SMP, the offset to the per-cpu memory region for
  configuration, to be scaled by the cpu number.


Example:

aic: interrupt-controller {
	compatible = "jcore,aic2";
	interrupt-controller;
	#interrupt-cells = <1>;
};
```
