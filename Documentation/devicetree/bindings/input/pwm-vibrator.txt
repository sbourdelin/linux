## Documentation/devicetree/bindings/interrupt-controller/marvell,sei.txt
```
Marvell SEI (System Error Interrupt) Controller
-----------------------------------------------

Marvell SEI (System Error Interrupt) controller is an interrupt
aggregator. It receives interrupts from several sources and aggregates
them to a single interrupt line (an SPI) on the parent interrupt
controller.

This interrupt controller can handle up to 64 SEIs, a set comes from the
AP and is wired while a second set comes from the CPs by the mean of
MSIs. Each 'domain' is represented as a subnode.

Required properties:

- compatible: should be "marvell,armada-8k-sei".
- reg: SEI registers location and length.
- interrupts: identifies the parent IRQ that will be triggered.

Child node 'sei-wired-controller' required properties:

- marvell,sei-ranges: ranges of wired interrupts.
- #interrupt-cells: number of cells to define an SEI wired interrupt
                    coming from the AP, should be 1. The cell is the IRQ
                    number.
- interrupt-controller: identifies the node as an interrupt controller.

Child node 'sei-msi-controller' required properties:

- marvell,sei-ranges: ranges of non-wired interrupts triggered by way of
                      MSIs.
- msi-controller: identifies the node as an MSI controller.

Example:

        sei: sei@3f0200 {
               compatible = "marvell,armada-8k-sei";
               reg = <0x3f0200 0x40>;
               interrupts = <GIC_SPI 0 IRQ_TYPE_LEVEL_HIGH>;

               sei_wired_controller: sei-wired-controller@0 {
                       marvell,sei-ranges = <0 21>;
                       #interrupt-cells = <1>;
                       interrupt-controller;
               };

               sei_msi_controller: sei-msi-controller@21 {
                       marvell,sei-ranges = <21 43>;
                       msi-controller;
               };
       };
```

## Documentation/devicetree/bindings/interrupt-controller/renesas,intc-irqpin.txt
```
DT bindings for the R-/SH-Mobile irqpin controller

Required properties:

- compatible:
    - "renesas,intc-irqpin-r8a7740" (R-Mobile A1)
    - "renesas,intc-irqpin-r8a7778" (R-Car M1A)
    - "renesas,intc-irqpin-r8a7779" (R-Car H1)
    - "renesas,intc-irqpin-sh73a0" (SH-Mobile AG5)
    - "renesas,rcar-gen1-intc-irqpin" (generic R-Car Gen1 compatible device)
    - "renesas,intc-irqpin"         (generic device)

    When compatible with a generic R-Car version, nodes must list the
    SoC-specific version corresponding to the platform first followed by
    the generic R-Car version.

    "renesas,intc-irqpin" must be present and last.

- reg: Base address and length of each register bank used by the external
  IRQ pins driven by the interrupt controller hardware module. The base
  addresses, length and number of required register banks varies with soctype.
- interrupt-controller: Identifies the node as an interrupt controller.
- #interrupt-cells: has to be <2>: an interrupt index and flags, as defined in
  interrupts.txt in this directory.
- interrupts: Must contain a list of interrupt specifiers. For each interrupt
  provided by this irqpin controller instance, there must be one entry,
  referring to the corresponding parent interrupt.

Optional properties:

- any properties, listed in interrupts.txt, and any standard resource allocation
  properties
- sense-bitfield-width: width of a single sense bitfield in the SENSE register,
  if different from the default 4 bits
- control-parent: disable and enable interrupts on the parent interrupt
  controller, needed for some broken implementations
- clocks: Must contain a reference to the functional clock.  This property is
  mandatory if the hardware implements a controllable functional clock for
  the irqpin controller instance.
- power-domains: Must contain a reference to the power domain. This property is
  mandatory if the irqpin controller instance is part of a controllable power
  domain.


Example
-------

	irqpin0: interrupt-controller@fe78001c {
		compatible = "renesas,intc-irqpin-r8a7779",
			     "renesas,rcar-gen1-intc-irqpin",
			     "renesas,intc-irqpin";
		#interrupt-cells = <2>;
		status = "disabled";
		interrupt-controller;
		reg = <0xfe78001c 4>,
			<0xfe780010 4>,
			<0xfe780024 4>,
			<0xfe780044 4>,
			<0xfe780064 4>,
			<0xfe780000 4>;
		interrupts = <GIC_SPI 27 IRQ_TYPE_LEVEL_HIGH
			      GIC_SPI 28 IRQ_TYPE_LEVEL_HIGH
			      GIC_SPI 29 IRQ_TYPE_LEVEL_HIGH
			      GIC_SPI 30 IRQ_TYPE_LEVEL_HIGH>;
		sense-bitfield-width = <2>;
	};
```

## Documentation/devicetree/bindings/interrupt-controller/renesas,rzn1-mux.txt
```
* Renesas RZ/N1 GPIO Interrupt Multiplexer

On Renesas RZ/N1 devices, there are several GPIO Controllers each with a number
of interrupt outputs. All of the interrupts from the GPIO Controllers are passed
to the GPIO Interrupt Multiplexer, which selects a sub-set of the interrupts to
pass onto the system interrupt controller.

A single node in the device tree is used to describe the GPIO IRQ Muxer.

Required properties:
- compatible: SoC-specific compatible string "renesas,<soc-specific>-gpioirqmux"
  followed by "renesas,rzn1-gpioirqmux" as fallback. The SoC-specific compatible
  strings must be one of:
	"renesas,r9a06g032-gpioirqmux" for RZ/N1D
	"renesas,r9a06g033-gpioirqmux" for RZ/N1S
- interrupt-controller: Identifies the node as an interrupt controller.
- #interrupt-cells: should be <1>. The meaning of the cells is the input
   interrupt index, 0 to 95.
- reg: Base address and size of GPIO IRQ Muxer registers.
- interrupts: This is a list of interrupt specifiers. Each interrupt consists of
   three numbers that represent:
     - (a) the index of the GPIO Interrupt Multiplexer output interrupt (0..7)
     - (b) the index of the GPIO Controller input interrupt (0..2)
     - (c) the interrupt index of the GPIO Controller input interrupt (0..31).
- interrupt-parent: A phandle for a local node that specifies an interrupt-map.
   The interrupt-map node must specify #interrupt-cells = <3>, and an
   interrupt-map property. The interrupt-map is used to translate the interrupt
   specifier to the output interrupts. It is used in conjunction with an
   interrupt-map-mask property to mask (b) and (c) from the interrupt specifier
   so that essentially there is a direct map from (a) to the output interrupt.
   Therefore (b) and (c) can be used to determine the interrupt source and
   configure the hardware accordingly. For information on interrupts,
   see Documentation/devicetree/bindings/interrupt-controller/interrupts.txt

Example:

	The following is an example for the RZ/N1D SoC.

	gpioirqmux: gpioirqmux@51000480 {
		compatible = "renesas,r9a06g032-gpioirqmux",
				"renesas,rzn1-gpioirqmux";
		reg = <0x51000480 0x20>;

		interrupt-controller;
		#interrupt-cells = <1>;
		interrupt-parent = <&gpioirqmux_map>;
		interrupts =
			<0 1 17>,	/* gpio1a 17 */
			<1 1 24>,	/* gpio1a 24 */
			<2 1 26>;	/* gpio1a 26 */

		gpioirqmux_map: gpioirqmux-map {
			#interrupt-cells = <3>;
			#address-cells = <0>;
			interrupt-map-mask = <7 0 0>;
			interrupt-map =
				<0 0 0 &gic GIC_SPI 103 IRQ_TYPE_LEVEL_HIGH>,
				<1 0 0 &gic GIC_SPI 104 IRQ_TYPE_LEVEL_HIGH>,
				<2 0 0 &gic GIC_SPI 105 IRQ_TYPE_LEVEL_HIGH>,
				<3 0 0 &gic GIC_SPI 106 IRQ_TYPE_LEVEL_HIGH>,
				<4 0 0 &gic GIC_SPI 107 IRQ_TYPE_LEVEL_HIGH>,
				<5 0 0 &gic GIC_SPI 108 IRQ_TYPE_LEVEL_HIGH>,
				<6 0 0 &gic GIC_SPI 109 IRQ_TYPE_LEVEL_HIGH>,
				<7 0 0 &gic GIC_SPI 110 IRQ_TYPE_LEVEL_HIGH>;
		};
	};

	gpio1: gpio@5000c000 {
		compatible = "snps,dw-apb-gpio";
		reg = <0x5000c000 0x80>;
		#address-cells = <1>;
		#size-cells = <0>;
		clock-names = "bus";
		clocks = <&sysctrl R9A06G032_HCLK_GPIO1>;

		gpio1a: gpio-controller@0 {
			compatible = "snps,dw-apb-gpio-port";
			bank-name = "gpio1a";
			gpio-controller;
			#gpio-cells = <2>;
			snps,nr-gpios = <32>;
			reg = <0>;

			interrupt-controller;
			interrupt-parent = <&gpioirqmux>;
			interrupts =   < 0  1  2  3  4  5  6  7
					 8  9 10 11 12 13 14 15
					16 17 18 19 20 21 22 23
					24 25 26 27 28 29 30 31 >;
			#interrupt-cells = <2>;
		};
	};
```
