## Documentation/devicetree/bindings/input/pwm-vibrator.txt
```
* PWM vibrator device tree bindings

Registers a PWM device as vibrator.

Required properties:
- compatible: should be
  * "pwm-vibrator"
    For vibrators controlled using the PWM channel's duty cycle (higher duty means
    the vibrator becomes stronger).
  * "motorola,mapphone-pwm-vibrator"
     For vibrator found in Motorola Droid 4. This vibrator generates a pulse for
     every rising edge, so its controlled using a duty cycle of 50% and changing
     the period time.
- pwm-names: Should contain "enable" and optionally "direction"
- pwms: Should contain a PWM handle for each entry in pwm-names

Example from Motorola Droid 4:

&omap4_pmx_core {
	vibrator_direction_pin: pinmux_vibrator_direction_pin {
		pinctrl-single,pins = <
		OMAP4_IOPAD(0x1ce, PIN_OUTPUT | MUX_MODE1) /* dmtimer8_pwm_evt (gpio_27) */
		>;
	};

	vibrator_enable_pin: pinmux_vibrator_enable_pin {
		pinctrl-single,pins = <
		OMAP4_IOPAD(0X1d0, PIN_OUTPUT | MUX_MODE1) /* dmtimer9_pwm_evt (gpio_28) */
		>;
	};
};

/ {
	pwm8: dmtimer-pwm {
		pinctrl-names = "default";
		pinctrl-0 = <&vibrator_direction_pin>;

		compatible = "ti,omap-dmtimer-pwm";
		#pwm-cells = <3>;
		ti,timers = <&timer8>;
		ti,clock-source = <0x01>;
	};

	pwm9: dmtimer-pwm {
		pinctrl-names = "default";
		pinctrl-0 = <&vibrator_enable_pin>;

		compatible = "ti,omap-dmtimer-pwm";
		#pwm-cells = <3>;
		ti,timers = <&timer9>;
		ti,clock-source = <0x01>;
	};

	vibrator {
		compatible = "pwm-vibrator";
		pwms = <&pwm8 0 1000000000 0>,
		       <&pwm9 0 1000000000 0>;
		pwm-names = "enable", "direction";
	};
};
```

## Documentation/devicetree/bindings/input/st,stpmu1-onkey.txt
```
STMicroelectronics STPMU1 Onkey

Required properties:

- compatible = "st,stpmu1-onkey";
- interrupt-parent: phandle to the parent interrupt controller
- interrupts: interrupt line to use
- interrupt-names = "onkey-falling", "onkey-rising"
	onkey-falling: happens when onkey is pressed; IT_PONKEY_F of pmic
	onkey-rising: happens when onkey is released; IT_PONKEY_R of pmic

Optional properties:

- st,onkey-pwroff-enabled: power off on long key-press
- st,onkey-long-press-seconds: long key-press duration from 1 to 16s
  (default 16s)
- st,onkey-clear-cc-flag: onkey is able power on after an
  over-current shutdown event.
- st,onkey-pu-inactive: onkey pull up is not active

Example:

onkey {
	compatible = "st,stpmu1-onkey";
	interrupt-parent = <&pmic>;
	interrupts = <7 0>,<6 1>;
	interrupt-names = "onkey-falling", "onkey-rising";
	status = "okay";
	st,onkey-pwroff-enabled;
	st,onkey-long-press-seconds = <10>;
};
```

## Documentation/devicetree/bindings/input/touchscreen/ar1021.txt
```
* Microchip AR1020 and AR1021 touchscreen interface (I2C)

Required properties:
- compatible		: use "microchip,ar1020-i2c" or "microchip,ar1021-i2c"
- reg			: I2C slave address
- interrupt-parent	: the phandle for the interrupt controller
- interrupts		: touch controller interrupt

Example:

	ar1020: ar1020@4d {
		compatible = "microchip,ar1020-i2c";
		reg = <0x4d>;
		interrupt-parent = <&gpio3>;
		interrupts = <11 IRQ_TYPE_LEVEL_HIGH>;
	};
```

## Documentation/devicetree/bindings/input/touchscreen/crtouch_ts.txt
```
* Freescale CRTOUCH based touchscreen

Required Properties:
- compatible must be fsl,crtouch_ts
- reg: I2C address of the touchscreen
- irq-gpio: GPIO to use as event IRQ

Example:

	touch: crtouch@49 {
		compatible = "fsl,crtouch_ts";
		reg = <0x49>;
		irq-gpio = <&gpio0 21 GPIO_ACTIVE_HIGH>;
	};
```

## Documentation/devicetree/bindings/input/touchscreen/cypress,cyttsp5.txt
```
* Cypress cyttsp touchscreen controller, generation 5

Required properties:
 - compatible		: must be "cypress,cyttsp5"
 - reg			: Device I2C address or SPI chip select number
 - interrupt-parent	: the phandle for the gpio controller
			  (see interrupt binding[0]).
 - interrupts		: (gpio) interrupt to which the chip is connected
			  (see interrupt binding[0]).

Optional properties:
 - reset-gpios		: the reset gpio the chip is connected to
			  (see GPIO binding[1] for more details).
Some other touchscreen optional properties can be defined such as
"touchscreen-size-x". See ./touchscreen.txt[2] for more details.

This touchscreen can handle some buttons that are touchscreen's defined zones.
Each button's event can be customized using a property:
	- linux,keycodes: List of keycode to emit.

[0]: Documentation/devicetree/bindings/interrupt-controller/interrupts.txt
[1]: Documentation/devicetree/bindings/gpio/gpio.txt
[2]: Documentation/devicetree/bindings/input/touchscreen/touchscreen.txt

Example:
&i2c0 {
	[...]

	touchscreen@24 {
		compatible = "cypress,cyttsp5";
		reg = <0x24>;

		interrupt-parent = <&pio>;
		interrupts = <1 5 IRQ_TYPE_LEVEL_LOW>;
		reset-gpios = <&pio 7 1 GPIO_ACTIVE_HIGH>;
		touchscreen-swapped-x-y;
		linux,keycodes = <KEY_HOMEPAGE>, <KEY_MENU>, <KEY_BACK>;
	};
};
```

## Documentation/devicetree/bindings/input/touchscreen/cyttsp.txt
```
* Cypress cyttsp touchscreen controller

Required properties:
- compatible		: must be "cypress,cyttsp-i2c" or "cypress,cyttsp-spi"
- reg			: Device I2C address or SPI chip select number
- spi-max-frequency 	: Maximum SPI clocking speed of the device (for cyttsp-spi)
- interrupt-parent	: the phandle for the gpio controller
			  (see interrupt binding[0]).
- interrupts		: (gpio) interrupt to which the chip is connected
			  (see interrupt binding[0]).
- reset-gpios		: the reset gpio the chip is connected to
			  (see GPIO binding[1] for more details).
- touchscreen-size-x	: horizontal resolution of touchscreen (in pixels)
- touchscreen-size-y	: vertical resolution of touchscreen (in pixels)
- bootloader-key	: the 8-byte bootloader key that is required to switch
			  the chip from bootloader mode (default mode) to
			  application mode.
			  This property has to be specified as an array of 8
			  '/bits/ 8' values.

Optional properties:
- active-distance	: the distance in pixels beyond which a touch must move
			  before movement is detected and reported by the device.
			  Valid values: 0-15.
- active-interval-ms	: the minimum period in ms between consecutive
			  scanning/processing cycles when the chip is in active mode.
			  Valid values: 0-255.
- lowpower-interval-ms	: the minimum period in ms between consecutive
			  scanning/processing cycles when the chip is in low-power mode.
			  Valid values: 0-2550
- touch-timeout-ms	: minimum time in ms spent in the active power state while no
			  touches are detected before entering low-power mode.
			  Valid values: 0-2550

[0]: Documentation/devicetree/bindings/interrupt-controller/interrupts.txt
[1]: Documentation/devicetree/bindings/gpio/gpio.txt

Example:
	&i2c1 {
		/* ... */
		cyttsp@a {
			compatible = "cypress,cyttsp-i2c";
			reg = <0xa>;
			interrupt-parent = <&msm_gpio>;
			interrupts = <13 0x2008>;
			reset-gpios = <&msm_gpio 12 0x00>;

			touchscreen-size-x = <800>;
			touchscreen-size-y = <480>;
			bootloader-key = /bits/ 8 <0x01 0x02 0x03 0x04 0x05 0x06 0x07 0x08>;

			active-distance = <8>;
			active-interval-ms = <0>;
			lowpower-interval-ms = <200>;
			touch-timeout-ms = <100>;
		};

		/* ... */
	};

	&mcspi1 {
		/* ... */
		cyttsp@0 {
			compatible = "cypress,cyttsp-spi";
			spi-max-frequency = <6000000>;
			reg = <0>;
			interrupt-parent = <&msm_gpio>;
			interrupts = <13 0x2008>;
			reset-gpios = <&msm_gpio 12 0x00>;

			touchscreen-size-x = <800>;
			touchscreen-size-y = <480>;
			bootloader-key = /bits/ 8 <0x01 0x02 0x03 0x04 0x05 0x06 0x07 0x08>;

			active-distance = <8>;
			active-interval-ms = <0>;
			lowpower-interval-ms = <200>;
			touch-timeout-ms = <100>;
		};

		/* ... */
	};
```

## Documentation/devicetree/bindings/input/touchscreen/cyttsp5.txt
```
* Cypress cyttsp touchscreen controller, generation 5

Required properties:
 - compatible		: must be "cypress,cyttsp5"
 - reg			: Device I2C address or SPI chip select number
 - interrupt-parent	: the phandle for the gpio controller
			  (see interrupt binding[0]).
 - interrupts		: (gpio) interrupt to which the chip is connected
			  (see interrupt binding[0]).

Optional properties (many of them coming from touchscreen binding[1]):
 - reset-gpios		: the reset gpio the chip is connected to
			  (see GPIO binding[2] for more details).
 - touchscreen-size-x	: horizontal resolution of touchscreen (in pixels)
 - touchscreen-size-y	: vertical resolution of touchscreen (in pixels)
 - touchscreen-fuzz-x	: horizontal noise value of the absolute input device
			  (in pixels)
 - touchscreen-fuzz-y	: vertical noise value of the absolute input device
			  (in pixels)

This touchscreen can handle some buttons that are touchscreen's defined zones.
Each button's event can be customized using a sub-node properties:
	- linux,code: Keycode to emit.

[0]: Documentation/devicetree/bindings/interrupt-controller/interrupts.txt
[1]: Documentation/devicetree/bindings/input/touchscreen/touchscreen.txt
[2]: Documentation/devicetree/bindings/gpio/gpio.txt

Example:
&i2c0 {
	[...]

	tsc@24 {
		compatible = "cypress,cyttsp5";
		reg = <0x24>;

		pinctrl-names = "default";
		pinctrl-0 = <&tp_reset_ds203>;
		interrupt-parent = <&pio>;
		interrupts = <1 5 IRQ_TYPE_LEVEL_LOW>;
		reset-gpios = <&pio 7 1 GPIO_ACTIVE_HIGH>;

		button@0 {
			linux,code = <KEY_HOMEPAGE>;
		};

		button@1 {
			linux,code = <KEY_MENU>;
		};

		button@2 {
			linux,code = <KEY_BACK>;
		};
	};
};
```

## Documentation/devicetree/bindings/input/touchscreen/sis_i2c.txt
```
* SiS I2C Multiple Touch Controller

Required properties:
- compatible: must be "sis,9200_ts"
- reg: i2c slave address
- interrupt-parent: the phandle for the interrupt controller
- interrupts: touch controller interrupt
- irq-gpio: the gpio pin used as irq pin
- reset-gpio: the gpio pin used to reset the controller 

Example:

	sis9255@5c  {
                compatible = "sis,9200_ts";
                reg = <0x5c>;
                pinctrl-names = "default";
                pinctrl-0 = <&pinctrl_sis>;
                interrupt-parent = <&gpio3>;
                interrupts = <19 2>;
                irq-gpio = <&gpio3 19 0>;
                reset-gpio = <&gpio2 30 0>;
	};
```

## Documentation/devicetree/bindings/input/touchscreen/stmpe.txt
```
STMPE Touchscreen
----------------

Required properties:
 - compatible: "st,stmpe-ts"

Optional properties:
- st,ave-ctrl: Sample average control (0 -> 1 sample, 1 -> 2 samples, 2 -> 4
  samples, 3 -> 8 samples)
- st,touch-det-delay: Touch detect interrupt delay (0 -> 10 us, 1 -> 50 us, 2 ->
  100 us, 3 -> 500 us, 4-> 1 ms, 5 -> 5 ms, 6 -> 10 ms, 7 -> 50 ms) recommended
  is 3
- st,settling: Panel driver settling time (0 -> 10 us, 1 -> 100 us, 2 -> 500 us, 3
  -> 1 ms, 4 -> 5 ms, 5 -> 10 ms, 6 for 50 ms, 7 -> 100 ms) recommended is 2
- st,fraction-z: Length of the fractional part in z (fraction-z ([0..7]) = Count of
  the fractional part) recommended is 7
- st,i-drive: current limit value of the touchscreen drivers (0 -> 20 mA typical 35
  mA max, 1 -> 50 mA typical 80 mA max)

Node name must be stmpe_touchscreen and should be child node of stmpe node to
which it belongs.

Example:

	stmpe_touchscreen {
		compatible = "st,stmpe-ts";
		st,ave-ctrl = <1>;
		st,touch-det-delay = <2>;
		st,settling = <2>;
		st,fraction-z = <7>;
		st,i-drive = <1>;
	};
```

## Documentation/devicetree/bindings/input/touchscreen/tsc2004.txt
```
* Texas Instruments tsc2004 touchscreen controller

Required properties:
 - compatible		      : "ti,tsc2004"
 - interrupts		      : IRQ specifier
 - vio-supply                 : Regulator specifier

Optional properties:
 - reset-gpios		      : GPIO specifier
 - ti,x-plate-ohms	      : integer, resistance of the touchscreen's X plates
				in ohm (defaults to 280)
 - ti,esd-recovery-timeout-ms : integer, if the touchscreen does not respond after
				the configured time (in milli seconds), the driver
				will reset it. This is disabled by default.
 - properties defined in touchscreen.txt

Example:

&i2c3 {
	tsc2004@48 {
		compatible = "ti,tsc2004";
		reg = <0x48>;
		vio-supply = <&vio>;

		reset-gpios = <&gpio4 8 GPIO_ACTIVE_HIGH>;
		interrupts-extended = <&gpio1 27 IRQ_TYPE_EDGE_RISING>;

		touchscreen-fuzz-x = <4>;
		touchscreen-fuzz-y = <7>;
		touchscreen-fuzz-pressure = <2>;
		touchscreen-size-x = <4096>;
		touchscreen-size-y = <4096>;
		touchscreen-max-pressure = <2048>;

		ti,x-plate-ohms = <280>;
		ti,esd-recovery-timeout-ms = <8000>;
	};
}
```

## Documentation/devicetree/bindings/input/tps65217-pwrbutton.txt
```
Texas Instruments TPS65217 power button

This module is part of the TPS65217. For more details about the whole
chip see Documentation/devicetree/bindings/regulator/tps65217.txt.

This module provides a simple power button event via an Interrupt.

Required properties:
- compatible: should be "ti,tps65217-pwrbutton"

Example:

&tps {
	tps65217-pwrbutton {
		compatible = "ti,tps65217-pwrbutton";
	};
};
```
