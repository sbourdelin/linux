## Documentation/devicetree/bindings/cpufreq/brcm-avs-cpufreq.txt
```
Broadcom AVS CPUfreq driver
===========================

This driver provides voltage and frequency scaling on Broadcom SoCs using
the AVS firmware with DVFS support. The AVS firmware is running on its own
co-processor. The driver supports both uniprocessor (UP) and symmetric
multiprocessor (SMP) systems which share clock and voltage across all CPUs.

Actual voltage and frequency scaling is done solely by the AVS firmware.
This driver does not change frequency or voltage itself. It provides a
standard CPUfreq interface to the rest of the kernel and to userland. It
interfaces with the AVS firmware to effect the requested changes and to
report back the current system status in a way that is expected by existing
tools.

This driver requires two DT nodes. One node (brcm,avs-cpu-data-mem)
references the mailbox register used to communicate with the AVS CPU. The
second node (brcm,avs-cpu-l2-intr) is required to trigger an interrupt on
the AVS CPU. The interrupt tells the AVS CPU that it needs to process a
command sent to it by this driver. Interrupting the AVS CPU is mandatory for
commands to be processed.

It also requires a reference to the AVS host interrrupt controller, so the
driver can react to interrupts generated by the AVS CPU whenever a command
has been processed. See [1] for more information on the brcm,l2-intc.

[1] Documentation/devicetree/bindings/interrupt-controller/brcm,l2-intc.txt


Node brcm,avs-cpu-data-mem
--------------------------

Required properties:
- compatible: Sould be one of: brcm,avs-cpu-data-mem,
              brcm,bcm7271-avs-cpu-data-mem or brcm,bcm7268-avs-cpu-data-mem
- reg: Specifies base physical address and size of the registers.
- interrupts: The interrupt that the AVS CPU will use to interrupt the host
              when a command completed.
- interrupt-parent: The interrupt controller the above interrupt is routed
                    through.
- interrupt-names: The name of the interrupt used to interrupt the host.

Optional properties:
- None

Node brcm,avs-cpu-l2-intr
-------------------------

Required properties:
- compatible: Sould be one of: brcm,avs-cpu-l2-intr,
              brcm,bcm7271-avs-cpu-l2-intr or brcm,bcm7268-avs-cpu-l2-intr
- reg: Specifies base physical address and size of the registers.

Optional properties:
- None


Example
=======

	avs_host_l2_intc: interrupt-controller@f04d1200 {                
		#interrupt-cells = <1>;                                  
		compatible = "brcm,l2-intc";                             
		interrupt-parent = <&intc>;                              
		reg = <0xf04d1200 0x48>;                                 
		interrupt-controller;                                    
		interrupts = <0x0 0x19 0x0>;                             
		interrupt-names = "avs";                                 
	};                                                               

	avs-cpu-data-mem@f04c4000 {
		compatible = "brcm,bcm7271-avs-cpu-data-mem",
				"brcm,avs-cpu-data-mem";
		reg = <0xf04c4000 0x60>;
		interrupts = <0x1a>;
		interrupt-parent = <&avs_host_l2_intc>;
		interrupt-names = "sw_intr";
	};

	avs-cpu-l2-intr@f04d1100 {
		compatible = "brcm,bcm7271-avs-cpu-l2-intr",
				"brcm,avs-cpu-l2-intr";
		reg = <0xf04d1100 0x10>;
	};
```

## Documentation/devicetree/bindings/cpufreq/cpufreq-qcom-fw.txt
```
Qualcomm Technologies, Inc. CPUFREQ Bindings

CPUFREQ FW is a hardware engine used by some Qualcomm Technologies, Inc. (QTI)
SoCs to manage frequency in hardware. It is capable of controlling frequency
for multiple clusters.

Properties:
- compatible
	Usage:		required
	Value type:	<string>
	Definition:	must be "qcom,cpufreq-fw".

* Property qcom,freq-domain
Devices supporting freq-domain must set their "qcom,freq-domain" property with
phandle to a freq_domain_table in their DT node.

* Frequency Domain Table Node

This describes the frequency domain belonging to a device.
This node can have following properties:

- reg
	Usage:		required
	Value type:	<prop-encoded-array>
	Definition:	Addresses and sizes for the memory of the perf
			, lut and enable bases.
			perf - indicates the base address for the desired
			performance state to be set.
			lut - indicates the look up table base address for the
			cpufreq	driver to read frequencies.
			enable - indicates the enable register for firmware.
- reg-names
	Usage:		required
	Value type:	<stringlist>
	Definition:	Address names. Must be "perf", "lut", "enable".
			Must be specified in the same order as the reg property.

Example:

Example 1: Dual-cluster, Quad-core per cluster. CPUs within a cluster switch
DCVS state together.

/ {
	cpus {
		#address-cells = <2>;
		#size-cells = <0>;

		CPU0: cpu@0 {
			device_type = "cpu";
			compatible = "qcom,kryo385";
			reg = <0x0 0x0>;
			enable-method = "psci";
			next-level-cache = <&L2_0>;
			qcom,freq-domain = <&freq_domain_table0>;
			L2_0: l2-cache {
				compatible = "cache";
				next-level-cache = <&L3_0>;
				L3_0: l3-cache {
				      compatible = "cache";
				};
			};
		};

		CPU1: cpu@100 {
			device_type = "cpu";
			compatible = "qcom,kryo385";
			reg = <0x0 0x100>;
			enable-method = "psci";
			next-level-cache = <&L2_100>;
			qcom,freq-domain = <&freq_domain_table0>;
			L2_100: l2-cache {
				compatible = "cache";
				next-level-cache = <&L3_0>;
			};
		};

		CPU2: cpu@200 {
			device_type = "cpu";
			compatible = "qcom,kryo385";
			reg = <0x0 0x200>;
			enable-method = "psci";
			next-level-cache = <&L2_200>;
			qcom,freq-domain = <&freq_domain_table0>;
			L2_200: l2-cache {
				compatible = "cache";
				next-level-cache = <&L3_0>;
			};
		};

		CPU3: cpu@300 {
			device_type = "cpu";
			compatible = "qcom,kryo385";
			reg = <0x0 0x300>;
			enable-method = "psci";
			next-level-cache = <&L2_300>;
			qcom,freq-domain = <&freq_domain_table0>;
			L2_300: l2-cache {
				compatible = "cache";
				next-level-cache = <&L3_0>;
			};
		};

		CPU4: cpu@400 {
			device_type = "cpu";
			compatible = "qcom,kryo385";
			reg = <0x0 0x400>;
			enable-method = "psci";
			next-level-cache = <&L2_400>;
			qcom,freq-domain = <&freq_domain_table1>;
			L2_400: l2-cache {
				compatible = "cache";
				next-level-cache = <&L3_0>;
			};
		};

		CPU5: cpu@500 {
			device_type = "cpu";
			compatible = "qcom,kryo385";
			reg = <0x0 0x500>;
			enable-method = "psci";
			next-level-cache = <&L2_500>;
			qcom,freq-domain = <&freq_domain_table1>;
			L2_500: l2-cache {
				compatible = "cache";
				next-level-cache = <&L3_0>;
			};
		};

		CPU6: cpu@600 {
			device_type = "cpu";
			compatible = "qcom,kryo385";
			reg = <0x0 0x600>;
			enable-method = "psci";
			next-level-cache = <&L2_600>;
			qcom,freq-domain = <&freq_domain_table1>;
			L2_600: l2-cache {
				compatible = "cache";
				next-level-cache = <&L3_0>;
			};
		};

		CPU7: cpu@700 {
			device_type = "cpu";
			compatible = "qcom,kryo385";
			reg = <0x0 0x700>;
			enable-method = "psci";
			next-level-cache = <&L2_700>;
			qcom,freq-domain = <&freq_domain_table1>;
			L2_700: l2-cache {
				compatible = "cache";
				next-level-cache = <&L3_0>;
			};
		};
	};

	qcom,cpufreq-fw {
		compatible = "qcom,cpufreq-fw";

		#address-cells = <1>;
		#size-cells = <1>;

		freq_domain_table0 : freq_table0 {
			reg = <0x17d43920 0x4>, <0x17d43110 0x500>,
				 <0x17d41000 0x4>;
			reg-names = "perf", "lut", "enable";
		};

		freq_domain_table1 : freq_table1 {
			reg = <0x17d46120 0x4>, <0x17d45910 0x500>,
				<0x17d45800 0x4> ;
			reg-names = "perf", "lut", "enable";
		};
	};
```
