## Documentation/devicetree/bindings/clock/marvell,berlin4ct.txt
```
* Marvell berlin4ct Clock Controllers

This binding uses the common clock binding[1].

[1] Documentation/devicetree/bindings/clock/clock-bindings.txt

The berlin4ct clock subsystem generates and supplies clock to various
controllers within the berlin4ct SoC. The berlin4ct contains 3 clock controller
blocks: pll, gateclk, berlin-clk.

Required Properties:

- compatible: should be one of the following.
  - "marvell,berlin-pll" - pll compatible
  - "marvell,berlin4ct-clk" - berlin clk compatible
  - "marvell,berlin4ct-gateclk" - gateclk compatible
- reg: physical base address of the clock controller and length of memory mapped
  region. For pll, the second reg defines the bypass register base address and
  length of memory mapped region.
- #clock-cells: for pll should 0, for gateclk and berlin clk should be 1.
- #bypass-shift: the bypass bit in bypass register.

Example:

syspll: syspll {
	compatible = "marvell,berlin-pll";
	reg = <0xea0200 0x14>, <0xea0710 4>;
	#clock-cells = <0>;
	clocks = <&osc>;
	bypass-shift = /bits/ 8 <0>;
};

clk: clk {
	compatible = "marvell,berlin4ct-clk";
	reg = <0xea0720 0x144>;
	#clock-cells = <1>;
	clocks = <&syspll>;
};
```

## Documentation/devicetree/bindings/clock/nxp,74aup1g157gw.txt
```
NXP 74AUP1G157GW Low-power 2-input multiplexer for clock

Required properties:
- compatible:	"nxp,74aup1g157gw-clk"      (select closest input as output)
		"nxp,74aup1g157gw-audio-clk (select 48kHz / 44.1kHz as output)
- clocks:	select input clock as i0, i1
- clock-names:	"i0" and "i1"
- sel-gpios:	selector pin

Examples:

	clk {
		#clock-cells = <0>;
		compatible = "nxp,74aup1g157gw-audio-clk";
		clocks = <&clk8snd>, <&clksnd>;
		clock-names = "i0", "i1";
		sel-gpios = <&gpio_exp_75 13 GPIO_ACTIVE_HIGH>;
	};
```

## Documentation/devicetree/bindings/clock/qcom,lpasscc.txt
```
Qualcomm LPASS Clock Controller Binding
-----------------------------------------------

Required properties :
- compatible	: shall contain "qcom,sdm845-lpasscc"
- #clock-cells	: from common clock binding, shall contain 1.
- reg		: shall contain base register address and size.
- reg-names	: shall contain the register names of LPASS domain
			"lpass_gcc", "lpass_cc", "lpass_qdsp6ss".

Example:

The below node has to be defined in the cases where the LPASS peripheral loader
would bring the subsystem out of reset.

	lpasscc: clock-controller {
		compatible = "qcom,sdm845-lpasscc";
		reg = <0x00147000 0x20>, <0x17014000 0x1f004>,
			<0x17300020 0x20>;
		reg-names = "lpass_gcc", "lpass_cc", "lpass_qdsp6ss";
		#clock-cells = <1>;
	};
```

## Documentation/devicetree/bindings/clock/qoriq-clock.txt
```
* Clock Block on Freescale QorIQ Platforms

Freescale QorIQ chips take primary clocking input from the external
SYSCLK signal. The SYSCLK input (frequency) is multiplied using
multiple phase locked loops (PLL) to create a variety of frequencies
which can then be passed to a variety of internal logic, including
cores and peripheral IP blocks.
Please refer to the Reference Manual for details.

All references to "1.0" and "2.0" refer to the QorIQ chassis version to
which the chip complies.

Chassis Version		Example Chips
---------------		-------------
1.0			p4080, p5020, p5040
2.0			t4240, b4860

1. Clock Block Binding

Required properties:
- compatible: Should contain a chip-specific clock block compatible
	string and (if applicable) may contain a chassis-version clock
	compatible string.

	Chip-specific strings are of the form "fsl,<chip>-clockgen", such as:
	* "fsl,p2041-clockgen"
	* "fsl,p3041-clockgen"
	* "fsl,p4080-clockgen"
	* "fsl,p5020-clockgen"
	* "fsl,p5040-clockgen"
	* "fsl,t1023-clockgen"
	* "fsl,t1024-clockgen"
	* "fsl,t1040-clockgen"
	* "fsl,t1042-clockgen"
	* "fsl,t2080-clockgen"
	* "fsl,t2081-clockgen"
	* "fsl,t4240-clockgen"
	* "fsl,b4420-clockgen"
	* "fsl,b4860-clockgen"
	* "fsl,ls1012a-clockgen"
	* "fsl,ls1021a-clockgen"
	* "fsl,ls1043a-clockgen"
	* "fsl,ls1046a-clockgen"
	* "fsl,ls1088a-clockgen"
	* "fsl,ls2080a-clockgen"
	Chassis-version clock strings include:
	* "fsl,qoriq-clockgen-1.0": for chassis 1.0 clocks
	* "fsl,qoriq-clockgen-2.0": for chassis 2.0 clocks
- reg: Describes the address of the device's resources within the
	address space defined by its parent bus, and resource zero
	represents the clock register set

Optional properties:
- ranges: Allows valid translation between child's address space and
	parent's. Must be present if the device has sub-nodes.
- #address-cells: Specifies the number of cells used to represent
	physical base addresses.  Must be present if the device has
	sub-nodes and set to 1 if present
- #size-cells: Specifies the number of cells used to represent
	the size of an address. Must be present if the device has
	sub-nodes and set to 1 if present
- clock-frequency: Input system clock frequency (SYSCLK)
- clocks: If clock-frequency is not specified, sysclk may be provided
	as an input clock.  Either clock-frequency or clocks must be
	provided.
	A second input clock, called "coreclk", may be provided if
	core PLLs are based on a different input clock from the
	platform PLL.
- clock-names: Required if a coreclk is present.  Valid names are
	"sysclk" and "coreclk".

2. Clock Provider

The clockgen node should act as a clock provider, though in older device
trees the children of the clockgen node are the clock providers.

When the clockgen node is a clock provider, #clock-cells = <2>.
The first cell of the clock specifier is the clock type, and the
second cell is the clock index for the specified type.

	Type#	Name		Index Cell
	0	sysclk		must be 0
	1	cmux		index (n in CLKCnCSR)
	2	hwaccel		index (n in CLKCGnHWACSR)
	3	fman		0 for fm1, 1 for fm2
	4	platform pll	0=pll, 1=pll/2, 2=pll/3, 3=pll/4
				4=pll/5, 5=pll/6, 6=pll/7, 7=pll/8
	5	coreclk		must be 0

3. Example

	clockgen: global-utilities@e1000 {
		compatible = "fsl,p5020-clockgen", "fsl,qoriq-clockgen-1.0";
		clock-frequency = <133333333>;
		reg = <0xe1000 0x1000>;
		#clock-cells = <2>;
	};

	fman@400000 {
		...
		clocks = <&clockgen 3 0>;
		...
	};
}
```

## Documentation/devicetree/bindings/clock/renesas,avb-clk.txt
```
* Renesas AVB Counter Clock

The AVB Counter Clocks are provided by avb_counter8 Clock Generator,
avb_counter8 has dividers which operates with S0D1ϕ clock and has
8 output clocks.

Required Properties:
  - compatible: Must be "renesas,clk-avb"
  - reg: Base address and length of the memory resource used by the AVB
  - #clock-cells: Must be 1

Example
-------

	clk_avb: avb-clock@ec5a011c {
		compatible = "renesas,clk-avb";
		reg = <0 0xec5a011c 0 0x24>;
		#clock-cells = <1>;
	};
```

## Documentation/devicetree/bindings/clock/renesas,r9a06g032-sysctrl.txt
```
* Renesas R9A06G032 SYSCTRL

Required Properties:

  - compatible: Must be:
    - "renesas,r9a06g032-sysctrl"
  - reg: Base address and length of the SYSCTRL IO block.
  - #clock-cells: Must be 1

Examples
--------

  - SYSCTRL node:

	sysctrl: system-controller@4000c000 {
		compatible = "renesas,r9a06g032-sysctrl";
		reg = <0x4000c000 0x1000>;
		#clock-cells = <1>;
	};

  - Other nodes can use the clocks provided by SYSCTRL as in:

	#include <dt-bindings/clock/r9a06g032-sysctrl.h>
	uart0: serial@40060000 {
		compatible = "snps,dw-apb-uart";
		reg = <0x40060000 0x400>;
		interrupts = <GIC_SPI 6 IRQ_TYPE_LEVEL_HIGH>;
		reg-shift = <2>;
		reg-io-width = <4>;
		clocks = <&sysctrl R9A06G032_CLK_UART0>;
		clock-names = "baudclk";
	};
```

## Documentation/devicetree/bindings/clock/renesas,rzn1-clocks.txt
```
* Renesas RZ/N1 Clock Driver

This driver provides the clock infrastructure used by all the other drivers.

One of the 'special' feature of this infrastructure is that Linux doesn't
necessary 'own' all the clocks on the SoC, some other OS runs on
the Cortex-M3 core and that OS can access and claim it's own clocks.

Required Properties:

  - compatible: Must be
    - "renesas,r9a06g032-clocks" for the RZ/N1D
    and "renesas,rzn1-clocks" as a fallback.
  - reg: Base address and length of the memory resource used by the driver
  - #clock-cells: Must be 1

Examples
--------

  - Clock driver device node:

	clock: clocks@4000c000 {
		compatible = "renesas,r9a06g032-clocks",
				"renesas,rzn1-clocks";
		reg = <0x4000c000 0x1000>;
		status = "okay";
		#clock-cells = <1>;
	};


  - Other drivers can use the clocks as in:

	uart0: serial@40060000 {
		compatible = "snps,dw-apb-uart";
		reg = <0x40060000 0x400>;
		interrupts = <GIC_SPI 6 IRQ_TYPE_LEVEL_HIGH>;
		reg-shift = <2>;
		reg-io-width = <4>;
		clocks = <&clock RZN1_CLK_UART0>;
		clock-names = "baudclk";
	};
    Note the use of RZN1_CLK_UART0 -- these constants are declared in
    the rzn1-clocks.h header file. These are not hardware based constants
    and are Linux specific.
```

## Documentation/devicetree/bindings/clock/renesas,sh7750-div-clock.txt
```
* Renesas SH7750/51 divider clock

Required Properties:

  - compatible: Must be "renesas,sh7750-div-clock"

  - clocks: Reference to the parent clocks (mostly PLL)

  - #clock-cells: Must be 0

  - reg: Base address and length of the divide rate selector

  - renesas,offset: bit offset of selector

  - clock-output-names: The names of the clocks.

Example
-------

        iclk: iclk {
                compatible = "renesas,sh7750-div-clock";
                clocks = <&pllclk>;
                #clock-cells = <0>;
                reg = <0xffc00000 2>;
		renesas,offset = <6>;
		clock-output-names = "ick";
        };
```

## Documentation/devicetree/bindings/clock/renesas,sh7750-pll-clock.txt
```
Renesas SH7750/51 PLL clock

This device is Clock multiplyer

Required Properties:

  - compatible: Must be "renesas,sh7750-pll-clock"

  - clocks: Reference to the parent clocks

  - #clock-cells: Must be 0

  - renesas,mult: PLL1 multiply rate

  - reg: Two rate selector (FRQCR / WDT) register address

Example
-------

        pllclk: pllclk {
                compatible = "renesas,sh7750-pll-clock";
                clocks = <&oclk>;
                #clock-cells = <0>;
		renesas,mult = <12>;
                reg = <0xffc00000 2>, <0xffc00008 4>;
        };
```

## Documentation/devicetree/bindings/clock/rohm,bd71837-clock.txt
```
ROHM BD71837 Power Management Integrated Circuit clock bindings

This is a part of device tree bindings of ROHM BD71837 multi-function
device. See generic BD71837 MFD bindings at:
	Documentation/devicetree/bindings/mfd/rohm,bd71837-pmic.txt

BD71837 contains one 32,768 KHz clock output which can be enabled and
disabled via i2c.

Following properties should be present in main device node of the MFD chip.

Required properties:
- clock-frequency	: Should be 32768
- #clock-cells		: Should be 0

Optional properties:
- clock-output-names	: Should contain name for output clock.

Example:

/* MFD node */

pmic: pmic@4b {
	compatible = "rohm,bd71837";
	/* ... */
	#clock-cells = <0>;
	clock-frequency  = <32768>;
	/* ... */
};

/* Clock consumer node */

foo@0 {
	compatible = "bar,foo";
	/* ... */
	clock-names = "my-clock";
	clocks = <&pmic>;
};
```

## Documentation/devicetree/bindings/clock/sprd-ccu.txt
```
Spreadtrum Clock Control Unit Binding
------------------------------------

This binding uses the common clock binding[1].

Required properties:
- compatible: must contain the following compatible:
                - "sprd,sc9860-ccu" (only support SC9860 for the time being)

- reg:	Must contain the registers base address and length.
	Clocks on most of Spreadtrum's SoCs were designed to locate in a few
	different address areas, so there would be more than one items under
	this property.

- clock-names:	Must contain the following clock names:
		- "ext-26m", "ext-rco-100m", "ext-32k"
- #clock-cells: must be 1

Example:

ccu: clk {
	compatible = "sprd,sc9860-ccu";
	#clock-cells = <1>;
	reg = <0 0x20000000 0 0x400>,
	      <0 0x20210000 0 0x3000>,
	      <0 0x402b0000 0 0x4000>,
	      <0 0x402d0000 0 0x400>,
	      <0 0x402e0000 0 0x4000>,
	      <0 0x40400000 0 0x400>,
	      <0 0x40880000 0 0x400>,
	      <0 0x415e0000 0 0x400>,
	      <0 0x60200000 0 0x400>,
	      <0 0x61000000 0 0x400>,
	      <0 0x61100000 0 0x3000>,
	      <0 0x62000000 0 0x4000>,
	      <0 0x62100000 0 0x4000>,
	      <0 0x63000000 0 0x400>,
	      <0 0x63100000 0 0x3000>,
	      <0 0x70b00000 0 0x3000>;
	clocks = <&ext_26m>, <&ext_rco_100m>, <&ext_32k>;
	clock-names = "ext-26m", "ext-rco-100m", "ext-32k";
};

[1] Documentation/devicetree/bindings/clock/clock-bindings.txt
```

## Documentation/devicetree/bindings/clock/sprd.txt
```
Spreadtrum Clock Binding
------------------------

Required properties:
- compatible: should contain the following compatible strings:
	- "sprd,sc9860-pmu-gate"
	- "sprd,sc9860-pll"
	- "sprd,sc9860-ap-clk"
	- "sprd,sc9860-aon-prediv"
	- "sprd,sc9860-apahb-gate"
	- "sprd,sc9860-aon-gate"
	- "sprd,sc9860-aonsecure-clk"
	- "sprd,sc9860-agcp-gate"
	- "sprd,sc9860-gpu-clk"
	- "sprd,sc9860-vsp-clk"
	- "sprd,sc9860-vsp-gate"
	- "sprd,sc9860-cam-clk"
	- "sprd,sc9860-cam-gate"
	- "sprd,sc9860-disp-clk"
	- "sprd,sc9860-disp-gate"
	- "sprd,sc9860-apapb-gate"

- #clock-cells: must be 1

- clocks : shall be the input parent clock(s) phandle for the clock.

Optional properties:

- reg:	Contain the registers base address and length. It must be configured only if no 'sprd,syscon' under the node.

- sprd,syscon: phandle to the syscon which is in the same address area with the clock.

Example:

	pmu_gate: pmu-gate {
		compatible = "sprd,sc9860-pmu-gate";
		sprd,syscon = <&pmu_apb>;
		clocks = <&ext_26m>;
		#clock-cells = <1>;
	};

	pll: pll {
		compatible = "sprd,sc9860-pll";
		sprd,syscon = <&ana_apb>;
		clocks = <&pmu_gate 0>;
		#clock-cells = <1>;
	};

	ap_clk: clock-controller@20000000 {
		compatible = "sprd,sc9860-ap-clk";
		reg = <0 0x20000000 0 0x400>;
		clocks = <&ext_26m>, <&pll 0>,
			 <&pmu_gate 0>;
		#clock-cells = <1>;
	};
```

## Documentation/devicetree/bindings/clock/sprd/sprd,adjustable-pll-clock.txt
```
Spreadtrum adjustable pll clock driver

Required properties:

- compatible : must be one of:
	"sprd,sc9836-adjustable-pll-clock"
	"sprd,sc9860-adjustable-pll-clock"

Example:
	clk_mpll0: clk@40400024 {
		compatible = "sprd,sc9860-adjustable-pll-clock";
		#clock-cells = <0>;
		reg = <0 0x40400024 0 0x4>,
		      <0 0x40400028 0 0x4>;
		clocks = <&clk_mpll_gates 2>;
		clock-output-names = "clk_mpll0";
	};
```

## Documentation/devicetree/bindings/clock/sprd/sprd,composite-clock.txt
```
Spreadtrum composite clock driver.

This binding uses the common clock binding[1].

[1] Documentation/devicetree/bindings/clock/clock-bindings.txt

Required properties:

- compatible:	should be "sprd,composite-clock"

- sprd,mux-msk:	arbitrary bitmask for selecting clock input

- sprd,div-msk:	arbitrary bitmask for programming the divider,
		denominator of divider is the value consisted
		of these bits plus 1

Example:

	clk_sensor: clk@60e00024 {
		compatible = "sprd,composite-clock";
		#clock-cells = <0>;
		reg = <0 0x60e00024 0 0x4>;
		clocks = <&ext_26m>, <&clk_twpll_48m_def>,
			 <&clk_twpll_76m8_def>, <&clk_twpll_96m_def>;
		clock-output-names = "clk_sensor";
		sprd,mux-msk = <0x3>;
		sprd,div-msk = <0x700>;
	};
```

## Documentation/devicetree/bindings/clock/sprd/sprd,divider-clock.txt
```
Spreadtrum divider clock driver which only supports simple indexed divider

This binding uses the common clock binding[1].

[1] Documentation/devicetree/bindings/clock/clock-bindings.txt

Required properties:

- compatible : should be "sprd,divider-clock"

- sprd,div-msk:	arbitrary bitmask for programming the divider,
		denominator of divider is the value consisted
		of these bits plus 1.

Example:

	clk_sdio0_1x: clk@402d032c {
		compatible = "sprd,divider-clock";
		#clock-cells = <0>;
		reg = <0 0x402d032c 0 0x4>;
		sprd,div-msk = <0x100>;
		clocks = <&clk_sdio0_2x>;
		clock-output-names = "clk_sdio0_1x";
	};
```
