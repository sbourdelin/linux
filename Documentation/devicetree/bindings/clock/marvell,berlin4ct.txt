## Documentation/devicetree/bindings/clock/sprd/sprd,gates-clock.txt
```
Spreadtrum gate clock driver

This binding uses the common clock binding[1].

[1] Documentation/devicetree/bindings/clock/clock-bindings.txt

Spreadtrum's SoCs often use one register to control more than one gate clocks.
Clock consumers can use index to get the correct gate clock.

In Spreadtrum platform, some of gate clocks have three registers, respectively
used for controlling, setting and clearing gate clock, the addresses of
these three registers generally are <start>, <start + offset>, and
<start + offset * 2>, and offset would be 0x1000 or 0x100, so the register
size of gate clocks is either 0x3000 or 0x300. While for some historical issue
there also are some clocks which don't have independent set/clear registers.
Please see bellow for more specific information.

Required properties:

- compatible:	should be one of the following:
		"sprd,sc1000-gates-clock"
		- offset of the registers for setting gate is 0x1000

		"sprd,sc100-gates-clock"
		- offset of the registers for setting gate is 0x100

		"sprd,gates-clock"
		- for clocks without independent set/clear registers

- reg:	the first cell represents the address of this clock gate controller
	register, the second cell implies how is the offset of set/clear
	registers of this clock gate, like addressed in the head of this
	file

optional properties:

- clock-indices:	If the identifying number for the clocks in the node
			is not linear from zero, this property is necessary

Example:

	clk_mpll_gates: clk@402b00b0 {
		compatible = "sprd,sc1000-gates-clock";
		#clock-cells = <1>;
		reg = <0 0x402b00b0 0 0x3000>;
		clocks = <&ext_26m>;
		clock-indices = <2>, <18>;
		clock-output-names = "clk_mpll0_gate", "clk_mpll1_gate";
	};

Below are two examples of how consumers use the gate clock.
The 'clk_mpll0' uses index 2 of 'clk_mpll_gates' and 'clk_mpll1'
uses index 18.

Examples:

	clk_mpll0: clk@40400024 {
		compatible = "sprd,sc9860-adjustable-pll-clock";
		#clock-cells = <0>;
		reg = <0 0x40400024 0 0x4>,
		      <0 0x40400028 0 0x4>;
		clocks = <&clk_mpll_gates 2>;
		clock-output-names = "clk_mpll0";
	};

	clk_mpll1: clk@4040002c {
		compatible = "sprd,sc9860-adjustable-pll-clock";
		#clock-cells = <0>;
		reg = <0 0x4040002c 0 0x4>,
		      <0 0x40400030 0 0x4>;
		clocks = <&clk_mpll_gates 18>;
		clock-output-names = "clk_mpll1";
	};
```

## Documentation/devicetree/bindings/clock/sprd/sprd,muxed-clock.txt
```
Spreadtrum multiplexed clock driver

This binding uses the common clock binding[1].

[1] Documentation/devicetree/bindings/clock/clock-bindings.txt

Required properties:

- compatible : should be "sprd,muxed-clock"

- sprd,mux-msk:	arbitrary bitmask for selecting clock input

Example:

	clk_adi: clk@402d0234 {
		compatible = "sprd,muxed-clock";
		#clock-cells = <0>;
		reg = <0 0x402d0234 0 0x4>;
		sprd,mux-msk = <0x7>;
		clocks = <&clk_rco_4m>, <&ext_26m>, <&clk_rco_25m>,
			 <&clk_twpll_38m4>, <&clk_twpll_51m2>;
		clock-output-names = "clk_adi";
	};
```

## Documentation/devicetree/bindings/clock/st,stm32h7-rcc.txt
```
STMicroelectronics STM32H7 Reset and Clock Controller
=====================================================

The RCC IP is both a reset and a clock controller.

Please refer to clock-bindings.txt for common clock controller binding usage.
Please also refer to reset.txt for common reset controller binding usage.

Required properties:
- compatible: Should be:
  "st,stm32h743-rcc"

- reg: should be register base and length as documented in the
  datasheet

- #reset-cells: 1, see below

- #clock-cells : from common clock binding; shall be set to 1

- clocks: External oscillator clock phandle
  - high speed external clock signal (HSE)
  - low speed external clock signal (LSE)
  - external I2S clock (I2S_CKIN)

- st,syscfg: phandle for pwrcfg, mandatory to disable/enable backup domain
  write protection (RTC clock).

Example:

	rcc: rcc@58024400 {
		#reset-cells = <1>;
		#clock-cells = <2>
		compatible = "st,stm32h743-rcc", "st,stm32-rcc";
		reg = <0x58024400 0x400>;
		clocks = <&clk_hse>, <&clk_lse>, <&clk_i2s_ckin>;

		st,syscfg = <&pwrcfg>;

		#address-cells = <1>;
		#size-cells = <0>;
	};

The peripheral clock consumer should specify the desired clock by
having the clock ID in its "clocks" phandle cell.

All available clocks are defined as preprocessor macros in
dt-bindings/clock/stm32h7-clks.h header and can be used in device
tree sources.

Example:

		timer5: timer@40000c00 {
			compatible = "st,stm32-timer";
			reg = <0x40000c00 0x400>;
			interrupts = <50>;
			clocks = <&rcc TIM5_CK>;

		};

Specifying softreset control of devices
=======================================

Device nodes should specify the reset channel required in their "resets"
property, containing a phandle to the reset device node and an index specifying
which channel to use.
The index is the bit number within the RCC registers bank, starting from RCC
base address.
It is calculated as: index = register_offset / 4 * 32 + bit_offset.
Where bit_offset is the bit offset within the register.

For example, for CRC reset:
  crc = AHB4RSTR_offset / 4 * 32 + CRCRST_bit_offset = 0x88 / 4 * 32 + 19 = 1107

All available preprocessor macros for reset are defined dt-bindings//mfd/stm32h7-rcc.h
header and can be used in device tree sources.

example:

	timer2 {
		resets	= <&rcc STM32H7_APB1L_RESET(TIM2)>;
	};
```

## Documentation/devicetree/bindings/clock/sunxi-ccu.txt
```
Allwinner Clock Control Unit Binding
------------------------------------

Required properties :
- compatible: must contain one of the following compatible:
		- "allwinner,sun8i-h3-ccu"

- reg: Must contain the registers base address and length
- clocks: phandle to the oscillators feeding the SPI controller. Two are
          needed:
  - "hosc": the high frequency oscillator (usually at 24MHz)
  - "losc": the low frequency oscillator (usually at 32kHz)
- clock-names: Must contain the clock names described just above
- #clock-cells : must contain 1
- #reset-cells : must contain 1

Example:
```

## Documentation/devicetree/bindings/clock/ti-clkctrl.txt
```
Texas Instruments clkctrl clock binding

Texas Instruments SoCs can have a clkctrl clock controller for each
interconnect target module. The clkctrl clock controller manages functional
and interface clocks for each module. Each clkctrl controller can also
gate one or more optional functional clocks for a module. The clkctrl
clock controller is typical for omap3 and later variants.

The clock consumers can specify the index of the clkctrl clock using
the hardware offset from the clkctrl instance register space. The optional
functional clocks can be specified by clkctrl hardware offset plus the
index of the optional clock. Please see the Linux clock framework binding
at Documentation/devicetree/bindings/clock/clock-bindings.txt.

Required properties :
- compatible : shall be "ti,clkctrl"
- #clock-cells : shall contain 1

Optional properties :
- "ti,modulemode-auto" : list of clkctrl offsets using automatic gating

Example: Clock controller node:

&cm_l4per {
	cm_l4per_clkctrl: clk@20 {
		compatible = "ti,clkctrl";
		reg = <0x20 0x1b0>;
		#clock-cells = 1;
		ti,modulemode-auto = <OMAP4_GPIO2_CLKCTRL>;
	};
};

Example: Preprocessor helper macros in dt-bindings/ti-clkctrl.h

#define OMAP4_CLKCTRL_OFFSET		0x20

#define OMAP_CLKCTRL_INDEX(offset)		\
	(((offset) - OMAP4_CLKCTRL_OFFSET) << 8)

#define OMAP_CLKCTRL_OPT_INDEX(offset, optclk)	\
	(OMAP_CLKCTRL_INDEX(offset) + (optclk))

#define OMAP4_GPTIMER10_CLKTRL		OMAP_CLKCTRL_INDEX(0x28)
#define OMAP4_GPTIMER11_CLKTRL		OMAP_CLKCTRL_INDEX(0x30)
#define OMAP4_GPTIMER2_CLKTRL		OMAP_CLKCTRL_INDEX(0x38)
...
#define OMAP4_GPIO2_CLKCTRL		OMAP_CLKCTRL_INDEX(0x60)
#define OMAP4_GPIO2_CLKCTRL_DBCLK	OMAP_CLKCTRL_OPT_INDEX(0x60, 1)
...

Example: Clock consumer node for GPIO2:

&gpio2 {
       clocks = <&cm_l4per_clkctrl OMAP4_GPIO2_CLKCTRL
		 &cm_l4per_clkctrl OMAP4_GPIO2_CLKCTRL_DBCLK>;
};
```

## Documentation/devicetree/bindings/clock/uniphier-clock.txt
```
UniPhier clock controller


System clock
------------

Required properties:
- compatible: should be one of the following:
    "socionext,uniphier-sld3-clock" - for PH1-sLD3 SoC.
    "socionext,uniphier-ld4-clock"  - for PH1-LD4 SoC.
    "socionext,uniphier-pro4-clock" - for PH1-Pro4 SoC.
    "socionext,uniphier-sld8-clock" - for PH1-sLD8 SoC.
    "socionext,uniphier-pro5-clock" - for PH1-Pro5 SoC.
    "socionext,uniphier-pxs2-clock" - for ProXstream2/PH1-LD6b SoC.
    "socionext,uniphier-ld11-clock" - for PH1-LD11 SoC.
    "socionext,uniphier-ld20-clock" - for PH1-LD20 SoC.
- #clock-cells: should be 1.

Note:
The clock node should be a child of a syscon node.

Example:

	sysctrl@61840000 {
		compatible = "simple-mfd", "syscon";
		reg = <0x61840000 0x4000>;

		clock {
			compatible = "socionext,uniphier-ld20-clock";
			#clock-cells = <1>;
		};

		other nodes ...
	};


Media I/O (MIO) clock
---------------------

Required properties:
- compatible: should be one of the following:
    "socionext,uniphier-sld3-mio-clock" - for PH1-sLD3 SoC.
    "socionext,uniphier-ld4-mio-clock"  - for PH1-LD4 SoC.
    "socionext,uniphier-pro4-mio-clock" - for PH1-Pro4 SoC.
    "socionext,uniphier-sld8-mio-clock" - for PH1-sLD8 SoC.
    "socionext,uniphier-pro5-mio-clock" - for PH1-Pro5 SoC.
    "socionext,uniphier-pxs2-mio-clock" - for ProXstream2/PH1-LD6b SoC.
    "socionext,uniphier-ld11-mio-clock" - for PH1-LD11 SoC.
    "socionext,uniphier-ld20-mio-clock" - for PH1-LD20 SoC.
- #clock-cells: should be 1.

Note:
The clock node should be a child of a syscon node.

Example:

	mioctrl@59810000 {
		compatible = "simple-mfd", "syscon";
		reg = <0x59810000 0x800>;

		clock {
			compatible = "socionext,uniphier-ld20-mio-clock";
			#clock-cells = <1>;
		};

		other nodes ...
	};

Provided clocks:

0: SD host ch0
1: eMMC host
2: SD host ch1
3: MIO DMAC
4: USB2 host ch0
5: USB2 host ch1
6: USB2 host ch2
7: USB2 host ch3


Peripheral clock
----------------

Required properties:
- compatible: should be one of the following:
    "socionext,uniphier-sld3-peri-clock" - for PH1-sLD3 SoC.
    "socionext,uniphier-ld4-peri-clock"  - for PH1-LD4 SoC.
    "socionext,uniphier-pro4-peri-clock" - for PH1-Pro4 SoC.
    "socionext,uniphier-sld8-peri-clock" - for PH1-sLD8 SoC.
    "socionext,uniphier-pro5-peri-clock" - for PH1-Pro5 SoC.
    "socionext,uniphier-pxs2-peri-clock" - for ProXstream2/PH1-LD6b SoC.
    "socionext,uniphier-ld11-peri-clock" - for PH1-LD11 SoC.
    "socionext,uniphier-ld20-peri-clock" - for PH1-LD20 SoC.
- #clock-cells: should be 1.

Note:
The clock node should be a child of a syscon node.

Example:

	perictrl@59820000 {
		compatible = "simple-mfd", "syscon";
		reg = <0x59820000 0x200>;

		clock {
			compatible = "socionext,uniphier-ld20-peri-clock";
			#clock-cells = <1>;
		};

		other nodes ...
	};

 0: UART ch0
 1: UART ch1
 2: UART ch2
 3: UART ch3
 4: I2C ch0
 5: I2C ch1
 6: I2C ch2
 7: I2C ch3
 8: I2C ch4
 9: I2C ch5
10: I2C ch6
```

## Documentation/devicetree/bindings/connector/usb-connector.txt
```
USB Connector
=============

USB connector node represents physical USB connector. It should be
a child of USB interface controller.

Required properties:
- compatible: describes type of the connector, must be one of:
    "usb-a-connector", "usb-b-connector", "usb-c-connector",

Optional properties:
- label: symbolic name for the connector
- type: size of the connector, should be specified in case of USB-A, USB-B
  non-standard (large) connector sizes: "mini", "micro"

Required nodes:
- any data bus to the connector should be modeled using the OF graph bindings
  specified in bindings/graph.txt, unless the bus is between parent node and
  the connector. Since single connector can have multpile data buses every bus
  has assigned OF graph port number as follows:
    0: High Speed (HS), present in all connectors,
    1: Super Speed (SS), present in SS capable connectors,
    2: Sideband use (SBU), present in USB-C,
    3: Mobile High-Definition Link (MHL), present in 11-pin Samsung micro-USB

Example
-------

muic_max77843@66 {
	...
	musb_con: connector {
		compatible = "usb-b-connector";
		label = "micro-USB";
		type = "micro";

		ports {
			#address-cells = <1>;
			#size-cells = <0>;

			port@3 {
				reg = <3>;
				musb_con_mhl_in: endpoint {
					remote-endpoint = <&mhl_out>;
				};
			};
		};
	};
};
```

## Documentation/devicetree/bindings/counter/stm32-timer-cnt.txt
```
STMicroelectronics STM32 Timer quadrature encoder

STM32 Timer provides quadrature encoder counter mode to detect
angular position and direction of rotary elements,
from IN1 and IN2 input signals.

Must be a sub-node of an STM32 Timer device tree node.
See ../mfd/stm32-timers.txt for details about the parent node.

Required properties:
- compatible:		Must be "st,stm32-timer-counter".
- pinctrl-names: 	Set to "default".
- pinctrl-0: 		List of phandles pointing to pin configuration nodes,
			to set IN1/IN2 pins in mode of operation for Low-Power
			Timer input on external pin.

Example:
	timers@40010000  {
		compatible = "st,stm32-timers";
		...
		counter {
			compatible = "st,stm32-timer-counter";
			pinctrl-names = "default";
			pinctrl-0 = <&tim1_in_pins>;
		};
	};
```
