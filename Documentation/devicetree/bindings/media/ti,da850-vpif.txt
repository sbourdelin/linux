## Documentation/devicetree/bindings/mfd/hisilicon,hisi-fmc.txt
```
HiSilicon Flash Memory Controller

The HiSilicon Flash Memory Controller(FMC) is a feature-rich controller
that supports SPI Nor, SPI Nand and Parallel Nand devices. This document
describes the binding for HiSilicon FMC device and its sub-notes.

Required properties:
- compatible : Should be "hisilicon,hisi-fmc".
- reg : Offset and length of the register set for the controller device.
- reg-names : Must include the following two entries: "control", "memory".
- address-cells : Should be 1.
- size-cells : Should be 0.
- clocks : A phandle to the HiSilicon FMC controller clock.

Optional sub-nodes:
	- spi-nor:
	Required properties:
		- compatible : "hisilicon,fmc-spi-nor"
	see "Documentation/devicetree/bindings/mtd/hisilicon,fmc-spi-nor.txt

	- spi-nand:
	Required properties:
		- compatible : "hisilicon,fmc-spi-nand"
		- reg : The chipselect for spi-nand devices
		- address-cells : Should be 1.
		- size-cells : Should be 0.

	- nand:
	Required properties:
		- compatible : "hisilicon,fmc-nand"
		- reg : The chipselect for nand devices
		- address-cells : Should be 1.
		- size-cells : Should be 0.

Example:
fmc: flash-memory-controller@10000000 {
		 compatible = "hisilicon,hisi-fmc";
		 reg = <0x10000000 0x1000>, <0x14000000 0x1000000>;
		 reg-names = "control", "memory";
		 clocks = <&crg FMC_CLK>;

		 hisfc:spi-nor {
				   compatible = "hisilicon,fmc-spi-nor";
				   #address-cells = <1>;
				   #size-cells = <0>;
				   hi_sfc@0 {
					   compatible = "jedec,spi-nor";
					   reg = <0>;
				   };
				/*
				 * Here you can add the spi nor flash devices.
				 * They share the same spi nor controller, but
				 * have different chipselect.
				 */
		};

		/*
		 * Here you can add spi nand and nand sub-nodes. It depends
		 * on the board-grade design.
		 */

};
```

## Documentation/devicetree/bindings/mfd/jnx-ptxpmb-cpld.txt
```
* Device tree bindings for Juniper's PTXPMB CPLD FPGA MFD driver

The device supports a number I2C muxes, hardware watchdog and a gpio block.
Those devices bindings are described in the jnx-i2c-mux-ptxpmb-cpld,
jnx-ptxpmb-wdt and jnx-gpio-ptxpmb-cpld documents.

Required properties:

- compatible:		"jnx,ptxpmb-cpld", "jnx,ngpmb-bcpld". They differ
			in the i2c-mux blocks.

- reg:			contains offset/length value for device state control
			registers space.

Optional properties:

- interrupts:		The interrupt line(s) the /IRQ signal(s) for the device is
			connected to.

- interrupt-parent:	The parent interrupt controller.

Example:

cpld@0,0 {
	compatible = "jnx,ptxpmb-cpld";
	reg = <0x0 0 0x10000>;

	cpld-i2c-mux {
		compatible = "jnx,i2c-mux-ptxpmb-cpld";
		#address-cells = <1>;
		#size-cells = <0>;

		i2c-parent = <&i2c_master_0>;

		num-enable = <1>;

		i2c@0 {
			reg = <0>;
			#address-cells = <1>;
			#size-cells = <0>;

			/* PMB devices are accessed through FPC */

			temp-sensor@1a { /* FPC */
				compatible = "maxim,max6697";
				reg = <0x1a>;
				smbus-timeout-disable;
				resistance-cancellation;
				alert-mask = <0xff>;
				over-temperature-mask = <0xff>;
			};
		};

		pic0i2c: i2c@1 {
			reg = <1>;
			#address-cells = <1>;
			#size-cells = <0>;

			/* PIC 0 */
		};

		pic1i2c: i2c@2 {
			reg = <2>;
			#address-cells = <1>;
			#size-cells = <0>;

			/* PIC 1 */
		};
	};

	gpio_cpld: cpld_gpio {
		compatible = "jnx,gpio-ptxpmb-cpld";
		#gpio-cells = <2>;
		gpio-controller;
	};
};
```

## Documentation/devicetree/bindings/mfd/lp873x.txt
```
TI LP3943 MFD driver

Required properties:
  - compatible: "ti,lp8732", "ti,lp8733"
  - reg: I2C slave address.

For the lp873x regulator properties please refer to:
Documentation/devicetree/bindings/regulator/lp873x.txt

Example:

lp8733: lp8733@60 {
	compatible = "ti,lp8733";
	reg = <0x60>;

	regulators {
		lp8733_buck0: buck0 {
			regulator-name = "lp8733-buck0";
			regulator-min-microvolt = <800000>;
			regulator-max-microvolt = <1400000>;
			regulator-min-microamp = <1500000>;
			regulator-max-microamp = <4000000>;
			regulator-ramp-delay = <10000>;
			regulator-always-on;
			regulator-boot-on;
		};

		lp8733_buck1: buck1 {
			regulator-name = "lp8733-buck1";
			regulator-min-microvolt = <800000>;
			regulator-max-microvolt = <1400000>;
			regulator-min-microamp = <1500000>;
			regulator-max-microamp = <4000000>;
			regulator-ramp-delay = <10000>;
			regulator-boot-on;
			regulator-always-on;
		};

		lp8733_ldo0: ldo0 {
			regulator-name = "lp8733-ldo0";
			regulator-min-microvolt = <800000>;
			regulator-max-microvolt = <3000000>;
			regulator-boot-on;
			regulator-always-on;
		};

		lp8733_ldo1: ldo1 {
			regulator-name = "lp8733-ldo1";
			regulator-min-microvolt = <800000>;
			regulator-max-microvolt = <3000000>;
			regulator-always-on;
			regulator-boot-on;
		};
	};
};
```

## Documentation/devicetree/bindings/mfd/madera.txt
```
Cirrus Logic Madera class audio codecs multi-function device

These devices are audio SoCs with extensive digital capabilities and a range
of analogue I/O.

See also the child driver bindings in:
bindings/extcon/extcon-madera.txt
bindings/gpio/gpio-madera.txt
bindings/interrupt-controller/cirrus,madera.txt
bindings/pinctrl/cirrus,madera-pinctrl.txt
bindings/regulator/madera-ldo1.txt
bindings/regulator/madera-micsupp.txt
bindings/sound/madera.txt

Required properties:

  - compatible : One of the following chip-specific strings:
        "cirrus,cs47l35"
        "cirrus,cs47l85"
        "cirrus,cs47l90"
        "cirrus,cs47l91"
        "cirrus,wm1840"

  - reg : I2C slave address when connected using I2C, chip select number when
    using SPI.

  - DCVDD-supply : Power supply for the device as defined in
    bindings/regulator/regulator.txt
    Mandatory on CS47L35, CS47L90, CS47L91
    Optional on CS47L85, WM1840

  - AVDD-supply, DBVDD1-supply, DBVDD2-supply, CPVDD1-supply, CPVDD2-supply :
    Power supplies for the device

  - DBVDD3-supply, DBVDD4-supply : Power supplies for the device
    (CS47L85, CS47L90, CS47L91, WM1840)

  - SPKVDDL-supply, SPKVDDR-supply : Power supplies for the device
    (CS47L85, WM1840)

  - SPKVDD-supply : Power supply for the device
    (CS47L35)

Optional properties:

  - MICVDD-supply : Power supply, only need to be specified if
    powered externally

  - reset-gpios : One entry specifying the GPIO controlling /RESET.
    As defined in bindings/gpio.txt.
    Although optional, it is strongly recommended to use a hardware reset

  - MICBIASx : Initial data for the MICBIAS regulators, as covered in
    Documentation/devicetree/bindings/regulator/regulator.txt.
    One for each MICBIAS generator (MICBIAS1, MICBIAS2, ...)
    (all codecs)

    One for each output pin (MICBIAS1A, MIBCIAS1B, MICBIAS2A, ...)
    (all except CS47L85, WM1840)

    The following following additional property is supported for the generator
    nodes:
      - cirrus,ext-cap : Set to 1 if the MICBIAS has external decoupling
        capacitors attached.

Example:

codec: cs47l85@0 {
	compatible = "cirrus,cs47l85";
	reg = <0>;

	reset-gpios = <&gpio 0>;

	MICBIAS1 {
		regulator-min-microvolt = <900000>;
		regulator-max-microvolt = <3300000>;
		cirrus,ext-cap = <1>;
	};
};
```

## Documentation/devicetree/bindings/mfd/max7360.txt
```
* Maxim MAX7360 Multi-function Device

The Maxim MAX7360 is a Multi-function Device which includes
64 key switches, 8 LED drivers/GPIOs, PWM intensity control,
and rotary switch control.

Required properties:
- compatible:	Should be the following: "maxim,max7360".
- reg:		Specifies the I2C slave address of the max7360 block.
		  It can be 0x38, 0x3a, 0x3c or 0x3e IIUC.

Optional properties:
- interrupt-parent:	Specifies the phandle of the interrupt controller to
			  which the interrupts from MAX7360 are routed to.
- interrupts:		List of IRQ lines specifiers.
- interrupt-names:	List of "inti" and "intk".
- interrupt-controller:	Identifies the device as an interrupt controller.
- #interrupt-cells :	Number of cells to encode an interrupt source,
			  shall be 1.

Examples:

Without subnodes:
	max7360@38 {
		compatible = "maxim,max7360";
		reg = <0x38>;
		interrupt-parent = <&gpio1>;
		interrupts = <23 IRQ_TYPE_LEVEL_LOW>, <23 IRQ_TYPE_LEVEL_LOW>;
		interrupt-names = "inti", "intk";
		interrupt-controller;
		#interrupt-cells = <0x1>;
	};

With subnodes:
	max7360@38 {
		compatible = "maxim,max7360";
		reg = <0x38>;
		interrupt-parent = <&gpio1>;
		interrupts = <23 IRQ_TYPE_LEVEL_LOW>, <23 IRQ_TYPE_LEVEL_LOW>;
		interrupt-names = "inti", "intk";
		interrupt-controller;
		#interrupt-cells = <0x1>;

		gpio {
			compatible = "maxim,max7360-gpio";
			gpio-controller;
			#gpio-cells = <0x2>;
			interrupt-controller;
			#interrupt-cells = <0x2>;
			interrupts = <0>;
		};

		keypad {
			compatible = "maxim,max7360-keypad";
			maxim,debounce_reg = /bits/ 8 <0xef>;
			maxim,ports_reg = /bits/ 8 <0xae>;
			linux,keymap = < MATRIX_KEY(0, 0, KEY_F5)
					 MATRIX_KEY(1, 0, KEY_F4) >;
			keypad,num-rows = <2>;
			keypad,num-columns = <1>;
			interrupts = <1>;
		};

		pwm {
			compatible = "maxim,max7360-pwm";
			#pwm-cells = <0x2>;
		};

		rotary-encoder {
			compatible = "maxim,max7360-rotary";
			interrupts = <2>;
		};

	};
```

## Documentation/devicetree/bindings/mfd/max77620.txt
```
MAX77620 Power management IC from Maxim Semiconductor.

Required properties:
-------------------
- compatible: Must be one of
		"maxim,max77620"
		"maxim,max20024".
- reg: I2C device address.

Optional properties:
-------------------
- interrupts:		the interrupt on the parent the controller is
			connected to
- interrupt-controller: Marks the device node as an interrupt controller.
- #interrupt-cells:	is <2> and their usage is compliant to the 2 cells
			variant of <../interrupt-controller/interrupts.txt>
			IRQ numbers for different interrupt source of MAX77620
			are defined at dt-bindings/mfd/max77620.h.

Optional subnodes and their properties:
=======================================

Flexible power sequence configurations:
--------------------------------------
The PMIC has multiple control mode:
	Normal mode also called as active mode on which all step-down
		regulators, all linear regulators, GPIOs, and the 32kHz
		oscillator are in normal active mode.
	sleep mode: Regulators/GPIOs/clock can go on OFF state based on
		their configurations.
	Global Low power mode (GLPM): In this mode, step-down regulators, linear
		regulators, and the 32kHz oscillator are in low-power modes.

	Different modes of regulators/clock/GPIOs are controlled by the their
FPS configurations. There is different configuration registers for each of
these resources. Typical configurations per resource are:
	FPS source: 	Attach the resource to required FPS source. When
			resources are attached to one of FPS source then
			resournce can be enable/disable when related FPS
			source gets the control signal for ON and OFF.
	Power on slot: 	Slot number on which resource is ON once FPS source
			get ON signal.
	Power down slot Slot number on which resource is OFF once FPS source
			get OFF signal.

There is three FPS source for resources called FPS0, FPS1 and FPS2. All
resources need to attached to one of these FPS. It can alsoi be set
FPS source to NONE, and on this case, it is completely controlled by
the register control rather than external input control to PMIC.

The configuration parameters of FPS is provided through subnode "fps"
and their child for FPS specific.
The node name for FPS child are defined as "fps0", "fps1", and "fps2" for
the FPS0, FPS1 and FPS2 respectively.

There is need for different FPS configuration parameters based on system
state like when system state changed from active to suspend or active to
power off (shutdown).

Optinal properties:
-------------------
-maxim,fps-control:	u32, FPS control source like external control input
			to PMIC i.e. EN0, EN1 or software (SW). The macros
			are defined on dt-bindings/mfd/max77620.h for
			different control source.
				FPS_CONTROL_SRC_EN0 for PMIC external input EN0.
				FPS_CONTROL_SRC_EN1 for PMIC external input EN1.
				FPS_CONTROL_SRC_SW for software control.

-maxim,shutdown-fps-time-period-us: u32, FPS time period in microseconds
				    when system enters to shutdown state.
-maxim,suspend-fps-time-period-us:  u32, FPS time period in microseconds
				    when system enters to suspend state.

-maxim,enable-sleep: 		    Boolean, enable sleep state of PMIC
				    when the FPS control input become active.
-maxim,enable-global-lpm: 	    Boolean, enable Global Low Power Mode (GLPM)
				    of PMIC when the FPS control input become
				    active.

Here supported time periods by device in microseconds are as follows:
MAX77620 supports 40, 80, 160, 320, 640, 1280, 2560 and 5120 microseconds.
MAX20024 supports 20, 40, 80, 160, 320, 640, 1280 and 2540 microseconds.

For different sub modules like GPIO, pincontrol, regulator, power, please refer
respected device-tree binding document on respective directories.

Example:
--------
#include <dt-bindings/mfd/max77620.h>

max77620@3c {
	compatible = "maxim,max77620";
	reg = <0x3c>;

	interrupt-parent = <&intc>;
	interrupts = <0 86 IRQ_TYPE_NONE>;

	interrupt-controller;
	#interrupt-cells = <2>;

	fps {
		fps0 {
			maxim,shutdown-fps-time-period-us = <1280>;
			maxim,fps-control = <FPS_CONTROL_SRC_EN1>;
		};

		fps1 {
			maxim,shutdown-fps-time-period-us = <1280>;
			maxim,fps-control = <FPS_CONTROL_SRC_EN0>;
		};

		fps2 {
			maxim,shutdown-fps-time-period-us = <1280>;
			maxim,fps-control = <FPS_CONTROL_SRC_SW>;
		};
	};
};
```

## Documentation/devicetree/bindings/mfd/max77650.txt
```
MAX77650 ultra low-power PMIC from Maxim Integrated.

Required properties:
-------------------
- compatible:		Must be "maxim,max77650"
- reg:			I2C device address.
- interrupts:		The interrupt on the parent the controller is
			connected to.
- interrupt-parent:	phandle of the parent interrupt controller.
- interrupt-controller: Marks the device node as an interrupt controller.
- #interrupt-cells:	Must be <2>.

For device-tree bindings of sub-modules (regulator, power supply, GPIO, LEDs
and onkey) refer to the binding documents under the respective sub-system
directories.

Example:
--------

	pmic: max77650@48 {
		compatible = "maxim,max77650";
		reg = <0x48>;

		interrupt-controller;
		interrupt-parent = <&gpio2>;
		#interrupt-cells = <2>;
		interrupts = <3 IRQ_TYPE_LEVEL_LOW>;
	};
```

## Documentation/devicetree/bindings/mfd/retu.txt
```
* Device tree bindings for Nokia Retu and Tahvo multi-function device

Retu and Tahvo are a multi-function devices found on Nokia Internet
Tablets (770, N800 and N810).

Required properties:
- compatible:		"nokia,retu-mfd" or "nokia,tahvo-mfd"
- reg:			Specifies the I2C slave address of the ASIC chip

Example:

i2c0 {
	retu_mfd: retu@1 {
		compatible = "nokia,retu-mfd";
		interrupt-parent = <&gpio4>;
		interrupts = <12 IRQ_TYPE_EDGE_RISING>;
		reg = <0x1>;
	};
};
```
