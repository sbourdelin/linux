## Documentation/devicetree/bindings/media/ti,da850-vpif.txt
```
Texas Instruments VPIF
----------------------

The Video Port InterFace (VPIF) is the core component for video output
and capture on DA850 TI Davinci SoCs.

- compatible: must be "ti,da850-vpif"
- reg: physical base address and length of the registers set for the device;
```

## Documentation/devicetree/bindings/media/ti,ds90ub954-q1.txt
```
Texas Instruments DS90UB954-Q1 dual video Deserializer
======================================================

Required properties:

 - compatible: must be "ti,ds90ub954-q1"
 - reg: I2C bus address of the chip (0x30..0xdd, based on strapping options)
 - reset-gpios: chip reset GPIO, active low (connected to PDB pin of the chip)
 - i2c-alias-pool: list of I2C addresses that are known to be available on the
                   "local" (SoC-to-deser) I2C bus; they will be picked at
		   runtime and used as aliases to reach remove I2C chips


Required subnodes:
 - ports: A ports node with one port child node per device input and output
          port, in accordance with the video interface bindings defined in
          Documentation/devicetree/bindings/media/video-interfaces.txt. The
          port nodes are numbered as follows:

          Port Description
          -----------------------------
          0    Input from FPD-Link 3 RX port 0
          1    Input from FPD-Link 3 RX port 1
          2    CSI-2 output
 - gpios: *** this is a temporary test implementation, ignore it
 - i2c-mux: contains one child per RX port, each generates an I2C adapter
            representing the I2C bus on the remote side
 - rxports: contains one child per RX port, each describes one FPD-Link 3 port
            with these fields:
	    - reg: the RX port index
	    - ser-i2c-alias: the alias to access the remore serializer from
	      the local bus
	    - bc-gpio-map: maps backchannel GPIO numbers to local GPIO inputs
	                   with pairs <fpd_gpio_number gpio_node>
			   (TODO change when reimplementing the gpios subnode)


Device node example
-------------------

&i2c0 {
	deser@3d {
		reg = <0x3d>;
		compatible = "ti,ds90ub954-q1";
		reset-gpios = <&gpio1 2 0>;

		i2c-alias-pool = /bits/ 16 <0x20 0x21 0x22 0x23 0x24 0x25>;

		ports {
			#address-cells = <1>;
			#size-cells = <0>;

			port@0 {
				reg = <0>;
				ds90ub954_fpd3_in0: endpoint {
					remote-endpoint = <&remote_sensor_0_out>;
				};
			};

			// TODO enable both ports (and s/1/2/g in th MIPI port below)
			// port@1 {
			// 	reg = <1>;
			// 	ds90ub954_fpd3_in1: endpoint {
			// 		remote-endpoint = <&remote_sensor_1_out>;
			// 	};
			// };

			port@1 {
				reg = <1>;
				ds90ub954_mipi_out0: endpoint {
					data-lanes = <1 2 3 4>;
					remote-endpoint = <&csirx_0_in>;
				};
			};
		};

		gpios {
			#address-cells = <1>;
			#size-cells = <0>;

			// From sensor to CPU
			gpio@0 {
				reg = <0>;
				output;
				source = <0>; // RX port 0
				function = <0>;
			};

			// CPU to sensor reset, active low
			remote_sensor1_reset: gpio@1 {
				reg = <1>;
				input;
			};
		};

		i2c-mux {
			#address-cells = <1>;
			#size-cells = <0>;

			remote_i2c0: i2c@0 {
				reg = <0>;
				#address-cells = <1>;
				#size-cells = <0>;
				clock-frequency = <400000>;
			};

			remote_i2c1: i2c@1 {
				reg = <1>;
				#address-cells = <1>;
				#size-cells = <0>;
				clock-frequency = <400000>;
			};
		};

		rxports {
			#address-cells = <1>;
			#size-cells = <0>;

			rxport@0 {
				reg = <0>;
				ser-i2c-alias = <0x3e>;

				/* Map BC GPIO numbers to local GPIO inputs */
				bc-gpio-map = <1 &remote_sensor1_reset>;
			};

			rxport@1 {
				reg = <1>;
				ser-i2c-alias = <0x3f>;
			};
		};
	};
};

&remote_i2c0 {
	remote_sensor0@1a {
		reg = <0x1a>;
		compatible = "sony,imx274";

		#address-cells = <1>;
		#size-cells = <0>;
		reset-gpios = <&gpio1 4 0>;

		port@0 {
			reg = <0>;
			remote_sensor_0_out: endpoint {
				remote-endpoint = <&ds90ub954_fpd3_in0>;
			};
		};
	};
};
```

## Documentation/devicetree/bindings/media/ti,vpif.txt
```
Texas Instruments VPIF
----------------------

The Video Port InterFace (VPIF) is the core component for video output
and capture on TI Davinci family SoCs.

- compatible: must be "ti,vpif"
- reg: physical base address and length of the registers set for the device;
```

## Documentation/devicetree/bindings/media/video-multiplexer.txt
```
Video Multiplexer
=================

Video multiplexers allow to select between multiple input ports. Video received
on the active input port is passed through to the output port. Muxes described
by this binding may be controlled by a syscon register bitfield or by a GPIO.

Required properties:
- compatible : should be "video-multiplexer"
- reg: should be register base of the register containing the control bitfield
- bit-mask: bitmask of the control bitfield in the control register
- bit-shift: bit offset of the control bitfield in the control register
- gpios: alternatively to reg, bit-mask, and bit-shift, a single GPIO phandle
  may be given to switch between two inputs
- #address-cells: should be <1>
- #size-cells: should be <0>
- port@*: at least three port nodes containing endpoints connecting to the
  source and sink devices according to of_graph bindings. The last port is
  the output port, all others are inputs.

Example:

syscon {
	compatible = "syscon", "simple-mfd";

	mux {
		compatible = "video-multiplexer";
		/* Single bit (1 << 19) in syscon register 0x04: */
		reg = <0x04>;
		bit-mask = <1>;
		bit-shift = <19>;
		#address-cells = <1>;
		#size-cells = <0>;

		port@0 {
			reg = <0>;

			mux_in0: endpoint {
				remote-endpoint = <&video_source0_out>;
			};
		};

		port@1 {
			reg = <1>;

			mux_in1: endpoint {
				remote-endpoint = <&video_source1_out>;
			};
		};

		port@2 {
			reg = <2>;

			mux_out: endpoint {
				remote-endpoint = <&capture_interface_in>;
			};
		};
	};
};
```

## Documentation/devicetree/bindings/media/xilinx/xlnx,csi2rxss.txt
```
Xilinx MIPI CSI2 Receiver Subsystem Device Tree Bindings
--------------------------------------------------------

The Xilinx MIPI CSI2 Receiver Subsystem is used to capture MIPI CSI2 traffic
from compliant camera sensors and send the output as AXI4 Stream video data
for image processing.

The subsystem consists of a MIPI DPHY in slave mode which captures the
data packets. This is passed along the MIPI CSI2 Rx IP which extracts the
packet data. The Video Format Bridge (VFB) converts this data to AXI4 Stream
video data.

For more details, please refer to PG232 Xilinx MIPI CSI-2 Receiver Subsystem.

Required properties:
--------------------
- compatible: Must contain "xlnx,mipi-csi2-rx-subsystem-4.0".
- reg: Physical base address and length of the registers set for the device.
- interrupts: Property with a value describing the interrupt number.
- clocks: List of phandles to AXI Lite, Video and 200 MHz DPHY clocks.
- clock-names: Must contain "lite_aclk" and "video_aclk" in the same order
  as clocks listed in clocks property.
- xlnx,csi-pxl-format: This denotes the CSI Data type selected in hw design.
  Packets other than this data type (except for RAW8 and User defined data
  types) will be filtered out. Possible values are as below -
  0x1E - YUV4228B
  0x1F - YUV42210B
  0x20 - RGB444
  0x21 - RGB555
  0x22 - RGB565
  0x23 - RGB666
  0x24 - RGB888
  0x28 - RAW6
  0x29 - RAW7
  0x2A - RAW8
  0x2B - RAW10
  0x2C - RAW12
  0x2D - RAW14
  0x2E - RAW16
  0x2F - RAW20


Optional properties:
--------------------
- xlnx,vfb: This is present when Video Format Bridge is enabled.
  Without this property the driver won't be loaded as IP won't be able to generate
  media bus format compliant stream output.
- xlnx,en-csi-v2-0: Present if CSI v2 is enabled in IP configuration.
- xlnx,en-vcx: When present, there are maximum 16 virtual channels, else
  only 4. This is present only if xlnx,en-csi-v2-0 is present.
- xlnx,en-active-lanes: Enable Active lanes configuration in Protocol
  Configuration Register.

Ports
-----
The device node shall contain two 'port' child nodes as defined in
Documentation/devicetree/bindings/media/video-interfaces.txt.

The port@0 is sink port and shall connect to CSI2 source like camera.
It must have the data-lanes property. It may have the xlnx,cfa-pattern
property to indicate bayer pattern of source.

The port@1 is source port could be connected to any video processing IP
which can work with AXI4 Stream data.

Required port properties:
--------------------
- reg: 0 - for sink port.
       1 - for source port.

Optional port properties:
--------------------
- xlnx,cfa-pattern: This goes in the sink port to indicate bayer pattern.
  Valid values are "bggr", "rggb", "gbrg" and "grbg".

Optional endpoint property:
---------------------------
- data-lanes: specifies MIPI CSI-2 data lanes as covered in video-interfaces.txt.
  This should be in the sink port endpoint which connects to MIPI CSI2 source
  like sensor. The possible values are:
  1       - For 1 lane enabled in IP.
  1 2     - For 2 lanes enabled in IP.
  1 2 3   - For 3 lanes enabled in IP.
  1 2 3 4 - For 4 lanes enabled in IP.

Example:

	csiss_1: csiss@a0020000 {
		compatible = "xlnx,mipi-csi2-rx-subsystem-4.0";
		reg = <0x0 0xa0020000 0x0 0x10000>;
		interrupt-parent = <&gic>;
		interrupts = <0 95 4>;
		xlnx,csi-pxl-format = <0x2a>;
		xlnx,vfb;
		xlnx,en-active-lanes;
		xlnx,en-csi-v2-0;
		xlnx,en-vcx;
		clock-names = "lite_aclk", "video_aclk";
		clocks = <&misc_clk_0>, <&misc_clk_1>, <&misc_clk_2>;

		ports {
			#address-cells = <1>;
			#size-cells = <0>;

			port@0 {
				/* Sink port */
				reg = <0>;
				xlnx,cfa-pattern = "bggr"
				csiss_in: endpoint {
					data-lanes = <1 2 3 4>;
					/* MIPI CSI2 Camera handle */
					remote-endpoint = <&camera_out>;
				};
			};
			port@1 {
				/* Source port */
				reg = <1>;
				csiss_out: endpoint {
					remote-endpoint = <&vproc_in>;
				};
			};
		};
	};
```

## Documentation/devicetree/bindings/memory-controllers/brcm,bcm2835-sdram.txt
```
Binding for SDRAM driver for BCM2835 SoCs.

Required parameters:
-------------------

compatible : 	should be: "brcm,bcm2835-sdram"
reg :		Address ranges of the ic1/ic2 registers.
clocks : 	Phandle of the clock used by the sdram.

Example:

memory-conroller@7e002000 {
	compatible = "brcm,bcm2835-sdram";
	reg = <0x7e002000 0x58>, <0x7e002800 0x58>;
	clocks = <&clocks BCM2835_CLOCK_SDRAM>;
};
```

## Documentation/devicetree/bindings/mfd/ac100.txt
```
X-Powers AC100 Codec/RTC IC device tree bindings

AC100 is a audio codec and RTC subsystem combo IC. The 2 parts are
separated, including power supplies and interrupt lines, but share
a common register address space and host interface.

Required properties:
- compatible: "x-powers,ac100"
- reg: The I2C slave address or RSB hardware address for the chip
- sub-nodes:
  - codec
    - compatible: "x-powers,ac100-codec"
    - interrupt-parent: The parent interrupt controller
    - interrupts: SoC NMI / GPIO interrupt connected to the IRQ_AUDIO pin
  - rtc
    - compatible: "x-powers,ac100-rtc"
    - interrupt-parent: The parent interrupt controller
    - interrupts: SoC NMI / GPIO interrupt connected to the IRQ_RTC pin
    - #clock-cells: shall be 1
    - clock-output-names: "cko1_rtc", "cko2_rtc", "cko3_rtc"
    - see clock/clock-bindings.txt for common clock bindings

Example:

ac100: codec@e89 {
	compatible = "x-powers,ac100";
	reg = <0xe89>;

	ac100_codec {
		compatible = "x-powers,ac100-codec";
		interrupt-parent = <&nmi_intc>;
		interrupts = <0 IRQ_TYPE_LEVEL_LOW>;
	};

	ac100_rtc {
		compatible = "x-powers,ac100-rtc";
		interrupt-parent = <&nmi_intc>;
		interrupts = <0 IRQ_TYPE_LEVEL_LOW>;
		#clock-cells = <1>;
		clock-output-names = "cko1_rtc", "cko2_rtc", "cko3_rtc";
	};
};
```

## Documentation/devicetree/bindings/mfd/act8945a.txt
```
Device-Tree bindings for Active-semi ACT8945A MFD driver

Required properties:
 - compatible: "active-semi,act8945a".
 - reg: the I2C slave address for the ACT8945A chip

The chip exposes two subdevices:
 - a regulators: see ../regulator/act8945a-regulator.txt
 - a charger: see ../power/act8945a-charger.txt

Example:
	act8945a@5b {
		compatible = "active-semi,act8945a";
		reg = <0x5b>;
		status = "okay";

		pmic {
			compatible = "active-semi,act8945a-regulator";
			active-semi,vsel-high;

				regulators {
					vdd_1v35_reg: DCDC_REG1 {
						regulator-name = "VDD_1V35";
						regulator-min-microvolt = <1350000>;
						regulator-max-microvolt = <1350000>;
						regulator-always-on;
					};

					vdd_1v2_reg: DCDC_REG2 {
						regulator-name = "VDD_1V2";
						regulator-min-microvolt = <1100000>;
						regulator-max-microvolt = <1300000>;
						regulator-always-on;
					};

					vdd_3v3_reg: DCDC_REG3 {
						regulator-name = "VDD_3V3";
						regulator-min-microvolt = <3300000>;
						regulator-max-microvolt = <3300000>;
						regulator-always-on;
					};

					vdd_fuse_reg: LDO_REG1 {
						regulator-name = "VDD_FUSE";
						regulator-min-microvolt = <2500000>;
						regulator-max-microvolt = <2500000>;
						regulator-always-on;
					};

					vdd_3v3_lp_reg: LDO_REG2 {
						regulator-name = "VDD_3V3_LP";
						regulator-min-microvolt = <3300000>;
						regulator-max-microvolt = <3300000>;
						regulator-always-on;
					};

					vdd_led_reg: LDO_REG3 {
						regulator-name = "VDD_LED";
						regulator-min-microvolt = <3300000>;
						regulator-max-microvolt = <3300000>;
						regulator-always-on;
					};

					vdd_sdhc_1v8_reg: LDO_REG4 {
						regulator-name = "VDD_SDHC_1V8";
						regulator-min-microvolt = <1800000>;
						regulator-max-microvolt = <1800000>;
						regulator-always-on;
					};
				};
			};

		charger {
			compatible = "active-semi,act8945a-charger";
			pinctrl-names = "default";
			pinctrl-0 = <&pinctrl_charger_chglev>;
			active-semi,chglev-gpio = <&pioA 12 GPIO_ACTIVE_HIGH>;
			active-semi,input_voltage_threshold = <6600>;
			active-semi,precondition_timeout = <40>;
			active-semi,total_timeout = <3>;
		};
	};
```

## Documentation/devicetree/bindings/mfd/aspeed-lpc.txt
```
* Device tree bindings for the Aspeed LPC Controller

The Aspeed LPC controller contains registers for a variety of functions. Not
all registers for a function are contiguous, and some registers are referenced
by functions outside the LPC controller.

Note that this is separate from the H8S/2168 compatible register set occupying
the start of the LPC controller address space.

Some significant functions in the LPC controller:

* LPC Host Controller
* Host Interface Controller
* iBT Controller
* SuperIO Scratch registers

Required properties:
- compatible:		"aspeed,ast2500-lpc", "syscon"
- reg:			contains offset/length value of the Aspeed-specific LPC
			memory region.

Example:

lpc: lpc@1e7890a0 {
	compatible = "aspeed,ast2500-lpc", "syscon";
	reg = <0x1e789080 0x1e0>;
};
```
