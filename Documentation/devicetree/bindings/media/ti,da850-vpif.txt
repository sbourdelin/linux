## Documentation/devicetree/bindings/mfd/atmel-lcdc.txt
```
Device-Tree bindings for Atmel's LCDC (LCD Controller) MFD driver

Required properties:
 - compatible: value should be one of the following:
   "atmel,at91sam9261-lcdc-mfd"
   "atmel,at91sam9263-lcdc-mfd"
   "atmel,at91sam9g10-lcdc-mfd"
   "atmel,at91sam9g45-lcdc-mfd"
   "atmel,at91sam9g46-lcdc-mfd"
   "atmel,at91sam9m10-lcdc-mfd"
   "atmel,at91sam9m11-lcdc-mfd"
   "atmel,at91sam9rl-lcdc-mfd"
 - reg: base address and size of the LCDC device registers.
 - clock-names: the name of the 2 clocks requested by the LCDC device.
   Should contain "lcdc_clk", and "hclk".
 - clocks: should contain the 2 clocks requested by the LCDC device.
	   May specify the same clock twice is there is no need to enable
	   "hclk" to use the display.
 - interrupts: should contain the description of the LCDC interrupt line

The LCDC IP exposes two subdevices:
 - a PWM chip: see ../pwm/atmel-lcdc-pwm.txt
 - a Display Controller: see ../display/atmel/lcdc-display-controller.txt

Example:
	lcdc0: lcdc@700000 {
		compatible = "atmel,at91sam9263-lcdc-mfd";
		reg = <0x700000 0x1000>;
		interrupts = <26 IRQ_TYPE_LEVEL_HIGH 3>;
		clocks = <&lcd_clk>, <&lcd_clk>;
		clock-names = "lcdc_clk", "hclk";

		lcdc-display-controller {
			compatible = "atmel,lcdc-display-controller";
			lcd-supply = <&lcdc_reg>;
			#address-cells = <1>;
			#size-cells = <0>;

			port@0 {
				reg = <0>;
				#address-cells = <1>;
				#size-cells = <0>;
				lcdc_panel_output: endpoint@0 {
					reg = <0>;
					remote-endpoint = <&panel_input>;
				};
			};
		};

		lcdc_pwm: lcdc-pwm {
			compatible = "atmel,lcdc-pwm";
			pinctrl-names = "default";
			pinctrl-0 = <&pinctrl_lcdc_pwm>;
			#pwm-cells = <3>;
		};

	};

	panel: panel {
		compatible = "logictechnologies,lttd800480070-l2rt", "simple-panel";
		backlight = <&backlight>;
		power-supply = <&panel_reg>;
		#address-cells = <1>;
		#size-cells = <0>;

		port@0 {
			#address-cells = <1>;
			#size-cells = <0>;

			panel_input: endpoint@0 {
				reg = <0>;
				remote-endpoint = <&lcdc_panel_output>;
			};
		};
	};
```

## Documentation/devicetree/bindings/mfd/cirrus,lochnagar.txt
```
Cirrus Logic Lochnagar Audio Development Board

Lochnagar is an evaluation and development board for Cirrus Logic
Smart CODEC and Amp devices. It allows the connection of most Cirrus
Logic devices on mini-cards, as well as allowing connection of
various application processor systems to provide a full evaluation
platform.  Audio system topology, clocking and power can all be
controlled through the Lochnagar, allowing the device under test
to be used in a variety of possible use cases.

Also see these documents for generic binding information:
  [1] GPIO : ../gpio/gpio.txt
  [2] Pinctrl: ../pinctrl/pinctrl-bindings.txt
  [3] Clock : ../clock/clock-bindings.txt
  [4] Regulator: ../regulator/regulator.txt

And these for relevant defines:
  [5] include/dt-bindings/pinctrl/lochnagar.h
  [6] include/dt-bindings/clock/lochnagar.h

Required properties:

  - compatible : One of the following strings:
                 "cirrus,lochnagar1"
                 "cirrus,lochnagar2"

  - reg : I2C slave address

  - gpio-controller : Indicates this device is a GPIO controller.
  - #gpio-cells : Must be 2. The first cell is the pin number, see
    [5] for available pins and the second cell is used to specify
    optional parameters, see [1].
  - gpio-ranges : Range of pins managed by the GPIO controller, see
    [1]. Both the GPIO and Pinctrl base should be set to zero and the
    count to the appropriate of the LOCHNAGARx_PIN_NUM_GPIOS define,
    see [5].

  - reset-gpios : Reset line to the Lochnagar, see [1].

  - #clock-cells : Must be 1. The first cell indicates the clock
    number, see [6] for available clocks and [3].

  - pinctrl-names : A pinctrl state named "default" must be defined.
  - pinctrl-0 : A phandle to the default pinctrl state.

  - SYSVDD-supply: Primary power supply for the Lochnagar.

Optional properties:

  - present-gpios : Host present line, indicating the presence of a
    host system, see [1]. This can be omitted if the present line is
    tied in hardware.

  - clocks : Must contain an entry for each clock in clock-names.
  - clock-names : May contain entries for each of the following
    clocks:
     - ln-cdc-clkout : Output clock from CODEC card.
     - ln-dsp-clkout : Output clock from DSP card.
     - ln-gf-mclk1,ln-gf-mclk2,ln-gf-mclk3,ln-gf-mclk4 : Optional
       input audio clocks from host system.
     - ln-psia1-mclk, ln-psia2-mclk : Optional input audio clocks from
       external connector.
     - ln-spdif-clkout : Optional input audio clock from SPDIF.
     - ln-adat-clkout : Optional input audio clock from ADAT.

  - assigned-clocks : A list of Lochnagar clocks to be reparented, see
    [6] for available clocks.
  - assigned-clock-parents : Parents to be assigned to the clocks
    listed in "assigned-clocks".

  - MICBIAS1-supply, MICBIAS2-supply: Regulator supplies for the
    MICxVDD outputs, supplying the digital microphones, normally
    supplied from the attached CODEC.

Required sub-nodes:

The pin configurations are defined as a child of the pinctrl states
node, see [2]. Each sub-node can have the following properties:
  - groups : A list of groups to select (either this or "pins" must be
    specified), available groups:
      codec-aif1, codec-aif2, codec-aif3, dsp-aif1, dsp-aif2, psia1,
      psia2, gf-aif1, gf-aif2, gf-aif3, gf-aif4, spdif-aif, usb-aif1,
      usb-aif2, adat-aif, soundcard-aif
  - pins : A list of pin names to select (either this or "groups" must
    be specified), available pins:
      fgpa-gpio1, fgpa-gpio2, fgpa-gpio3, fgpa-gpio4, fgpa-gpio5,
      fgpa-gpio6, codec-gpio1, codec-gpio2, codec-gpio3, codec-gpio4,
      codec-gpio5, codec-gpio6, codec-gpio7, codec-gpio8, dsp-gpio1,
      dsp-gpio2, dsp-gpio3, dsp-gpio4, dsp-gpio5, dsp-gpio6, gf-gpio2,
      gf-gpio3, gf-gpio7, codec-aif1-bclk, codec-aif1-rxdat,
      codec-aif1-lrclk, codec-aif1-txdat, codec-aif2-bclk,
      codec-aif2-rxdat, codec-aif2-lrclk, codec-aif2-txdat,
      codec-aif3-bclk, codec-aif3-rxdat, codec-aif3-lrclk,
      codec-aif3-txdat, dsp-aif1-bclk, dsp-aif1-rxdat, dsp-aif1-lrclk,
      dsp-aif1-txdat, dsp-aif2-bclk, dsp-aif2-rxdat,
      dsp-aif2-lrclk, dsp-aif2-txdat, psia1-bclk, psia1-rxdat,
      psia1-lrclk, psia1-txdat, psia2-bclk, psia2-rxdat, psia2-lrclk,
      psia2-txdat, gf-aif3-bclk, gf-aif3-rxdat, gf-aif3-lrclk,
      gf-aif3-txdat, gf-aif4-bclk, gf-aif4-rxdat, gf-aif4-lrclk,
      gf-aif4-txdat, gf-aif1-bclk, gf-aif1-rxdat, gf-aif1-lrclk,
      gf-aif1-txdat, gf-aif2-bclk, gf-aif2-rxdat, gf-aif2-lrclk,
      gf-aif2-txdat, dsp-uart1-rx, dsp-uart1-tx, dsp-uart2-rx,
      dsp-uart2-tx, gf-uart2-rx, gf-uart2-tx, usb-uart-rx,
      codec-pdmclk1, codec-pdmdat1, codec-pdmclk2, codec-pdmdat2,
      codec-dmicclk1, codec-dmicdat1, codec-dmicclk2, codec-dmicdat2,
      codec-dmicclk3, codec-dmicdat3, codec-dmicclk4, codec-dmicdat4,
      dsp-dmicclk1, dsp-dmicdat1, dsp-dmicclk2, dsp-dmicdat2, i2c2-scl,
      i2c2-sda, i2c3-scl, i2c3-sda, i2c4-scl, i2c4-sda, dsp-standby,
      codec-mclk1, codec-mclk2, dsp-clkin, psia1-mclk, psia2-mclk,
      gf-gpio1, gf-gpio5, dsp-gpio20, led1, led2
  - function : The mux function to select, available functions:
      aif, fgpa-gpio1, fgpa-gpio2, fgpa-gpio3, fgpa-gpio4, fgpa-gpio5,
      fgpa-gpio6, codec-gpio1, codec-gpio2, codec-gpio3, codec-gpio4,
      codec-gpio5, codec-gpio6, codec-gpio7, codec-gpio8, dsp-gpio1,
      dsp-gpio2, dsp-gpio3, dsp-gpio4, dsp-gpio5, dsp-gpio6, gf-gpio2,
      gf-gpio3, gf-gpio7, gf-gpio1, gf-gpio5, dsp-gpio20, codec-clkout,
      dsp-clkout, pmic-32k, spdif-clkout, clk-12m288, clk-11m2986,
      clk-24m576, clk-22m5792, xmos-mclk, gf-clkout1, gf-mclk1,
      gf-mclk3, gf-mclk2, gf-clkout2, codec-mclk1, codec-mclk2,
      dsp-clkin, psia1-mclk, psia2-mclk, spdif-mclk, codec-irq,
      codec-reset, dsp-reset, dsp-irq, dsp-standby, codec-pdmclk1,
      codec-pdmdat1, codec-pdmclk2, codec-pdmdat2, codec-dmicclk1,
      codec-dmicdat1, codec-dmicclk2, codec-dmicdat2, codec-dmicclk3,
      codec-dmicdat3, codec-dmicclk4, codec-dmicdat4, dsp-dmicclk1,
      dsp-dmicdat1, dsp-dmicclk2, dsp-dmicdat2, dsp-uart1-rx,
      dsp-uart1-tx, dsp-uart2-rx, dsp-uart2-tx, gf-uart2-rx,
      gf-uart2-tx, usb-uart-rx, usb-uart-tx, i2c2-scl, i2c2-sda,
      i2c3-scl, i2c3-sda, i2c4-scl, i2c4-sda, gpio, spdif-aif, psia1,
      psia1-bclk, psia1-lrclk, psia1-rxdat, psia1-txdat, psia2,
      psia2-bclk, psia2-lrclk, psia2-rxdat, psia2-txdat, codec-aif1,
      codec-aif1-bclk, codec-aif1-lrclk, codec-aif1-rxdat,
      codec-aif1-txdat, codec-aif2, codec-aif2-bclk, codec-aif2-lrclk,
      codec-aif2-rxdat, codec-aif2-txdat, codec-aif3, codec-aif3-bclk,
      codec-aif3-lrclk, codec-aif3-rxdat, codec-aif3-txdat, dsp-aif1,
      dsp-aif1-bclk, dsp-aif1-lrclk, dsp-aif1-rxdat, dsp-aif1-txdat,
      dsp-aif2, dsp-aif2-bclk, dsp-aif2-lrclk, dsp-aif2-rxdat,
      dsp-aif2-txdat, gf-aif3, gf-aif3-bclk, gf-aif3-lrclk,
      gf-aif3-rxdat, gf-aif3-txdat, gf-aif4, gf-aif4-bclk,
      gf-aif4-lrclk, gf-aif4-rxdat, gf-aif4-txdat, gf-aif1,
      gf-aif1-bclk, gf-aif1-lrclk, gf-aif1-rxdat, gf-aif1-txdat,
      gf-aif2, gf-aif2-bclk, gf-aif2-lrclk, gf-aif2-rxdat,
      gf-aif2-txdat, usb-aif1, usb-aif2, adat-aif, soundcard-aif,

  - aif-master : Specifies that an AIF group will be used as a master
    interface (either this or aif-slave is required if a group is
    being muxed to an AIF)
  - aif-slave : Specifies that an AIF group will be used as a slave
    interface (either this or aif-master is required if a group is
    being muxed to an AIF)

Optional sub-nodes:

  - VDDCORE : Initialisation data for the VDDCORE regulator, which
    supplies the CODECs digital core if it has no build regulator for that
    purpose.

  - MICVDD : Initialisation data for the MICVDD regulator, which
    supplies the CODECs MICVDD.
  - MIC1VDD, MIC2VDD : Initialisation data for the MICxVDD supplies.
      Optional Properties:
      - cirrus,micbias-input : A property selecting which of the CODEC
        minicard micbias outputs should be used, valid values are 1 - 4.

  - VDD1V8 : Recommended fixed regulator for the VDD1V8 regulator, which supplies the
    CODECs analog and 1.8V digital supplies.
      Required Properties:
      - compatible : Should be set to "regulator-fixed"
      - regulator-min-microvolt : Should be set to 1.8V
      - regulator-max-microvolt : Should be set to 1.8V
      - regulator-boot-on
      - regulator-always-on
      - vin-supply : Should be set to same supply as SYSVDD

Example:
lochnagar: lochnagar@22 {
	compatible = "cirrus,lochnagar2";
	reg = <0x22>;

	gpio-controller;
	#gpio-cells = <2>;
	gpio-ranges = <&lochnagar 0 0 110>;

	reset-gpio = <&gpio0 55 0>;
	present-gpio = <&gpio0 60 0>;

	#clock-cells = <1>;

	clocks = <&clk_audio>;
	clock-names = "ln-gf-mclk2";

	assigned-clocks = <&lochnagar LOCHNAGAR_CDC_MCLK1>,
			  <&lochnagar LOCHNAGAR_CDC_MCLK2>;
	assigned-clock-parents = <&clk_audio>,
				 <&lochnagar LOCHNAGAR_PMIC_32K>;

	SYSVDD-supply = <&wallvdd>;

	pinctrl-names = "default";
	pinctrl-0 = <&pin_settings>;

	pin_settings: pin_settings {
		ap_aif {
			aif-slave;
			groups = "gf-aif1";
			function = "codec-aif3";
		};
		codec_aif {
			aif-master;
			groups = "codec-aif3";
			function = "gf-aif1";
		};
	};

	lochnagar_micvdd: MICVDD {
		regulator-min-microvolt = <3300000>;
		regulator-max-microvolt = <3300000>;
	};

	lochnagar_vdd1v8: VDD1V8 {
		compatible = "regulator-fixed";

		regulator-name = "VDD1V8";
		regulator-min-microvolt = <1800000>;
		regulator-max-microvolt = <1800000>;
		regulator-boot-on;
		regulator-always-on;

		vin-supply = <&wallvdd>;
	};
};
```

## Documentation/devicetree/bindings/mfd/cpcap.txt
```
CPCAP PMIC device tree binding

Required properties:
- compatible		: Motorola device "motorola,cpcap", others "st,6556002"
- reg			: Chip select and size
- interrupt-parent	: The parent interrupt controller
- interrupts		: The interrupt line the device is connected to
- interrupt-controller	: Marks the device node as an interrupt controller
- #interrupt-cells	: The number of cells to describe an IRQ, should be 2
- #address-cells	: Child device offset number of cells, typically 1
- #size-cells		: Child device size number of cells, typically 1
- ranges		: Child device register range
- spi-max-frequency	: Typically set to 3000000
- spi-cs_high		: SPI chip select direction

Example:

&mcspi1 {
	#address-cells = <1>;
	#size-cells = <1>;
	ranges;
	cpcap: pmic@0 {
		compatible = "motorola,cpcap", "st,6556002";
		reg = <0 0>;	/* cs0, size 0 */
		interrupt-parent = <&gpio1>;
		interrupts = <7 IRQ_TYPE_EDGE_RISING>;
		interrupt-controller;
		#interrupt-cells = <2>;
		#address-cells = <1>;
		#size-cells = <1>;
		ranges = <0 0 0x8000>;
		spi-max-frequency = <3000000>;
		spi-cs-high;
	};
};
```

## Documentation/devicetree/bindings/mfd/ds1374.txt
```
* Device tree bindings for Maxim/Dallas DS1374 Multi Function Device (MFD)

The Maxim/Dallas DS1374 is a multi function device that combines rtc,
watchdog or alarm, as well as trickle charger.

The DS1374 is connected via I2C.

Required properties:
- compatible: "dallas,ds1374"
- reg: I2C slave address
- dallas,ds1374-mode: Should be one of the following values:
			<0> for RTC
			<1> for RTC + Alarm (Interrupt)
			<2> for RTC + Watchdog

Required child:
A single available child device of type matching the "dallas,ds1374-mode"
property.

Optional properties (watchdog):
- dallas,ds1374-remap-wdt-reset: Boolean describing whether the INT pin
				 on the device is used as interrupt for
				 the alarm

See ../watchdog/* for generic watchdog bindings.

Optional properties (real time clock):
- interrupt: phandle to interrupt cell for the rtc's alarm feature

See ../rtc/* for generic rtc bindings.

Optional properties (trickle-charger):
- dallas,trickle-resistor-ohms : Selected resistor for trickle charger
	Values usable for ds1374 are 250, 2000, 4000
	Should be given if trickle charger should be enabled
- dallas,trickle-diode-disable : Do not use internal trickle charger diode
	Should be given if internal trickle charger diode should be disabled

Example for rtc with alarm mode and interrupt:

i2c@12ca0000 {
	rtc@68 {
		compatible = "ds1374";
		reg = <0x68>;
		interrupts = <&gpio0 62>;
		dallas,ds1374-mode = <2>

		dallas,trickle-resistor-ohms = <250>;
		dallas,trickle-diode-disable;
	};
};

Example for rtc with watchdog and reset on timeout, with reset remapped
to the INT pin:

i2c@12ca0000 {
	rtc@68 {
		compatible = "ds1374";
		reg = <0x68>;
		dallas,ds1374-mode = <2>
		dallas,ds1374-remap-wdt-reset;
	};
};
```

## Documentation/devicetree/bindings/mfd/hi3519.txt
```
* Hisilicon Hi3519 System Controller Block

This bindings use the following binding:
Dcumentation/devicetree/bindings/clock/clock-bindings.txt

Required properties:
- compatible: "hislicon,hi3519-sysctrl".
- reg: the register region of this block

Examples:
sysctrl: system-controller@12010000 {
	compatible = "hisilicon,hi3519-sysctrl", "syscon";
	reg = <0x12010000 0x1000>;
};
```

## Documentation/devicetree/bindings/mfd/hisilicon,hi655x.txt
```
Hisilicon hi655x Power Management Integrated Circuit (PMIC)

Required properties:
- compatible: Should be "hisilicon,hi655x-pmic-driver"
- reg: Base address of PMIC on hi6220 soc
- #interrupt-cells: Should be 2, two cells are needed for irq.
- interrupt-controller: hi655x has internal IRQs (has own IRQ domain).
- pmu_irq_gpio: should be &gpio_pmu_irq_n, is the IRQ gpio of hi655x.

Example:
	pmic: pmic@f8000000 {
		compatible = "hisilicon,hi655x-pmic-driver";
		reg = <0x0 0xf8000000 0x0 0x1000>;
		#interrupt-cells = <2>;
		interrupt-controller;
		pmic_gpios = <&gpio_pmu_irq_n>;
		status = "okay";
	}
```
