## Documentation/devicetree/bindings/media/fsl-imx-capture.txt
```
Freescale i.MX IPUv3 capture subsystem
======================================

The i.MX5/6 IPUv3 capture subsystem consists of one or two IPUs and all
external subdevices connected to the IPU CSI input ports. On i.MX5 these
are only external subdevices. On i.MX6, there are additional SoC internal
multiplexers and a MIPI CSI-2 bridge connected to the CSI input ports via
of_graph bindings.

On i.MX6 variants with two IPUs, either a single capture subsystem node may be
defined, containing all CSI ports, or two separate capture subsystem nodes may
be defined, each containing the CSI ports of a single IPU. In the latter case
there must be no external of_graph links between the two subsystems.

Required properties:
- compatible: should be "fsl,imx-capture-subsystem"
- ports: should contain a list of phandles pointing to the capture interface
  ports of IPU devices

Example:

capture-subsystem {
        compatible = "fsl,imx-capture-subsystem";
        ports = <&ipu1_csi0>, <&ipu1_csi1>, <&ipu2_csi0>, <&ipu2_csi1>;
};

i.MX MIPI CSI-2 Host Controller
===============================

The i.MX6 contains an implementation of a Synopsys DesignWare MIPI CSI-2 host
controller combined with a CSI2IPU gasket that distributes the virtual channels
to up to four IPUv3 CSIs.

Required properties:
- compatible: should be "fsl,imx6q-mipi-csi2", "snps,dw-mipi-csi2"
- reg: should be register base and length as documented in the SoC
  reference manual
- clocks: should contain the pclk, cfg, ref, and pixel clocks, in the
  order determined by the clock-names property.
- clock-names: should be "pclk", "cfg", "ref", "pixel"
- address-cells: should be 1
- size-cells: should be 0
- port@*: five port nodes using of_graph bindings, one input port and four
  output ports corresponding to the virtual channels.

Example:

mipi_csi: mipi@021dc000 {
	compatible = "fsl,imx6q-mipi-csi2", "snps,dw-mipi-csi2";
	reg = <0x021dc000 0x4000>;
	clocks = <&clks IMX6QDL_CLK_HSI_TX>, <&clks IMX6QDL_CLK_HSI_TX>,
		 <&clks IMX6QDL_CLK_HSI_TX>, <&clks IMX6QDL_CLK_EIM_PODF>;
	clock-names = "pclk", "cfg", "ref", "pixel";
	#address-cells = <1>;
	#size-cells = <0>;

	port@0 {
		reg = <0>;
	};

	port@1 {
		reg = <1>;

		vc0: endpoint {
			remote-endpoint = <&csi0_in>;
		};
	};

	port@2 {
		reg = <2>;

		vc1: endpoint {
			remote-endpoint = <&csi1_in>;
		};
	};

	port@3 {
		reg = <3>;

		vc2: endpoint {
			remote-endpoint = <&csi2_in>;
		};
	};

	port@4 {
		reg = <4>;

		vc3: endpoint {
			remote-endpoint = <&csi3_in>;
		};
	};
};
```

## Documentation/devicetree/bindings/media/i2c/ad5820.txt
```
* Analog Devices AD5820 autofocus coil

Required Properties:

  - compatible: Must contain one of:
		- "adi,ad5820"
		- "adi,ad5821"
		- "adi,ad5823"

  - reg: I2C slave address

  - VANA-supply: supply of voltage for VANA pin

Optional properties:

   - enable-gpios : GPIO spec for the XSHUTDOWN pin. Note that the polarity of
the enable GPIO is the opposite of the XSHUTDOWN pin (asserting the enable
GPIO deasserts the XSHUTDOWN signal and vice versa).

Example:

       ad5820: coil@c {
               compatible = "adi,ad5820";
               reg = <0x0c>;

               VANA-supply = <&vaux4>;
               enable-gpios = <&msmgpio 26 GPIO_ACTIVE_HIGH>;
       };
```

## Documentation/devicetree/bindings/media/i2c/akm,ak7375.txt
```
Asahi Kasei Microdevices AK7375 voice coil lens driver

AK7375 is a 12-bit DAC intended for controlling voice coil lenses.

Mandatory properties:

- compatible: "akm,ak7375"
- reg: I2C slave address
```

## Documentation/devicetree/bindings/media/i2c/imi,rdacm20.txt
```
IMI D&D RDACM20 Automotive Camera Platform
------------------------------------------

The IMI D&D RDACM20 is a GMSL-compatible camera designed for automotive
applications. It encloses a Maxim Integrated MAX9271 GMSL serializer, an
Omnivision OV10635 camera sensor and an embedded MCU, and connects to a remote
GMSL endpoint through a coaxial cable.

                                                     IMI RDACM20
 ---------------                               --------------------------------
|      GMSL     |   <---  Video Stream        |       <- Video--------\        |
|               |< ====== GMSL Link ======== >|MAX9271<- I2C bus-> <-->OV10635 |
| de-serializer |   <---  I2C messages --->   |                   \<-->MCU     |
 ---------------                               --------------------------------

The RDACM20 transmits video data generated by the embedded camera sensor on the
GMSL serial channel to a remote GMSL de-serializer, as well as it receives and
transmits I2C messages encapsulated in the GMSL bidirectional control channel.

All I2C traffic received on the GMSL link not directed to the serializer is
propagated on the local I2C bus to the embedded camera sensor and MCU. All
I2C traffic generated on the local I2C bus not directed to the serializer is
propagated to the remote de-serializer encapsulated in the GMSL control channel.

The RDACM20 DT node should be a direct child of the GMSL Deserializer's I2C bus
corresponding to the GMSL link that the camera is attached to.

Required Properties:

- compatible: Shall be "imi,rdacm20".
- reg: Pair of I2C device addresses, the first to be assigned to the serializer
  the second to be assigned to the camera sensor.

Connection to the remote GMSL endpoint are modelled using the OF graph bindings
in accordance with the video interface bindings defined in
Documentation/devicetree/bindings/media/video-interfaces.txt.

The device node contains a single "port" child node with a single "endpoint"
sub-device.

Required endpoint properties:

- remote-endpoint: phandle to the remote GMSL endpoint sub-node in the remote
  node port.

Example:
-------

	i2c@0 {
		#address-cells = <1>;
		#size-cells = <0>;
		reg = <0>;

		camera@51 {
			compatible = "imi,rdacm20";
			reg = <0x51 0x61>;

			port {
				rdacm20_out0: endpoint {
					remote-endpoint = <&max9286_in0>;
				};
			};

		};
	};
```

## Documentation/devicetree/bindings/media/i2c/imx214.txt
```
* Sony 1/3.06-Inch 13.13Mp CMOS Digital Image Sensor

The Sony imx214 is a 1/3.06-inch CMOS active pixel digital image sensor with
an active array size of 4224H x 3176V. It is programmable through I2C
interface. The I2C address can be configured to to 0x1a or 0x10, depending on
how is wired.
Image data is sent through MIPI CSI-2, which is configured as 4 lanes
at 1440 Mbps.


Required Properties:
- compatible: value should be "sony,imx214" for imx214 sensor
- reg: I2C bus address of the device
- enable-gpios: Sensor enable GPIO
- vdddo-supply: Chip digital IO regulator (1.8V).
- vdda-supply: Chip analog regulator (2.7V).
- vddd-supply: Chip digital core regulator (1.12V).
- clocks = Reference to the xclk clock.
- clock-names = Should be "xclk".
- clock-frequency = Frequency of the xclk clock. Should be <24000000>;

Optional Properties:
- flash-leds: See ../video-interfaces.txt
- lens-focus: See ../video-interfaces.txt

The imx274 device node should contain one 'port' child node with
an 'endpoint' subnode. For further reading on port node refer to
Documentation/devicetree/bindings/media/video-interfaces.txt.

Example:

	camera_rear@1a {
		status = "okay";
		compatible = "sony,imx214";
		reg = <0x1a>;
		vdddo-supply = <&pm8994_lvs1>;
		vddd-supply = <&camera_vddd_1v12>;
		vdda-supply = <&pm8994_l17>;
		lens-focus = <&ad5820>;
		enable-gpios = <&msmgpio 25 GPIO_ACTIVE_HIGH>;
		clocks = <&mmcc CAMSS_MCLK0_CLK>;
		clock-names = "xclk";
		clock-frequency = <24000000>;
		port {
				imx214_ep: endpoint {
				clock-lanes = <1>;
				data-lanes = <0 2 3 4>;
				remote-endpoint = <&csiphy0_ep>;
			};
		};
	};
```

## Documentation/devicetree/bindings/media/i2c/max2175.txt
```
Maxim Integrated MAX2175 RF to Bits tuner
-----------------------------------------

The MAX2175 IC is an advanced analog/digital hybrid-radio receiver with
RF to Bits® front-end designed for software-defined radio solutions.

Required properties:
--------------------
- compatible: "maxim,max2175" for MAX2175 RF-to-bits tuner.
- clocks: phandle to the fixed xtal clock.
- clock-names: name of the fixed xtal clock.
- port: child port node of a tuner that defines the local and remote
  endpoints. The remote endpoint is assumed to be an SDR device
  that is capable of receiving the digital samples from the tuner.

Optional properties:
--------------------
- maxim,slave	      : phandle to the master tuner if it is a slave. This
			is used to define two tuners in diversity mode
			(1 master, 1 slave). By default each tuner is an
			individual master.
- maxim,refout-load-pF: load capacitance value (in pF) on reference
			output drive level. The possible load values are
			 0 (default - refout disabled)
			10
			20
			30
			40
			60
			70
- maxim,am-hiz	      : empty property indicates AM Hi-Z filter path is
			selected for AM antenna input. By default this
			filter path is not used.

Example:
--------

Board specific DTS file

/* Fixed XTAL clock node */
maxim_xtal: clock {
	compatible = "fixed-clock";
	#clock-cells = <0>;
	clock-frequency = <36864000>;
};

/* A tuner device instance under i2c bus */
max2175_0: tuner@60 {
	compatible = "maxim,max2175";
	reg = <0x60>;
	clocks = <&maxim_xtal>;
	clock-names = "xtal";
	maxim,refout-load-pF = <10>;

	port {
		max2175_0_ep: endpoint {
			remote-endpoint = <&slave_rx_device>;
		};
	};

};
```

## Documentation/devicetree/bindings/media/i2c/maxim,max9286.txt
```
Maxim Integrated Quad GMSL Deserializer
---------------------------------------

The MAX9286 deserializer receives video data on up to 4 Gigabit Multimedia
Serial Links (GMSL) and outputs them on a CSI-2 D-PHY port using up to 4 data
lanes.

In addition to video data, the GMSL links carry a bidirectional control channel
that encapsulates I2C messages. The MAX9286 forwards all I2C traffic not
addressed to itself to the other side of the links, where a GMSL serializer
will output it on a local I2C bus. In the other direction all I2C traffic
received over GMSL by the MAX9286 is output on the local I2C bus.

Required Properties:

- compatible: Shall be "maxim,max9286"
- reg: I2C device address

Optional Properties:

- poc-supply: Regulator providing Power over Coax to the cameras
- enable-gpios: GPIO connected to the #PWDN pin with inverted polarity

Required endpoint nodes:
-----------------------

The connections to the MAX9286 GMSL and its endpoint nodes are modeled using
the OF graph bindings in accordance with the video interface bindings defined
in Documentation/devicetree/bindings/media/video-interfaces.txt.

The following table lists the port number corresponding to each device port.

        Port            Description
        ----------------------------------------
        Port 0          GMSL Input 0
        Port 1          GMSL Input 1
        Port 2          GMSL Input 2
        Port 3          GMSL Input 3
        Port 4          CSI-2 Output

Optional Endpoint Properties for GMSL Input Ports (Port [0-3]):

- remote-endpoint: phandle to the remote GMSL source endpoint subnode in the
  remote node port.

Required Endpoint Properties for CSI-2 Output Port (Port 4):

- remote-endpoint: phandle to the remote CSI-2 sink endpoint node.
- data-lanes: array of physical CSI-2 data lane indexes.

Required i2c-mux nodes:
----------------------

Each GMSL link is modeled as a child bus of an i2c bus multiplexer/switch, in
accordance with bindings described in
Documentation/devicetree/bindings/i2c/i2c-mux.txt. The serializer device on the
remote end of the GMSL link shall be modelled as a child node of the
corresponding I2C bus.

Required i2c child bus properties:
- all properties described as required i2c child bus nodes properties in
  Documentation/devicetree/bindings/i2c/i2c-mux.txt.

Example:
-------

	gmsl-deserializer@2c {
		compatible = "maxim,max9286";
		reg = <0x2c>;
		poc-supply = <&camera_poc_12v>;
		enable-gpios = <&gpio 13 GPIO_ACTIVE_LOW>;

		#address-cells = <1>;
		#size-cells = <0>;

		ports {
			#address-cells = <1>;
			#size-cells = <0>;

			port@0 {
				reg = <0>;
				max9286_in0: endpoint {
					remote-endpoint = <&rdacm20_out0>;
				};
			};

			port@1 {
				reg = <1>;
				max9286_in1: endpoint {
					remote-endpoint = <&rdacm20_out1>;
				};
			};

			port@2 {
				reg = <2>;
				max9286_in2: endpoint {
					remote-endpoint = <&rdacm20_out2>;
				};
			};

			port@3 {
				reg = <3>;
				max9286_in3: endpoint {
					remote-endpoint = <&rdacm20_out3>;
				};
			};

			port@4 {
				reg = <4>;
				max9286_out: endpoint {
					data-lanes = <1 2 3 4>;
					remote-endpoint = <&csi40_in>;
				};
			};
		};

		i2c@0 {
			#address-cells = <1>;
			#size-cells = <0>;
			reg = <0>;

			camera@51 {
				compatible = "imi,rdacm20";
				reg = <0x51 0x61>;

				port {
					rdacm20_out0: endpoint {
						remote-endpoint = <&max9286_in0>;
					};
				};

			};
		};

		i2c@1 {
			#address-cells = <1>;
			#size-cells = <0>;
			reg = <1>;

			camera@52 {
				compatible = "imi,rdacm20";
				reg = <0x52 0x62>;
				port {
					rdacm20_out1: endpoint {
						remote-endpoint = <&max9286_in1>;
					};
				};
			};
		};

		i2c@2 {
			#address-cells = <1>;
			#size-cells = <0>;
			reg = <2>;

			camera@53 {
				compatible = "imi,rdacm20";
				reg = <0x53 0x63>;
				port {
					rdacm20_out2: endpoint {
						remote-endpoint = <&max9286_in2>;
					};
				};
			};
		};

		i2c@3 {
			#address-cells = <1>;
			#size-cells = <0>;
			reg = <3>;

			camera@54 {
				compatible = "imi,rdacm20";
				reg = <0x54 0x64>;
				port {
					rdacm20_out3: endpoint {
						remote-endpoint = <&max9286_in3>;
					};
				};
			};
		};
	};
```

## Documentation/devicetree/bindings/media/i2c/ov5645.txt
```
* Omnivision 1/4-Inch 5Mp CMOS Digital Image Sensor

The Omnivision OV5645 is a 1/4-Inch CMOS active pixel digital image sensor with
an active array size of 2592H x 1944V. It is programmable through a serial SCCB
interface.

Required Properties:
- compatible: value should be "ovti,ov5645"
- clocks: reference to the xclk clock
- clock-names: should be "xclk"
- assigned-clocks: reference to the xclk clock
- assigned-clock-rates: should be "23880000"

Optional Properties:
- reset-gpios: Chip reset GPIO
- pwdn-gpios: Chip power down GPIO
- dovdd-supply: Chip IO regulator
- dvdd-supply: Chip core regulator
- avdd-supply: Chip analog regulator

The device node must contain one 'port' child node for its digital output
video port, in accordance with the video interface bindings defined in
Documentation/devicetree/bindings/media/video-interfaces.txt.

Example:

	&i2c1 {
		...

		ov5645: ov5645@78 {
			compatible = "ovti,ov5645";
			reg = <0x78>;

			pwdn-gpios = <&gpio1 6 GPIO_ACTIVE_LOW>;
			reset-gpios = <&gpio5 20 GPIO_ACTIVE_LOW>;
			pinctrl-names = "default";
			pinctrl-0 = <&camera_rear_default>;

			clocks = <&clks 200>;
			clock-names = "xclk";
			assigned-clocks = <&clks 200>;
			assigned-clock-rates = <23880000>;

			dovdd-supply = <&camera_dovdd_1v8>;
			avdd-supply = <&camera_avdd_2v8>;
			dvdd-supply = <&camera_dvdd_1v2>;

			port {
				ov5645_ep: endpoint {
					clock-lanes = <1>;
					data-lanes = <0 2>;
					remote-endpoint = <&csi0_ep>;
				};
			};
		};
	};
```
