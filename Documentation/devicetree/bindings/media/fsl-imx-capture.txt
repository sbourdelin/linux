## Documentation/devicetree/bindings/media/renesas,drif.txt
```
Renesas R-Car Gen3 Digital Radio Interface controller (DRIF)
------------------------------------------------------------

R-Car Gen3 DRIF is a SPI like receive only slave device. A general
representation of DRIF interfacing with a master device is shown below.

+---------------------+                +---------------------+
|                     |-----SCK------->|CLK                  |
|       Master        |-----SS-------->|SYNC  DRIFn (slave)  |
|                     |-----SD0------->|D0                   |
|                     |-----SD1------->|D1                   |
+---------------------+                +---------------------+

As per datasheet, each DRIF channel (drifn) is made up of two internal
channels (drifn0 & drifn1). These two internal channels share the common
CLK & SYNC. Each internal channel has its own dedicated resources like
irq, dma channels, address space & clock. This internal split is not
visible to the external master device.

The device tree model represents each internal channel as a separate node.
The internal channels sharing the CLK & SYNC are tied together by their
phandles using a new property called "renesas,bonding". For the rest of
the documentation, unless explicitly stated, the word channel implies an
internal channel.

When both internal channels are enabled they need to be managed together
as one (i.e.) they cannot operate alone as independent devices. Out of the
two, one of them needs to act as a primary device that accepts common
properties of both the internal channels. This channel is identified by a
new property called "renesas,primary-bond".

To summarize,
   - When both the internal channels that are bonded together are enabled,
     the zeroth channel is selected as primary-bond. This channels accepts
     properties common to all the members of the bond.
   - When only one of the bonded channels need to be enabled, the property
     "renesas,bonding" or "renesas,primary-bond" will have no effect. That
     enabled channel can act alone as any other independent device.

Required properties of an internal channel:
-------------------------------------------
- compatible: "renesas,r8a7795-drif" if DRIF controller is a part of R8A7795 SoC.
	      "renesas,rcar-gen3-drif" for a generic R-Car Gen3 compatible device.
	      When compatible with the generic version, nodes must list the
	      SoC-specific version corresponding to the platform first
	      followed by the generic version.
- reg: offset and length of that channel.
- interrupts: associated with that channel.
- clocks: phandle and clock specifier of that channel.
- clock-names: clock input name string: "fck".
- dmas: phandles to the DMA channels.
- dma-names: names of the DMA channel: "rx".
- renesas,bonding: phandle to the other channel.

Optional properties of an internal channel:
-------------------------------------------
- power-domains: phandle to the respective power domain.

Required properties of an internal channel when:
	- It is the only enabled channel of the bond (or)
	- If it acts as primary among enabled bonds
--------------------------------------------------------
- pinctrl-0: pin control group to be used for this channel.
- pinctrl-names: must be "default".
- renesas,primary-bond: empty property indicating the channel acts as primary
			among the bonded channels.
- port: child port node of a channel that defines the local and remote
	endpoints. The remote endpoint is assumed to be a third party tuner
	device endpoint.

Optional properties of an internal channel when:
	- It is the only enabled channel of the bond (or)
	- If it acts as primary among enabled bonds
--------------------------------------------------------
- renesas,syncmd       : sync mode
			 0 (Frame start sync pulse mode. 1-bit width pulse
			    indicates start of a frame)
			 1 (L/R sync or I2S mode) (default)
- renesas,lsb-first    : empty property indicates lsb bit is received first.
			 When not defined msb bit is received first (default)
- renesas,syncac-active: Indicates sync signal polarity, 0/1 for low/high
			 respectively. The default is 1 (active high)
- renesas,dtdl         : delay between sync signal and start of reception.
			 The possible values are represented in 0.5 clock
			 cycle units and the range is 0 to 4. The default
			 value is 2 (i.e.) 1 clock cycle delay.
- renesas,syncdl       : delay between end of reception and sync signal edge.
			 The possible values are represented in 0.5 clock
			 cycle units and the range is 0 to 4 & 6. The default
			 value is 0 (i.e.) no delay.

Example
--------

SoC common dtsi file

		drif00: rif@e6f40000 {
			compatible = "renesas,r8a7795-drif",
				     "renesas,rcar-gen3-drif";
			reg = <0 0xe6f40000 0 0x64>;
			interrupts = <GIC_SPI 12 IRQ_TYPE_LEVEL_HIGH>;
			clocks = <&cpg CPG_MOD 515>;
			clock-names = "fck";
			dmas = <&dmac1 0x20>, <&dmac2 0x20>;
			dma-names = "rx", "rx";
			power-domains = <&sysc R8A7795_PD_ALWAYS_ON>;
			renesas,bonding = <&drif01>;
			status = "disabled";
		};

		drif01: rif@e6f50000 {
			compatible = "renesas,r8a7795-drif",
				     "renesas,rcar-gen3-drif";
			reg = <0 0xe6f50000 0 0x64>;
			interrupts = <GIC_SPI 13 IRQ_TYPE_LEVEL_HIGH>;
			clocks = <&cpg CPG_MOD 514>;
			clock-names = "fck";
			dmas = <&dmac1 0x22>, <&dmac2 0x22>;
			dma-names = "rx", "rx";
			power-domains = <&sysc R8A7795_PD_ALWAYS_ON>;
			renesas,bonding = <&drif00>;
			status = "disabled";
		};


Board specific dts file

(1) Both internal channels enabled, primary-bond = 0
-----------------------------------------------------

When interfacing with a third party tuner device with two data pins as shown
below.

+---------------------+                +---------------------+
|                     |-----SCK------->|CLK                  |
|       Master        |-----SS-------->|SYNC  DRIFn (slave)  |
|                     |-----SD0------->|D0                   |
|                     |-----SD1------->|D1                   |
+---------------------+                +---------------------+

pfc {
	...

	drif0_pins: drif0 {
		groups = "drif0_ctrl_a", "drif0_data0_a",
				 "drif0_data1_a";
		function = "drif0";
	};
	...
}

&drif00 {
	pinctrl-0 = <&drif0_pins>;
	pinctrl-names = "default";
	renesas,syncac-active = <1>;
	renesas,primary-bond;
	status = "okay";
	port {
		drif0_ep: endpoint {
		     remote-endpoint = <&tuner_ep>;
		};
	};
};

&drif01 {
	status = "okay";
};

(2) Internal channel 1 alone is enabled:
----------------------------------------

When interfacing with a third party tuner device with one data pin as shown
below.

+---------------------+                +---------------------+
|                     |-----SCK------->|CLK                  |
|       Master        |-----SS-------->|SYNC  DRIFn (slave)  |
|                     |                |D0 (unused)          |
|                     |-----SD-------->|D1                   |
+---------------------+                +---------------------+

pfc {
	...

	drif0_pins: drif0 {
		groups = "drif0_ctrl_a", "drif0_data1_a";
		function = "drif0";
	};
	...
}

&drif01 {
	pinctrl-0 = <&drif0_pins>;
	pinctrl-names = "default";
	renesas,syncac-active = <0>;
	status = "okay";
	port {
		drif0_ep: endpoint {
		     remote-endpoint = <&tuner_ep>;
		};
	};
};
```

## Documentation/devicetree/bindings/media/rk1608.txt
```
Rockchip RK1608 as a PreISP to link on Soc
------------------------------------------

Required properties:

- compatible		: "rockchip,rk1608";
- reg			: SPI slave address of the rk1608;
- clocks		: Must contain an entry for each entry in clock-names;
- clock-names		: Must contain "mclk" for the device's master clock;
- reset-gpio		: GPIO connected to reset pin;
- irq-gpio		: GPIO connected to irq pin;
- sleepst-gpio		: GPIO connected to sleepst pin;
- wakeup-gpio		: GPIO connected to wakeup pin;
- powerdown-gpio	: GPIO connected to powerdown pin;
- rockchip,powerdown0	: GPIO connected to the sensor0's powerdown pin;
- rockchip,reset0	: GPIO connected to the sensor0's reset pin;
- rockchip,powerdown1	: GPIO connected to the sensor1's powerdown pin;
- rockchip,reset1	: GPIO connected to the sensor1's reset pin;
- pinctrl-names		: Should contain only one value - "default";
- pinctrl-0		: Pin control group to be used for this controller;

Optional properties:

- spi-max-frequency	: Maximum SPI clocking speed of the device;

The device node should contain one 'port' child node with one child 'endpoint'
node, according to the bindings defined in Documentation/devicetree/bindings/
media/video-interfaces.txt. The following are properties specific to those
nodes.

endpoint node
-------------

- data-lanes : (optional) specifies MIPI CSI-2 data lanes as covered in
	       video-interfaces.txt. If present it should be <1> - the device
	       supports only one data lane without re-mapping.

Note1: Since no data is generated in RK1608，so this is meaningful that you need
a extra sensor (such as a camera) mounted on RK1608. You need to use endpoint@x
to match these sensors.

Note2:You must set the current value of the spi pins to be 8mA, if they are not.

Example:
&spi0 {
	status = "okay";
	spi_rk1608@00 {
		compatible =  "rockchip,rk1608";
		status = "okay";
		reg = <0>;
		spi-max-frequency = <24000000>;
		link-freqs = /bits/ 64 <400000000>;
		clocks = <&cru SCLK_SPI0>, <&cru SCLK_VIP_OUT>,
		<&cru DCLK_VOP0>, <&cru ACLK_VIP>, <&cru HCLK_VIP>,
		<&cru PCLK_ISP_IN>, <&cru PCLK_ISP_IN>,
		<&cru PCLK_ISP_IN>, <&cru SCLK_MIPIDSI_24M>,
		<&cru PCLK_MIPI_CSI>;
		clock-names = "mclk", "mipi_clk",  "pd_cif", "aclk_cif",
			"hclk_cif", "cif0_in", "g_pclkin_cif",
			"cif0_out", "clk_mipi_24m", "hclk_mipiphy";
		reset-gpio = <&gpio6 0 GPIO_ACTIVE_HIGH>;
		irq-gpio = <&gpio6 2 GPIO_ACTIVE_HIGH>;
		sleepst-gpio = <&gpio6 1 GPIO_ACTIVE_HIGH>;
		wakeup-gpio = <&gpio6 4 GPIO_ACTIVE_HIGH>;
		powerdown-gpio = <&gpio8 0 GPIO_ACTIVE_HIGH>;

		rockchip,powerdown1 = <&gpio5 9 GPIO_ACTIVE_HIGH>;
		rockchip,reset1 = <&gpio6 8 GPIO_ACTIVE_HIGH>;

		rockchip,powerdown0 = <&gpio5 8 GPIO_ACTIVE_HIGH>;
		rockchip,reset0 = <&gpio6 7 GPIO_ACTIVE_HIGH>;

		pinctrl-names = "default";
		pinctrl-0 = <&rk1608_irq_gpios &rk1608_wake_gpios
			     &rk1608_sleep_gpios>;

		port@0 {
			mipi_dphy_out: endpoint {
				remote-endpoint = <&mipi_dphy_in>;
				clock-lanes = <0>;
				data-lanes = <1 2 3 4>;
				clock-noncontinuous;
				link-frequencies =
					/bits/ 64 <400000000>;
			};
		};
		/* Example: we have two cameras */
		port@1 {
			sensor_in0: endpoint@0 {
				remote-endpoint = <&sensor_out0>;
			};
			sensor_in1: endpoint@1 {
				remote-endpoint = <&sensor_out1>;
			};
		};
	};
};
```

## Documentation/devicetree/bindings/media/snps,dw-csi-plat.txt
```
Synopsys DesignWare CSI-2 Host controller

Description
-----------

This HW block is used to receive image coming from an MIPI CSI-2 compatible
camera.

Required properties:
- compatible: shall be "snps,dw-csi-plat"
- reg			: physical base address and size of the device memory mapped
  registers;
- interrupts		: CSI-2 Host interrupt
- snps,output-type	: Core output to be used (IPI-> 0 or IDI->1 or BOTH->2)
			  These  values choose which of the Core outputs will be used,
			  it can be Image Data Interface or Image Pixel Interface.
- phys			: List of one PHY specifier (as defined in
			  Documentation/devicetree/bindings/phy/phy-bindings.txt).
			  This PHY is a MIPI DPHY working in RX mode.
- resets		: Reference to a reset controller (optional)

The per-board settings:
 - port sub-node describing a single endpoint connected to the camera as
   described in video-interfaces.txt[1].

Example:

	csi2_1: csi2@3000 {
		compatible = "snps,dw-csi-plat";
		#address-cells = <1>;
		#size-cells = <0>;
		reg = < 0x03000 0x7FF>;
		interrupts = <2>;
		output-type = <2>;
		resets = <&dw_rst 1>;
		phys = <&mipi_dphy_rx1 0>;
		phy-names = "csi2-dphy";

		/* CSI-2 per-board settings */
		port@1 {
			reg = <1>;
			csi1_ep1: endpoint {
				remote-endpoint = <&camera_1>;
				data-lanes = <1 2>;
			};
		};
		port@2 {
			csi1_ep2: endpoint {
				remote-endpoint = <&vif1_ep>;
			};
		};
	};
```

## Documentation/devicetree/bindings/media/snps,dw-hdmi-rx.txt
```
Synopsys DesignWare HDMI RX Decoder
===================================

This document defines device tree properties for the Synopsys DesignWare HDMI
RX Decoder (DWC HDMI RX).

The properties bellow belong to the Synopsys DesignWare HDMI RX Decoder node.

Required properties:

- compatible: Shall be "snps,dw-hdmi-rx".
- reg: Memory mapped base address and length of the DWC HDMI RX registers.
- interrupts: Reference to the DWC HDMI RX interrupt and the HDMI 5V sense
interrupt.
- clocks: Reference to the config clock.
- clock-names: Shall be "cfg".
- #address-cells: Shall be 1.
- #size-cells: Shall be 0.

Optional properties:

- edid-phandle: Reference to the EDID handler block; if this property is not
specified it is assumed that EDID is handled by device described by parent
node of the HDMI RX node. You should not specify this property if your HDMI RX
controller does not have CEC.

You also have to create a subnode for the PHY device. PHY node properties are
as follows.

Required properties:

- compatible: Shall be "snps,dw-hdmi-phy-e405".
- reg: Shall be the JTAG address of the PHY.
- clocks: Reference to the config clock.
- clock-names: Shall be "cfg".

Example:

hdmi_rx: hdmi-rx@0 {
	compatible = "snps,dw-hdmi-rx";
	reg = <0x0 0x10000>;
	interrupts = <1 2>;
	edid-phandle = <&dw_hdmi_edid>;

	clocks = <&dw_hdmi_refclk>;
	clock-names = "cfg";

	#address-cells = <1>;
	#size-cells = <0>;

	hdmi-phy@fc {
		compatible = "snps,dw-hdmi-phy-e405";
		reg = <0xfc>;

		clocks = <&dw_hdmi_refclk>;
		clock-names = "cfg";
	};
};
```

## Documentation/devicetree/bindings/media/snps,dw-mipi-csi.txt
```
Synopsys DesignWare CSI-2 Host controller

Description
-----------

This HW block is used to receive image coming from an MIPI CSI-2 compatible
camera.

Required properties:
- compatible: shall be "snps,dw-mipi-csi"
- reg		: physical base address and size of the device memory mapped
		  registers;
- interrupts	: CSI-2 Host interrupt
- data-lanes    : Number of lanes to be used
- output-type   : Core output to be used (IPI-> 0 or IDI->1 or BOTH->2)
- phys, phy-names: List of one PHY specifier and identifier string (as defined
  in Documentation/devicetree/bindings/phy/phy-bindings.txt).

Optional properties(if in IPI mode):
- ipi-mode 	: Mode to be used when in IPI(Camera -> 0 or Automatic -> 1)
- ipi-color-mode: Color depth to be used in IPI (48 bits -> 0 or 16 bits -> 1)
- ipi-auto-flush: Data auto-flush (1 -> Yes or 0 -> No)
- virtual-channel: Virtual channel where data is present when in IPI

The per-board settings:
 - port sub-node describing a single endpoint connected to the dw-mipi-csi
   as described in video-interfaces.txt[1].
```

## Documentation/devicetree/bindings/media/snps,plat-ipk.txt
```
Synopsys DesignWare CSI-2 Host IPK Media Device

This Media Device at the moment is not totally functional, however it is a base
for the future.

Required properties:

- compatible: Must be "snps,plat-ipk".
```
