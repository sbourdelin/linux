## Documentation/devicetree/bindings/media/spi-ir.txt
```
Device tree bindings for IR LED connected through SPI bus which is used as
remote controller.

The IR LED switch is connected to the MOSI line of the SPI device and the data
are delivered thourgh that.

Required properties:
	- compatible: should be "ir-spi".

Optional properties:
	- irled,switch: specifies the gpio switch which enables the irled/
	- negated: boolean value that specifies whether the output is negated
	  with a NOT gate.
	- duty-cycle: 8 bit value that stores the percentage of the duty cycle.
	  it can be 50, 60, 70, 75, 80 or 90.

Example:

        irled@0 {
                compatible = "ir-spi";
                reg = <0x0>;
                spi-max-frequency = <5000000>;
                irled,switch = <&gpr3 3 0>;
		negated;
		duty-cycle = /bits/ 8 <60>;
        };
```

## Documentation/devicetree/bindings/media/st,stm32-dcmi.txt
```
STMicroelectronics STM32 Digital Camera Memory Interface (DCMI)

Required properties:
- compatible: "st,stm32-dcmi"
- reg: physical base address and length of the registers set for the device;
- interrupts: should contain IRQ line for the DCMI;
- clocks: list of clock specifiers, corresponding to entries in
          the clock-names property;
- clock-names: must contain "mclk", which is the DCMI peripherial clock.
- resets: Reference to a reset controller
- reset-names: see Documentation/devicetree/bindings/reset/st,stm32-rcc.txt

DCMI supports a single port node with parallel bus. It should contain one
'port' child node with child 'endpoint' node. Please refer to the bindings
defined in Documentation/devicetree/bindings/media/video-interfaces.txt.

Example:

Device node example
-------------------
	dcmi: dcmi@50050000 {
		compatible = "st,stm32-dcmi";
		reg = <0x50050000 0x400>;
		interrupts = <78>;
		resets = <&rcc STM32F4_AHB2_RESET(DCMI)>;
		clocks = <&rcc 0 STM32F4_AHB2_CLOCK(DCMI)>;
		clock-names = "mclk";
		pinctrl-names = "default";
		pinctrl-0 = <&dcmi_pins>;
		dmas = <&dma2 1 1 0x414 0x3>;
		dma-names = "tx";
		status = "disabled";
	};

Board setup example
-------------------

&dcmi {
	status = "okay";

	port {
		dcmi_0: endpoint@0 {
			remote-endpoint = <&ov2640_0>;
			bus-width = <8>;
			hsync-active = <0>;
			vsync-active = <0>;
			pclk-sample = <1>;
		};
	};
};

{
	[...]
	i2c@0 {
		ov2640: camera@30 {
			compatible = "ovti,ov2640";
			reg = <0x30>;
			resetb-gpios = <&stmpegpio 2 GPIO_ACTIVE_HIGH>;
			pwdn-gpios = <&stmpegpio 0 GPIO_ACTIVE_LOW>;
			clocks = <&clk_ext_camera>;
			clock-names = "xvclk";
			status = "okay";

			port {
				ov2640_0: endpoint {
					remote-endpoint = <&dcmi_0>;
				};
			};
		};
	};

	clk_ext_camera: clk-ext-camera {
		#clock-cells = <0>;
		compatible = "fixed-clock";
		clock-frequency = <24000000>;
	};
}
```

## Documentation/devicetree/bindings/media/sun6i-csi.txt
```
Allwinner V3s Camera Sensor Interface
------------------------------

Required properties:
  - compatible: value must be "allwinner,sun8i-v3s-csi"
  - reg: base address and size of the memory-mapped region.
  - interrupts: interrupt associated to this IP
  - clocks: phandles to the clocks feeding the CSI
    * ahb: the CSI interface clock
    * mod: the CSI module clock
    * ram: the CSI DRAM clock
  - clock-names: the clock names mentioned above
  - resets: phandles to the reset line driving the CSI

- ports: A ports node with endpoint definitions as defined in
  Documentation/devicetree/bindings/media/video-interfaces.txt.

Example:

	csi1: csi@01cb4000 {
		compatible = "allwinner,sun8i-v3s-csi";
		reg = <0x01cb4000 0x1000>;
		interrupts = <GIC_SPI 84 IRQ_TYPE_LEVEL_HIGH>;
		clocks = <&ccu CLK_BUS_CSI>,
			 <&ccu CLK_CSI1_SCLK>,
			 <&ccu CLK_DRAM_CSI>;
		clock-names = "ahb", "mod", "ram";
		resets = <&ccu RST_BUS_CSI>;

		port {
			#address-cells = <1>;
			#size-cells = <0>;

			/* Parallel bus endpoint */
			csi1_ep: endpoint {
				remote-endpoint = <&adv7611_ep>;
				bus-width = <16>;
				data-shift = <0>;

				/* If hsync-active/vsync-active are missing,
				   embedded BT.656 sync is used */
				hsync-active = <0>; /* Active low */
				vsync-active = <0>; /* Active low */
				data-active = <1>;  /* Active high */
				pclk-sample = <1>;  /* Rising */
			};
		};
	};
```

## Documentation/devicetree/bindings/media/ti,da850-vpif-capture.txt
```
Texas Instruments VPIF Capture
------------------------------

The TI Video Port InterFace (VPIF) capture component is the primary
component for video capture on the DA850 family of TI DaVinci SoCs.

TI Document number reference: SPRUH82C

Required properties:
- compatible: must be "ti,da850-vpif-capture"
- reg: physical base address and length of the registers set for the device;
- interrupts: should contain IRQ line for the VPIF

VPIF capture has a 16-bit parallel bus input, supporting 2 8-bit
channels or a single 16-bit channel.  It should contain at least one
port child node with child 'endpoint' node. Please refer to the
bindings defined in
Documentation/devicetree/bindings/media/video-interfaces.txt.

Example using 2 8-bit input channels, one of which is connected to an
I2C-connected TVP5147 decoder:

	vpif_capture: video-capture@0x00217000 {
		compatible = "ti,da850-vpif-capture";
		reg = <0x00217000 0x1000>;
		interrupts = <92>;

		port {
			vpif_ch0: endpoint@0 {
				  reg = <0>;
				  bus-width = <8>;
				  remote-endpoint = <&composite>;
			};

			vpif_ch1: endpoint@1 {
				  reg = <1>;
				  bus-width = <8>;
				  data-shift = <8>;
			};
		};
	};

[ ... ]

&i2c0 {

	tvp5147@5d {
		compatible = "ti,tvp5147";
		reg = <0x5d>;
		status = "okay";

		port {
			composite: endpoint {
				hsync-active = <1>;
				vsync-active = <1>;
				pclk-sample = <0>;

				/* VPIF channel 0 (lower 8-bits) */
				remote-endpoint = <&vpif_ch0>;
				bus-width = <8>;
			};
		};
	};

};
```
