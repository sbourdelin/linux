## Documentation/devicetree/bindings/media/i2c/ov5647.txt
```
Omnivision OV5647 raw image sensor
---------------------------------

OV5647 is a raw image sensor with MIPI CSI-2 and CCP2 image data interfaces
and CCI (I2C compatible) control bus.

Required properties:

- compatible		: "ovti,ov5647".
- reg			: I2C slave address of the sensor.
- clocks		: Reference to the xclk clock.
- clock-names		: Should be "xclk".
- clock-frequency	: Frequency of the xclk clock.

The common video interfaces bindings (see video-interfaces.txt) should be
used to specify link to the image data receiver. The OV5647 device
node should contain one 'port' child node with an 'endpoint' subnode.

Example:

	i2c@2000 {
		...
		ov: camera@36 {
			compatible = "ovti,ov5647";
			reg = <0x36>;
			clocks = <&camera_clk>;
			clock-names = "xclk";
			clock-frequency = <30000000>;
			port {
				camera_1: endpoint {
					remote-endpoint = <&csi1_ep1>;
				};
			};
		};
	};
```

## Documentation/devicetree/bindings/media/i2c/ov7740.txt
```
* Omnivision OV7740 CMOS image sensor

The Omnivision OV7740 image sensor supports multiple output image
size, such as VGA, and QVGA, CIF and any size smaller. It also
supports the RAW RGB and YUV output formats.

Required Properties:
- compatible: should be "ovti,ov7740"
- clocks: reference to the xvclk input clock.
- clock-names: should be "xvclk".

Optional Properties:
- reset-gpios: reference to the GPIO connected to the reset_b pin,
  if any. Active low with pull-ip resistor.
- powerdown-gpios: reference to the GPIO connected to the pwdn pin,
  if any. Active high with pull-down resistor.

The device node must contain one 'port' child node for its digital
output video port, in accordance with the video interface bindings
defined in Documentation/devicetree/bindings/media/video-interfaces.txt.

Example:

	i2c1: i2c@fc028000 {
		ov7740: camera@21 {
			compatible = "ovti,ov7740";
			reg = <0x21>;
			pinctrl-names = "default";
			pinctrl-0 = <&pinctrl_sensor_power &pinctrl_sensor_reset>;
			clocks = <&isc>;
			clock-names = "xvclk";
			assigned-clocks = <&isc>;
			assigned-clock-rates = <24000000>;
			reset-gpios = <&pioA 43 GPIO_ACTIVE_LOW>;
			powerdown-gpios = <&pioA 44 GPIO_ACTIVE_HIGH>;

			port {
				ov7740_0: endpoint {
					remote-endpoint = <&isc_0>;
				};
			};
		};
	};
```

## Documentation/devicetree/bindings/media/i2c/toshiba,tc358746.txt
```
* Toshiba TC358746 Parallel to MIPI CSI2-TX or MIPI CSI2-RX to Parallel Bridge

The Toshiba TC358746 is a bridge that converts a Parallel-in stream to MIPI CSI-2 TX
or a MIPI CSI-2 RX stream into a Parallel-out. It is programmable through I2C.

Required Properties:

- compatible: should be "toshiba,tc358746"
- reg: should be <0x0e>
- clocks: should contain a phandle link to the reference clock source
- clock-names: the clock input is named "refclk".

Optional Properties:

- reset-gpios: gpio phandle GPIO connected to the reset pin

Parallel Endpoint:

Required Properties:

- reg: should be <0>
- bus-width: the data bus width e.g. <8> for eight bit bus, or <16>
	     for sixteen bit wide bus.

MIPI CSI-2 Endpoint:

Required Properties:

- reg: should be <1>
- data-lanes: should be <1 2 3 4> for four-lane operation,
	      or <1 2> for two-lane operation
- clock-lanes: should be <0>
- link-frequencies: List of allowed link frequencies in Hz. Each frequency is
		    expressed as a 64-bit big-endian integer. The frequency
		    is half of the bps per lane due to DDR transmission.

Optional Properties:

- clock-noncontinuous: Presence of this boolean property decides whether the
		       MIPI CSI-2 clock is continuous or non-continuous.

For further information on the endpoint node properties, see
Documentation/devicetree/bindings/media/video-interfaces.txt.

Example:

&i2c {
	tc358746: tc358746@0e {
		reg = <0x0e>;
		compatible = "toshiba,tc358746";
		pinctrl-names = "default";
		clocks = <&clk_cam_ref>;
		clock-names = "refclk";
		reset-gpios = <&gpio3 2 GPIO_ACTIVE_LOW>;

		#address-cells = <1>;
		#size-cells = <0>;

		port@0 {
			reg = <0>;

			tc358746_parallel_in: endpoint {
				bus-width = <8>;
				remote-endpoint = <&micron_parallel_out>;
			};
		};

		port@1 {
			reg = <1>;

			tc358746_mipi2_out: endpoint {
				remote-endpoint = <&mipi_csi2_in>;
				data-lanes = <1 2>;
				clock-lanes = <0>;
				clock-noncontinuous;
				link-frequencies = /bits/ 64 <216000000>;
			};
		};
	};
};
```

## Documentation/devicetree/bindings/media/imx.txt
```
Freescale i.MX Media Video Device
=================================

Video Media Controller node
---------------------------

This is the media controller node for video capture support. It is a
virtual device that lists the camera serial interface nodes that the
media device will control.

Required properties:
- compatible : "fsl,imx-capture-subsystem";
- ports      : Should contain a list of phandles pointing to camera
		sensor interface ports of IPU devices

example:

capture-subsystem {
	compatible = "fsl,imx-capture-subsystem";
	ports = <&ipu1_csi0>, <&ipu1_csi1>;
};


mipi_csi2 node
--------------

This is the device node for the MIPI CSI-2 Receiver, required for MIPI
CSI-2 sensors.

Required properties:
- compatible	: "fsl,imx6-mipi-csi2", "snps,dw-mipi-csi2";
- reg           : physical base address and length of the register set;
- clocks	: the MIPI CSI-2 receiver requires three clocks: hsi_tx
		  (the D-PHY clock), video_27m (D-PHY PLL reference
		  clock), and eim_podf;
- clock-names	: must contain "dphy", "ref", "pix";
- port@*        : five port nodes must exist, containing endpoints
		  connecting to the source and sink devices according to
		  of_graph bindings. The first port is an input port,
		  connecting with a MIPI CSI-2 source, and ports 1
		  through 4 are output ports connecting with parallel
		  bus sink endpoint nodes and correspond to the four
		  MIPI CSI-2 virtual channel outputs.

Optional properties:
- interrupts	: must contain two level-triggered interrupts,
		  in order: 100 and 101;
```

## Documentation/devicetree/bindings/media/mediatek-vcodec.txt
```
Mediatek Video Codec

Mediatek Video Codec is the video codec hw present in Mediatek SoCs which
supports high resolution encoding functionalities.

Required properties:
- compatible : "mediatek,mt8173-vcodec-enc" for encoder
- reg : Physical base address of the video codec registers and length of
  memory mapped region.
- interrupts : interrupt number to the cpu.
- mediatek,larb : must contain the local arbiters in the current Socs.
- clocks : list of clock specifiers, corresponding to entries in
  the clock-names property;
- clock-names: must contain "vencpll", "venc_lt_sel", "vcodecpll_370p5_ck"
- iommus : list of iommus specifiers should be enabled for hw encode.
  There are 2 cells needed to enable/disable iommu.
  The first one is local arbiter index(larbid), and the other is port
  index(portid) within local arbiter. Specifies the larbid and portid
  as defined in dt-binding/memory/mt8173-larb-port.h.
- mediatek,vpu : the node of video processor unit

Example:
vcodec_enc: vcodec@0x18002000 {
    compatible = "mediatek,mt8173-vcodec-enc";
    reg = <0 0x18002000 0 0x1000>,    /*VENC_SYS*/
          <0 0x19002000 0 0x1000>;    /*VENC_LT_SYS*/
    interrupts = <GIC_SPI 198 IRQ_TYPE_LEVEL_LOW>,
           <GIC_SPI 202 IRQ_TYPE_LEVEL_LOW>;
    larb = <&larb3>,
           <&larb5>;
    iommus = <&iommu M4U_LARB3_ID M4U_PORT_VENC_RCPU>,
             <&iommu M4U_LARB3_ID M4U_PORT_VENC_REC>,
             <&iommu M4U_LARB3_ID M4U_PORT_VENC_BSDMA>,
             <&iommu M4U_LARB3_ID M4U_PORT_VENC_SV_COMV>,
             <&iommu M4U_LARB3_ID M4U_PORT_VENC_RD_COMV>,
             <&iommu M4U_LARB3_ID M4U_PORT_VENC_CUR_LUMA>,
             <&iommu M4U_LARB3_ID M4U_PORT_VENC_CUR_CHROMA>,
             <&iommu M4U_LARB3_ID M4U_PORT_VENC_REF_LUMA>,
             <&iommu M4U_LARB3_ID M4U_PORT_VENC_REF_CHROMA>,
             <&iommu M4U_LARB3_ID M4U_PORT_VENC_NBM_RDMA>,
             <&iommu M4U_LARB3_ID M4U_PORT_VENC_NBM_WDMA>,
             <&iommu M4U_LARB5_ID M4U_PORT_VENC_RCPU_SET2>,
             <&iommu M4U_LARB5_ID M4U_PORT_VENC_REC_FRM_SET2>,
             <&iommu M4U_LARB5_ID M4U_PORT_VENC_BSDMA_SET2>,
             <&iommu M4U_LARB5_ID M4U_PORT_VENC_SV_COMA_SET2>,
             <&iommu M4U_LARB5_ID M4U_PORT_VENC_RD_COMA_SET2>,
             <&iommu M4U_LARB5_ID M4U_PORT_VENC_CUR_LUMA_SET2>,
             <&iommu M4U_LARB5_ID M4U_PORT_VENC_CUR_CHROMA_SET2>,
             <&iommu M4U_LARB5_ID M4U_PORT_VENC_REF_LUMA_SET2>,
             <&iommu M4U_LARB5_ID M4U_PORT_VENC_REC_CHROMA_SET2>;
    vpu = <&vpu>;
    clocks = <&apmixedsys CLK_APMIXED_VENCPLL>,
             <&topckgen CLK_TOP_VENC_LT_SEL>,
             <&topckgen CLK_TOP_VCODECPLL_370P5>;
    clock-names = "vencpll",
                  "venc_lt_sel",
                  "vcodecpll_370p5_ck";
  };
```

## Documentation/devicetree/bindings/media/mtk-cir.txt
```
Device-Tree bindings for Mediatek IR controller found in Mediatek SoC family

Required properties:
- compatible	    : "mediatek,mt7623-ir"
- clocks	    : list of clock specifiers, corresponding to
		      entries in clock-names property;
- clock-names	    : should contain "clk" entries;
- interrupts	    : should contain IR IRQ number;
- reg		    : should contain IO map address for IR.

Optional properties:
- linux,rc-map-name : Remote control map name.

Example:

cir: cir@0x10013000 {
	compatible = "mediatek,mt7623-ir";
	reg = <0 0x10013000 0 0x1000>;
	interrupts = <GIC_SPI 87 IRQ_TYPE_LEVEL_LOW>;
	clocks = <&infracfg CLK_INFRA_IRRX>;
	clock-names = "clk";
	linux,rc-map-name = "rc-rc6-mce";
};
```

## Documentation/devicetree/bindings/media/renesas,ceu.txt
```
Renesas Capture Engine Unit (CEU)
----------------------------------------------

The Capture Engine Unit is the image capture interface found on Renesas
RZ chip series and on SH Mobile ones.

The interface supports a single parallel input with data bus width up to
8/16 bits.

Required properties:
- compatible
	Must be one of:
	- "renesas,ceu"
	- "renesas,r7s72100-ceu"
- reg
	Physical address base and size.
- interrupts
	The interrupt specifier.
- pinctrl-names, pinctrl-0
	phandle of pin controller sub-node configuring pins for CEU operations.
- remote-endpoint
	phandle to an 'endpoint' subnode of a remote device node.

CEU supports a single parallel input and should contain a single 'port' subnode
with a single 'endpoint'. Optional endpoint properties applicable to parallel
input bus described in "video-interfaces.txt" supported by this driver are:

- hsync-active
	active state of the HSYNC signal, 0/1 for LOW/HIGH respectively.
- vsync-active
	active state of the VSYNC signal, 0/1 for LOW/HIGH respectively.

Example:

The example describes the connection between the Capture Engine Unit and an
OV7670 image sensor sitting on bus i2c1.

ceu: ceu@e8210000 {
	reg = <0xe8210000 0x209c>;
	compatible = "renesas,ceu";
	interrupts = <GIC_SPI 332 IRQ_TYPE_LEVEL_HIGH>;

	pinctrl-names = "default";
	pinctrl-0 = <&vio_pins>;

	status = "okay";

	port {
		ceu_in: endpoint {
			remote-endpoint = <&ov7670_out>;

			hsync-active = <1>;
			vsync-active = <0>;
		};
	};
};

i2c1: i2c@fcfee400 {
	pinctrl-names = "default";
	pinctrl-0 = <&i2c1_pins>;

	status = "okay";

	clock-frequency = <100000>;

	ov7670: camera@21 {
		compatible = "ovti,ov7670";
		reg = <0x21>;

		pinctrl-names = "default";
		pinctrl-0 = <&vio_pins>;

		reset-gpios = <&port3 11 GPIO_ACTIVE_LOW>;
		powerdown-gpios = <&port3 12 GPIO_ACTIVE_HIGH>;

		port {
			ov7670_out: endpoint {
				remote-endpoint = <&ceu_in>;

				hsync-active = <1>;
				vsync-active = <0>;
			};
		};
	};
};
```
